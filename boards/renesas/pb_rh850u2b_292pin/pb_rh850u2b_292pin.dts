/*
 * Copyright (c) 2025 Renesas Electronics Corporation
 * SPDX-License-Identifier: Apache-2.0
 */

/dts-v1/;

#include <rh850/renesas/rh850u2b/r7f70254xafabb-c.dtsi>
#include <dt-bindings/gpio/gpio.h>

/ {
	model = "Renesas RH850 U2B 292pin";
	compatible = "renesas,u2b10", "renesas,u2b";
};


