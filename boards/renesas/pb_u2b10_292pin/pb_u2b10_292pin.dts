/*
 * Copyright (c) 2025 Renesas Electronics Corporation
 * SPDX-License-Identifier: Apache-2.0
 */

/dts-v1/;

#include <rh850/renesas/u2b/u2b10/r7f70254xafabb-c.dtsi>
#include <dt-bindings/gpio/gpio.h>

/ {
	model = "Renesas R-H850 U2B10 292pin";
	compatible = "renesas,u2b10", "renesas,u2b";
};


