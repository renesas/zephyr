/*
 * Copyright (c) 2025 Renesas Electronics Corporation
 * SPDX-License-Identifier: Apache-2.0
 */

/dts-v1/;

#include <renesas/ra/ra8/r7ka8p1kflcac_cm33.dtsi>
#include "ek_ra8p1_r7ka8p1kflcac_cm33_common.dtsi"

/ {
	model = "Renesas EK-RA8P1";

	chosen {
		zephyr,sram = &sram1;
	};
};
