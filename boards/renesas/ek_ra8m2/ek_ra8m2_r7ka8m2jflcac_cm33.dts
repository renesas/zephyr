/*
 * Copyright (c) 2026 Renesas Electronics Corporation
 *
 * SPDX-License-Identifier: Apache-2.0
 */

/dts-v1/;

#include <renesas/ra/ra8/r7ka8m2jflcac_cm33.dtsi>
#include "ek_ra8m2_r7ka8m2jflcac_cm33_common.dtsi"

/ {
	model = "Renesas EK-RA8M2";

	chosen {
		zephyr,sram = &sram1;
	};
};
