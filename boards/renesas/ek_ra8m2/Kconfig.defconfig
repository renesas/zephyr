## boards/renesas/ek_ra8m2/Kconfig.ek_ra8m2
```kconfig
# Copyright (c) 2025-2026 Renesas Electronics Corporation
# SPDX-License-Identifier: Apache-2.0

config BOARD_EK_RA8M2
	select SOC_R7KA8M2JFLCAC_CM85 if BOARD_EK_RA8M2_R7KA8M2JFLCAC_CM85
	select SOC_R7KA8M2JFLCAC_CM85 if BOARD_EK_RA8M2_R7KA8M2JFLCAC_CM85_NS
	select SOC_R7KA8M2JFLCAC_CM33 if BOARD_EK_RA8M2_R7KA8M2JFLCAC_CM33
	select SOC_R7KA8M2JFLCAC_CM33 if BOARD_EK_RA8M2_R7KA8M2JFLCAC_CM33_NS
	select TFM_PARTITION_FIRMWARE_UPDATE_SUPPORTED if BOARD_EK_RA8M2_R7KA8M2JFLCAC_CM85_NS
```

## boards/renesas/ek_ra8p1/Kconfig.ek_ra8p1
```kconfig
# Copyright (c) 2025 Renesas Electronics Corporation
# SPDX-License-Identifier: Apache-2.0

config BOARD_EK_RA8P1
	select SOC_R7KA8P1KFLCAC_CM85 if BOARD_EK_RA8P1_R7KA8P1KFLCAC_CM85
	select SOC_R7KA8P1KFLCAC_CM33 if BOARD_EK_RA8P1_R7KA8P1KFLCAC_CM33

config BOARD_EK_RA8P1_MIPI_CSI2_INIT
	bool "Configure EK-RA8P1 MIPI CSI-2 board bring-up during init"
	default n
	help
		Enable board-level MIPI CSI-2 bring-up on the EK-RA8P1. This drives
		the D-PHY analog enable GPIO (P108) and, when the sw4_ioexp node is
		present, configures the camera connector mux (SW4-6/MIPI_SEL) for
		CSI-2 routing. Both are required for CSI-2 lane activity regardless
		of the rest of the capture pipeline configuration.

		Automatically enabled by VIDEO_RENESAS_RA_VIN. Applications using
		VIN/MIPI CSI-2 through raw FSP APIs instead of the Zephyr VIN driver
		must enable this option explicitly.
```

## boards/renesas/ek_rx74m/Kconfig.defconfig
```kconfig
# Copyright (c) 2025 Renesas Electronics Corporation
# SPDX-License-Identifier: Apache-2.0

if BOARD_EK_RX74M

if NETWORKING

config NET_L2_ETHERNET
	default y

config ETH_INIT_PRIORITY
	int "Ethernet driver init priority"
	default 55

config PHY_VERIFY_DEVICE_IDENTIFICATION
	default y

config NET_IF_MAX_IPV4_COUNT
	default 2

endif # NETWORKING

endif # BOARD_EK_RX74M
```

## boards/renesas/ek_rx74m/board.yml
```yaml
board:
  name: ek_rx74m
  full_name: Evaluation Kit for RX74M
  vendor: renesas
  socs:
    - name: r5k574mcb4ae
```

## boards/renesas/ek_rx74n/Kconfig.defconfig
```kconfig
# Copyright (c) 2026 Renesas Electronics Corporation
# SPDX-License-Identifier: Apache-2.0

if BOARD_EK_RX74N

if NETWORKING

config NET_L2_ETHERNET
	default y

config ETH_INIT_PRIORITY
	int "Ethernet driver init priority"
	default 55

config PHY_VERIFY_DEVICE_IDENTIFICATION
	default y

config NET_IF_MAX_IPV4_COUNT
	default 1

endif # NETWORKING

endif # BOARD_EK_RX74N
```

## boards/renesas/pb_rh850u2a_144pin/Kconfig.pb_rh850u2a_144pin
```kconfig
# Copyright (c) 2026 Renesas Electronics Corporation
# SPDX-License-Identifier: Apache-2.0

config BOARD_PB_RH850U2A_144PIN
	select SOC_R7F702302FAFM_C if BOARD_PB_RH850U2A_144PIN_R7F702302FAFM_C
```

## boards/renesas/pb_rh850u2a_144pin/board.yml
```yaml
board:
  name: pb_rh850u2a_144pin
  full_name: RH850/U2A 144pin PiggyBack Board
  vendor: renesas
  socs:
  - name: r7f702302fafm-c
```

## boards/renesas/pb_rh850u2a_156pin/Kconfig.pb_rh850u2a_156pin
```kconfig
# Copyright (c) 2026 Renesas Electronics Corporation
# SPDX-License-Identifier: Apache-2.0

config BOARD_PB_RH850U2A_156PIN
	select SOC_R7F702302FABD_C if BOARD_PB_RH850U2A_156PIN_R7F702302FABD_C
```

## boards/renesas/pb_rh850u2a_156pin/board.yml
```yaml
board:
  name: pb_rh850u2a_156pin
  full_name: RH850/U2A 156pin PiggyBack Board
  vendor: renesas
  socs:
  - name: r7f702302fabd-c
```

## boards/renesas/pb_rh850u2a_176pin/Kconfig.pb_rh850u2a_176pin
```kconfig
# Copyright (c) 2026 Renesas Electronics Corporation
# SPDX-License-Identifier: Apache-2.0

config BOARD_PB_RH850U2A_176PIN
	select SOC_R7F702302FAFK_C if BOARD_PB_RH850U2A_176PIN_R7F702302FAFK_C
```

## boards/renesas/pb_rh850u2a_176pin/board.yml
```yaml
board:
  name: pb_rh850u2a_176pin
  full_name: RH850/U2A 176pin PiggyBack Board
  vendor: renesas
  socs:
  - name: r7f702302fafk-c
```

## boards/renesas/pb_rh850u2a_292pin/Kconfig.pb_rh850u2a_292pin
```kconfig
# Copyright (c) 2026 Renesas Electronics Corporation
# SPDX-License-Identifier: Apache-2.0

config BOARD_PB_RH850U2A_292PIN
	select SOC_R7F702300AFABA_C if BOARD_PB_RH850U2A_292PIN_R7F702300AFABA_C
	select SOC_R7F702300BFABA_C if BOARD_PB_RH850U2A_292PIN_R7F702300BFABA_C
	select SOC_R7F702300EABA_C if BOARD_PB_RH850U2A_292PIN_R7F702300EABA_C
	select SOC_R7F702301AFABG_C if BOARD_PB_RH850U2A_292PIN_R7F702301AFABG_C
	select SOC_R7F702301BFABG_C if BOARD_PB_RH850U2A_292PIN_R7F702301BFABG_C
	select SOC_R7F702301EABG_C if BOARD_PB_RH850U2A_292PIN_R7F702301EABG_C
	select SOC_R7F702302FABB_C if BOARD_PB_RH850U2A_292PIN_R7F702302FABB_C
```

## boards/renesas/pb_rh850u2a_292pin/board.yml
```yaml
board:
  name: pb_rh850u2a_292pin
  full_name: RH850/U2A 292pin PiggyBack Board
  vendor: renesas
  socs:
  - name: r7f702300afaba-c
  - name: r7f702300bfaba-c
  - name: r7f702300eaba-c
  - name: r7f702301afabg-c
  - name: r7f702301bfabg-c
  - name: r7f702301eabg-c
  - name: r7f702302fabb-c
```

## boards/renesas/pb_rh850u2a_373pin/Kconfig.pb_rh850u2a_373pin
```kconfig
# Copyright (c) 2026 Renesas Electronics Corporation
# SPDX-License-Identifier: Apache-2.0

config BOARD_PB_RH850U2A_373PIN
	select SOC_R7F702300AEBBB_C if BOARD_PB_RH850U2A_373PIN_R7F702300AEBBB_C
	select SOC_R7F702300BEBBB_C if BOARD_PB_RH850U2A_373PIN_R7F702300BEBBB_C
	select SOC_R7F702300EBBB_C if BOARD_PB_RH850U2A_373PIN_R7F702300EBBB_C
	select SOC_R7F702301AEBBA_C if BOARD_PB_RH850U2A_373PIN_R7F702301AEBBA_C
	select SOC_R7F702301BEBBA_C if BOARD_PB_RH850U2A_373PIN_R7F702301BEBBA_C
	select SOC_R7F702301EBBA_C if BOARD_PB_RH850U2A_373PIN_R7F702301EBBA_C
```

## boards/renesas/pb_rh850u2a_373pin/board.yml
```yaml
board:
  name: pb_rh850u2a_373pin
  full_name: RH850/U2A 373pin PiggyBack Board
  vendor: renesas
  socs:
  - name: r7f702300aebbb-c
  - name: r7f702300bebbb-c
  - name: r7f702300ebbb-c
  - name: r7f702301aebba-c
  - name: r7f702301bebba-c
  - name: r7f702301ebba-c
```

## boards/renesas/pb_rh850u2b_292pin/Kconfig.pb_rh850u2b_292pin
```kconfig
# Copyright (c) 2025 Renesas Electronics Corporation
# SPDX-License-Identifier: Apache-2.0

config BOARD_PB_RH850U2B_292PIN
	select SOC_R7F70254XAFABB_C if BOARD_PB_RH850U2B_292PIN_R7F70254XAFABB_C
	select SOC_R7F70254XFABB_C if BOARD_PB_RH850U2B_292PIN_R7F70254XFABB_C
	select SOC_R7F70255XAFABB_C if BOARD_PB_RH850U2B_292PIN_R7F70255XAFABB_C
	select SOC_R7F70255XBFABB_C if BOARD_PB_RH850U2B_292PIN_R7F70255XBFABB_C
	select SOC_R7F70255XFABB_C if BOARD_PB_RH850U2B_292PIN_R7F70255XFABB_C
```

## boards/renesas/pb_rh850u2b_292pin/board.yml
```yaml
board:
  name: pb_rh850u2b_292pin
  full_name: Piggy Board RH850 U2B 292pin
  vendor: renesas
  socs:
  - name: r7f70254xafabb-c
  - name: r7f70254xfabb-c
  - name: r7f70255xafabb-c
  - name: r7f70255xbfabb-c
  - name: r7f70255xfabb-c
```

## boards/renesas/pb_rh850u2b_373pin/Kconfig.pb_rh850u2b_373pin
```kconfig
# Copyright (c) 2026 Renesas Electronics Corporation
# SPDX-License-Identifier: Apache-2.0

config BOARD_PB_RH850U2B_373PIN
	select SOC_R7F70254XAFABA_C if BOARD_PB_RH850U2B_373PIN_R7F70254XAFABA_C
	select SOC_R7F70254XFABA_C if BOARD_PB_RH850U2B_373PIN_R7F70254XFABA_C
```

## boards/renesas/pb_rh850u2b_373pin/board.yml
```yaml
board:
  name: pb_rh850u2b_373pin
  full_name: Piggy Board RH850 U2B 373pin
  vendor: renesas
  socs:
  - name: r7f70254xafaba-c
  - name: r7f70254xfaba-c
```
