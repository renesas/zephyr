/*
 * Copyright (c) 2026 Renesas Electronics Corporation
 *
 * SPDX-License-Identifier: Apache-2.0
 */

/dts-v1/;

#include <renesas/ra/ra8/r7ka8m2jflcac_cm33_ns.dtsi>
#include "ek_ra8m2_r7ka8m2jflcac_cm33_common.dtsi"
#include "ek_ra8m2_r7ka8m2jflcac_ns_partition.dtsi"

/ {
	model = "Renesas EK-RA8M2 Non-Secure";

	chosen {
		zephyr,sram = &sram1_ns;
		zephyr,code-partition = &cm33_slot0_ns_partition;
	};
};

/* CGC is configured by the TF-M secure image */
&pclkblock {
	secure-clocks;
};
