## drivers/ethernet/Kconfig.renesas_rcarsoc
```kconfig
# Copyright (c) 2026 Renesas Electronics Corporation
# SPDX-License-Identifier: Apache-2.0

config ETH_RENESAS_RCARSOC_TSNES
	bool "Renesas TSN Endpoint Station (TSN-ES)"
	default y
	depends on DT_HAS_RENESAS_RCARSOC_ETH_TSNES_ENABLED
	help
		Enable TSN-ES Ethernet controller
		- 10 Gbps TSN-aware switching
		- Multiple RX/TX queues
		- DMA buffer management
		- Per-queue statistics

if ETH_RENESAS_RCARSOC_TSNES

config ETH_RENESAS_RCARSOC_TSNES_BUFFER_POOL_SIZE
	int "Total DMA buffer pool size (bytes)"
	default 3145728
	range 65536 4194304
	help
		Total memory allocated for TX/RX buffers.
		Must be aligned to cache line size (64 bytes).
		Larger pools support more concurrent frames.

config ETH_RENESAS_RCARSOC_TSNES_MAX_FRAME_SIZE
	int "Maximum frame size (bytes)"
	default 1522
	range 64 9000
	help
		Maximum Ethernet frame size including VLAN tag.
		1522: Standard (1500 payload + 14 MAC + 4 VLAN + 4 FCS)
		9000: Jumbo frames support

config ETH_RENESAS_RCARSOC_TSNES_RX_THREAD_PRIORITY
	int "Priority of RX processing thread"
	default 2
	help
		Cooperative thread priority (0-255).
		Lower values = higher priority.
		Typical: 0-2 for real-time, 3-7 for normal.

config ETH_RENESAS_RCARSOC_TSNES_RX_THREAD_STACK
	int "Stack size for RX thread (bytes)"
	default 2048
	range 1024 8192
	help
		Stack size for RX descriptor processing thread.

config ETH_RENESAS_RCARSOC_TSNES_DESCRIPTOR_CACHE_ALIGN
	int "Descriptor cache alignment (bytes)"
	default 64
	help
		Cache line size for descriptor alignment.
		Improves DMA performance.

config ETH_RENESAS_RCARSOC_TSNES_ENABLE_DMA_CACHE_OPS
	bool "Explicit DMA cache operations"
	help
		Use explicit cache invalidate/flush operations for DMA.
		Required for DMA coherency on systems without hardware coherency.

config ETH_RENESAS_RCARSOC_TSNES_CONFIG_LOOPBACK
	bool "Configuration loopback mode for testing"

config ETH_RENESAS_RCARSOC_TSNES_TIMESTAMP_CAPTURE
	bool "Timestamp capture for Ethernet TSNES"
	default y
	depends on PTP_CLOCK_RENESAS_RCAR
	help
		Enable Timestamp capture feature on TSNES
		Require desired ptp-clock to be enabled
		and attached through device tree property

endif # ETH_RENESAS_RCARSOC_TSNES

config ETH_RENESAS_RCARSOC_RSWITCH3
	bool "Renesas R-Switch 3 Ethernet Switch Driver"
	default y
	depends on DT_HAS_RENESAS_RCARSOC_RSWITCH3_ENABLED
	select PHY_RENESAS_PCS
	select NET_MGMT if ETH_RENESAS_RCARSOC_TSNES
	select NET_MGMT_EVENT if ETH_RENESAS_RCARSOC_TSNES
	help
	  Enable the driver for the Renesas R-Switch 3. This driver
	  manages the switch fabric, brings up the external ports and the
	  internal agents of TSN-ES endpoints, and configures forwarding
	  between them.

if ETH_RENESAS_RCARSOC_RSWITCH3

config ETH_RENESAS_RSWITCH3_TIMEOUT
	int "Register access timeout (us)"
	default 100000
	help
	  Timeout in microseconds for waiting on register bit changes.
	  Must comfortably exceed the 10ms link-verification window the
	  driver programs into MLVC.LVT.

config ETH_RENESAS_RSWITCH3_INIT_PRIORITY
	int "R-Switch 3 driver init priority"
	default 55
	help
	  Physical port bring-up wires each port's external PHY and PCS
	  channel device, so this must run after CONFIG_MDIO_INIT_PRIORITY
	  and CONFIG_PHY_INIT_PRIORITY, and before CONFIG_ETH_INIT_PRIORITY
	  (the per-port net_if attaches to the GWCA at that priority).

config ETH_RENESAS_RSWITCH3_GWCA
	bool "Renesas R-Switch 3 GWCA (Gateway CPU Agent) DMA engine"
	depends on DT_HAS_RENESAS_RCARSOC_RSWITCH3_GWCA_ENABLED
	help
	  Enable the GWCA DMA engine sub-module, letting the CPU inject
	  and receive frames through the R-Switch 3 fabric directly.
	  Selected by the physical-port net_if driver. Independent of the
	  TSN-ES DMA path, which does not use GWCA.

if ETH_RENESAS_RSWITCH3_GWCA

config ETH_RENESAS_RSWITCH3_GWCA_INIT_PRIORITY
	int "R-Switch 3 gateway init priority"
	default 56
	help
	  Must be higher than ETH_RENESAS_RSWITCH3_INIT_PRIORITY, since a gateway
	  can only come up once the switch has reset the common block and cleared
	  the forwarding tables.

config ETH_RENESAS_RSWITCH3_GWCA_RX_THREAD_STACK_SIZE
	int "GWCA RX-processing thread stack size (bytes)"
	default 2048
	help
	  Stack of the thread that drains the GWCA RX rings and passes each
	  frame to the network stack with net_recv_data(). The default of
	  2048 bytes covers net_pkt allocation and queueing to the stack's RX
	  thread. With CONFIG_NET_TC_RX_COUNT=0 the whole receive path runs
	  on this thread, which then needs CONFIG_NET_RX_STACK_SIZE instead.

config ETH_RENESAS_RSWITCH3_GWCA_RX_THREAD_PRIORITY
	int "GWCA RX-processing thread priority"
	default 2
	help
	  Cooperative priority of the GWCA RX thread, which runs at
	  K_PRIO_COOP(<value>) so it is not preempted while draining a ring.
	  Must be below CONFIG_NUM_COOP_PRIORITIES; lower values give higher
	  priority. The default of 2 matches the RX threads of other Ethernet
	  drivers.

config ETH_RENESAS_RSWITCH3_GWCA_ENABLE_DMA_CACHE_OPS
	bool "Explicit DMA cache operations for GWCA"
	default y
	help
	  Use explicit cache invalidate/flush around GWCA descriptor and
	  buffer accesses. Required for DMA coherency on systems without
	  hardware coherency between the CPU and GWCA, so enabled by default.
	  No cache operations are done with CONFIG_NOCACHE_MEMORY.

endif # ETH_RENESAS_RSWITCH3_GWCA

config ETH_RENESAS_RSWITCH3_PORT
	bool "Renesas R-Switch 3 physical-port net_if (GWCA-backed)"
	default y
	depends on DT_HAS_RENESAS_RCARSOC_RSWITCH3_PORT_ENABLED
	depends on DT_HAS_RENESAS_RCARSOC_RSWITCH3_GWCA_ENABLED
	select ETH_RENESAS_RSWITCH3_GWCA
	select NET_CHECKSUM_OFFLOAD_SUPPORTED if NET_L2_ETHERNET
	help
	  Enable one Zephyr net_if per external renesas,rcarsoc-rswitch3-port
	  child node that names a GWCA engine with renesas,gwca, backed by a
	  dedicated GWCA TX/RX queue pair, allowing the CPU to send/receive
	  packets directly through a physical port without a TSN-ES endpoint.
	  An external port without renesas,gwca is only brought up and
	  forwarded, for example to a TSN-ES agent. With no engine enabled,
	  neither this driver nor GWCA is built.

	  With CONFIG_NET_CHECKSUM_OFFLOAD, IPv4 header, and TCP, UDP and
	  ICMP over IPv4 checksums are computed by GWCA on TX and checked by
	  the ETHA ingress on RX (bad frames are dropped in the switch).
	  IPv6 checksums stay in software.

endif # ETH_RENESAS_RCARSOC_RSWITCH3
```
