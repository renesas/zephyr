## boards/renesas/pb_rh850u2b_468pin/board.yml
```yaml
board:
  name: pb_rh850u2b_468pin
  full_name: Piggy Board RH850 U2B 468pin
  vendor: renesas
  socs:
  - name: r7f70254xafabg-c
  - name: r7f70254xfabg-c
  revision:
    format: major.minor.patch
    default: "3.0.0"
    revisions:
    - name: "1.0.0"
    - name: "2.0.0"
    - name: "3.0.0"
```

## boards/renesas/pb_rh850u2c_100pin/Kconfig.pb_rh850u2c_100pin
```kconfig
# Copyright (c) 2026 Renesas Electronics Corporation
# SPDX-License-Identifier: Apache-2.0

config BOARD_PB_RH850U2C_100PIN
	select SOC_R7F702606AFAFD_C if BOARD_PB_RH850U2C_100PIN_R7F702606AFAFD_C
	select SOC_R7F702616AFAFD_C if BOARD_PB_RH850U2C_100PIN_R7F702616AFAFD_C
	select SOC_R7F702613AFAFD_C if BOARD_PB_RH850U2C_100PIN_R7F702613AFAFD_C
	select SOC_R7F702608AFAFD_C if BOARD_PB_RH850U2C_100PIN_R7F702608AFAFD_C
```

## boards/renesas/pb_rh850u2c_100pin/board.yml
```yaml
board:
  name: pb_rh850u2c_100pin
  full_name: Piggy Board RH850 U2C 100pin
  vendor: renesas
  socs:
  - name: r7f702606afafd-c
  - name: r7f702616afafd-c
  - name: r7f702613afafd-c
  - name: r7f702608afafd-c
```

## boards/renesas/pb_rh850u2c_144pin/Kconfig.pb_rh850u2c_144pin
```kconfig
# Copyright (c) 2026 Renesas Electronics Corporation
# SPDX-License-Identifier: Apache-2.0

config BOARD_PB_RH850U2C_144PIN
	select SOC_R7F702606AFAFB_C if BOARD_PB_RH850U2C_144PIN_R7F702606AFAFB_C
	select SOC_R7F702606AFAFM_C if BOARD_PB_RH850U2C_144PIN_R7F702606AFAFM_C
	select SOC_R7F702616AFAFM_C if BOARD_PB_RH850U2C_144PIN_R7F702616AFAFM_C
	select SOC_R7F702616AFAFB_C if BOARD_PB_RH850U2C_144PIN_R7F702616AFAFB_C
	select SOC_R7F702614AFAFM_C if BOARD_PB_RH850U2C_144PIN_R7F702614AFAFM_C
	select SOC_R7F702614AFAFB_C if BOARD_PB_RH850U2C_144PIN_R7F702614AFAFB_C
	select SOC_R7F702615AFAFM_C if BOARD_PB_RH850U2C_144PIN_R7F702615AFAFM_C
	select SOC_R7F702615AFAFB_C if BOARD_PB_RH850U2C_144PIN_R7F702615AFAFB_C
```

## boards/renesas/pb_rh850u2c_144pin/board.yml
```yaml
board:
  name: pb_rh850u2c_144pin
  full_name: Piggy Board RH850 U2C 144pin
  vendor: renesas
  socs:
  - name: r7f702606afafb-c
  - name: r7f702606afafm-c
  - name: r7f702616afafm-c
  - name: r7f702616afafb-c
  - name: r7f702614afafm-c
  - name: r7f702614afafb-c
  - name: r7f702615afafm-c
  - name: r7f702615afafb-c
```

## boards/renesas/pb_rh850u2c_292pin/board.yml
```yaml
board:
  name: pb_rh850u2c_292pin
  full_name: Piggy Board RH850 U2C 292pin
  vendor: renesas
  socs:
  - name: r7f702600afabb-c
  - name: r7f702606afabb-c
  - name: r7f702616afabb-c
  - name: r7f702613afabb-c
```

## boards/renesas/y_ask_rh850u2a/Kconfig.y_ask_rh850u2a
```kconfig
# Copyright (c) 2026 Renesas Electronics Corporation
# SPDX-License-Identifier: Apache-2.0

config BOARD_Y_ASK_RH850U2A
	select SOC_R7F702300BFABA_C if BOARD_Y_ASK_RH850U2A_R7F702300BFABA_C
	select SOC_R7F702302FABB_C if BOARD_Y_ASK_RH850U2A_R7F702302FABB_C
```

## boards/renesas/y_ask_rh850u2a/board.yml
```yaml
board:
  name: y_ask_rh850u2a
  full_name: RH850/U2A Starter Kit
  vendor: renesas
  socs:
  - name: r7f702300bfaba-c
  - name: r7f702302fabb-c
```

## boards/renesas/y_ask_rh850u2b/Kconfig.y_ask_rh850u2b
```kconfig
# Copyright (c) 2026 Renesas Electronics Corporation
# SPDX-License-Identifier: Apache-2.0

config BOARD_Y_ASK_RH850U2B
	select SOC_R7F70255XFABB_C if BOARD_Y_ASK_RH850U2B_R7F70255XFABB_C
	select SOC_R7F70255XAFABB_C if BOARD_Y_ASK_RH850U2B_R7F70255XAFABB_C
	select SOC_R7F70255XBFABB_C if BOARD_Y_ASK_RH850U2B_R7F70255XBFABB_C
	select SOC_R7F70254XFABB_C if BOARD_Y_ASK_RH850U2B_R7F70254XFABB_C
	select SOC_R7F70254XAFABB_C if BOARD_Y_ASK_RH850U2B_R7F70254XAFABB_C
```

## boards/renesas/y_ask_rh850u2b/board.yml
```yaml
board:
  name: y_ask_rh850u2b
  full_name: RH850/U2B Starter Kit
  vendor: renesas
  socs:
  - name: r7f70255xfabb-c
  - name: r7f70255xafabb-c
  - name: r7f70255xbfabb-c
  - name: r7f70254xfabb-c
  - name: r7f70254xafabb-c
```

## boards/renesas/y_ask_rh850u2c/Kconfig.y_ask_rh850u2c
```kconfig
# Copyright (c) 2026 Renesas Electronics Corporation
# SPDX-License-Identifier: Apache-2.0

config BOARD_Y_ASK_RH850U2C
	select SOC_R7F702600AFABB_C if BOARD_Y_ASK_RH850U2C_R7F702600AFABB_C
	select SOC_R7F702606AFABB_C if BOARD_Y_ASK_RH850U2C_R7F702606AFABB_C
```

## boards/renesas/y_ask_rh850u2c/board.yml
```yaml
board:
  name: y_ask_rh850u2c
  full_name: RH850/U2C Starter Kit
  vendor: renesas
  socs:
  - name: r7f702600afabb-c
  - name: r7f702606afabb-c
```

## drivers/adc/Kconfig.renesas_rh850_adcj
```kconfig
# Copyright (c) 2026 Renesas Electronics Corporation
# SPDX-License-Identifier: Apache-2.0

config ADC_RENESAS_RH850_ADCJ
	bool "Renesas RH850 ADCJ ADC driver"
	default y
	depends on DT_HAS_RENESAS_RH850_ADCJ_ENABLED
	depends on ADC
	select USE_RH850_FSP_ADCJ
	help
	  Enable the Renesas RH850 ADCJ driver.
	  This driver uses the Renesas RH850 FSP ADCJ implementation as the
	  hardware access layer.

config ADC_RENESAS_RH850_ADCJ_STREAM
	bool "Renesas RH850 ADCJ ADC streaming support"
	default n
	depends on ADC_RENESAS_RH850_ADCJ
	depends on ADC_STREAM
	help
	  Use this configuration option to enable streaming ADC data via RTIO.

config ADC_RENESAS_RH850_ADCJ_STREAM_DMA
	bool "ADCJ DMA-backed streaming"
	default n
	depends on ADC_RENESAS_RH850_ADCJ_STREAM
	select DMA
	help
	  Use this configuration option to enable DMA for streaming ADC.
```

## drivers/adc/Kconfig.renesas_rh850_adck
```kconfig
# Copyright (c) 2026 Renesas Electronics Corporation
# SPDX-License-Identifier: Apache-2.0

config ADC_RENESAS_RH850_ADCK
	bool "Renesas RH850 ADCK ADC driver"
	default y
	depends on DT_HAS_RENESAS_RH850_ADCK_ENABLED
	depends on ADC
	select USE_RH850_FSP_ADCK
	help
	  Enable the ADC driver for the Renesas RH850 ADCK peripheral.
	  The driver uses the Renesas RH850 FSP ADCK implementation as its
	  hardware access layer.

config ADC_RENESAS_RH850_ADCK_STREAM
	bool "Renesas RH850 ADCK ADC streaming support"
	default n
	depends on ADC_RENESAS_RH850_ADCK
	depends on ADC_STREAM
	help
	  Use this configuration option to enable streaming ADC data via RTIO.

config ADC_RENESAS_RH850_ADCK_STREAM_DMA
	bool "ADCK DMA-backed streaming"
	default n
	depends on ADC_RENESAS_RH850_ADCK_STREAM
	select DMA
	help
	  Use this configuration option to enable DMA for streaming ADC.
```

## drivers/adc/Kconfig.renesas_rx
```kconfig
# Renesas RX Family

# Copyright (c) 2025 Renesas Electronics Corporation
# SPDX-License-Identifier: Apache-2.0

config ADC_RENESAS_RX
	bool "Renesas RX ADC"
	default y
	depends on DT_HAS_RENESAS_RX_ADC_ENABLED
	select USE_RX_RDP_ADC
	select PINCTRL
	help
	  Enable Renesas RX ADC Driver.

config ADC_RENESAS_RX_ADC_B
	bool "Renesas RX ADC_B"
	default y
	depends on DT_HAS_RENESAS_RX_ADC_B_ENABLED
	select USE_RX_FSP_ADC_B
	select ADC_CONFIGURABLE_INPUTS
	select PINCTRL
	help
	  Enable Renesas RX ADC_B Driver.
```

## drivers/audio/Kconfig.ak4619
```kconfig
# Copyright (c) 2026 Renesas Electronics Corporation
# SPDX-License-Identifier: Apache-2.0

config AUDIO_CODEC_AK4619
	bool "AKM AK4619 Audio CODEC driver"
	default y
	depends on GPIO
	depends on DT_HAS_ASAHI_KASEI_AK4619_ENABLED
	select I2C
	help
	  Enable driver for the AKM AK4619 audio CODEC.
```

## drivers/can/Kconfig.renesas_rh850
```kconfig
# Copyright (c) 2026 Renesas Electronics Corporation
# SPDX-License-Identifier: Apache-2.0

config CAN_RENESAS_RH850_CANFD
	bool "Renesas RH850 CANFD"
	default y
	depends on DT_HAS_RENESAS_RH850_CANFD_ENABLED
	select CLOCK_CONTROL
	select USE_RH850_FSP_CANFD
	select PINCTRL
	help
	  Enable Renesas RH850 CANFD driver

config CAN_RENESAS_RH850_TX_QUEUE_DEPTH
	int "RH850 CANFD hardware TX queue depth"
	depends on CAN_RENESAS_RH850_CANFD
	range 3 16
	default 8
	help
	  Maximum number of outstanding transmit frames per CAN channel.
```

## drivers/can/Kconfig.renesas_rx
```kconfig
# Copyright (c) 2025 Renesas Electronics Corporation
# SPDX-License-Identifier: Apache-2.0

config CAN_RENESAS_RX_CANFDG
	bool "Renesas RX CANFDG"
	default y
	depends on DT_HAS_RENESAS_RX_CANFDG_ENABLED
	select USE_RX_FSP_CANFDG
	select PINCTRL
	help
	  Enable Renesas RX CANFDG driver
```

## drivers/clock_control/Kconfig.renesas_rcar_adg
```kconfig
# Copyright (c) 2026 Renesas Electronics Corporation
# SPDX-License-Identifier: Apache-2.0

config CLOCK_CONTROL_RENESAS_RCAR_ADG
	bool "R-Car Audio Clock Generator"
	default y
	depends on SOC_FAMILY_RENESAS_RCAR
	depends on DT_HAS_RENESAS_RCAR_ADG_ENABLED
	depends on I2S || AUDIO
	help
	  Enable support for Renesas R-Car ADG clock control driver.

config CLOCK_CONTROL_ADG_INIT_PRIORITY
	int "Initialization priority of the ADG driver"
	default 40
	depends on CLOCK_CONTROL_RENESAS_RCAR_ADG
	help
	  Initialization priority of the ADG clock control driver. Must init before I2S.
```

## drivers/counter/Kconfig.renesas_ra
```kconfig
# Renesas RA Family

# Copyright (c) 2024 Renesas Electronics Corporation
# SPDX-License-Identifier: Apache-2.0

config COUNTER_RA_AGT
	bool "Renesas RA AGT driver"
	default y
	depends on DT_HAS_RENESAS_RA_AGT_COUNTER_ENABLED
	select USE_RA_FSP_AGT
	help
	  Enable support for Renesas Low Power Asynchronous General Purpose Timer (AGT) driver.

config COUNTER_RENESAS_RA_AGT_CUSTOM_CONSTANT_ALARMS
	bool "Enable custom feature"
	default n
	help 
	  Stops agt alarms from reseting after underflow
```

## drivers/counter/Kconfig.renesas_rcar
```kconfig
# Copyright (c) 2026 Renesas Electronics Corporation
# SPDX-License-Identifier: Apache-2.0

config COUNTER_RENESAS_RCAR_OSTM
	bool "Renesas R-Car OS Timer (OSTM) Counter driver"
	default y
	depends on DT_HAS_RENESAS_RCAR_OSTM_COUNTER_ENABLED
	select USE_RCARSOC_DRV_OSTM
	help
	  Enable the counter driver for the Renesas R-Car OS Timer (OSTM).
```

## drivers/counter/Kconfig.renesas_rx
```kconfig
# Copyright (c) 2026 Renesas Electronics Corporation
# SPDX-License-Identifier: Apache-2.0

config COUNTER_RENESAS_RX_TMR
	bool "Renesas RX 8-Bit Timer (TMR) Counter driver"
	default y
	depends on DT_HAS_RENESAS_RX_TMR_COUNTER_ENABLED
	select USE_RX_FSP_TMR
	help
	  Enable the counter driver for the Renesas RX 8-Bit Timer (TMR).
```

## drivers/dma/Kconfig.renesas_rcar
```kconfig
# Copyright (c) 2026 Renesas Electronics Corporation
# SPDX-License-Identifier: Apache-2.0

config DMA_RENESAS_RCAR
	bool "Renesas RCAR DMAC"
	default y
	depends on DT_HAS_RENESAS_RCAR_DMA_ENABLED
	select USE_RCARSOC_DRV_DMAC
	help
	  Enable Renesas RCAR DMA Driver.

if DMA_RENESAS_RCAR

config DMA_RENESAS_RCAR_NUM_DESCRIPTOR
	int "Maximum number of descriptor"
	default 128
	range 1 256
	help
	  Maximum number of descriptors for each channel in dma unit

endif
```

## drivers/entropy/Kconfig.renesas_rx
```kconfig
# Copyright (c) 2025 Renesas Electronics Corporation
# SPDX-License-Identifier: Apache-2.0

# Renesas RX entropy generator driver configuration

config ENTROPY_RENESAS_RX
	bool "Renesas RA TRNG driver"
	default y
	depends on DT_HAS_RENESAS_RX_RSIP_E50D_TRNG_ENABLED        \
		|| DT_HAS_RENESAS_RX_TRNG_ENABLED
	select ENTROPY_HAS_DRIVER
	select USE_RX_FSP_SCE
	help
	  This option enables entropy driver for Renesas RX
```
