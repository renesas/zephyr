## subsys/usb/host/class/Kconfig.msc
```kconfig
# SPDX-FileCopyrightText: Copyright 2026 Renesas, Embedd
# SPDX-License-Identifier: Apache-2.0

config USBH_MSC_CLASS
	bool "USB host Mass Storage Class support [EXPERIMENTAL]"
	select EXPERIMENTAL
	select DISK_ACCESS
	help
	  USB Mass Storage Class (MSC) implementation.

if USBH_MSC_CLASS

config USBH_MSC_INSTANCES_COUNT
	int "Number of HOST MSC instances"
	default 4
	help
	  Number of instances of this USB class

config USBH_MSC_TEST_UNIT_READY_ATTEMPTS
	int "Number of attempts for unit ready command"
	default 5
	help
	  Before an MSC device can be used it must be tested for readyness. It may respond
	  negatively, and this is the amount of attempts the test is repeated for before failing.

config USBH_MSC_RECOVERY_ATTEMPTS
	int "Number of recovery attempts in case of error"
	default 5
	help
	  A SCSI transaction may fail due to USB protocol issues (hardware disturbances, device
	  refuses to comply); in this case a reset is required. This is the number of times the host
	  driver attempts to reset communication and retry the transaction before failing.

config USBH_MSC_MAX_SUPPORTED_LUN
	int "Maximum number of logical units supported by the driver"
	default 4
	help
	  An MSC device may expose more than one drive in its interface. They are advertised as LUN
	  (Logical UNits) when the device is first connected and each one should result in a
	  different mount point. This configuration parameter specifies how many the driver can
	  handle for each device.

config USBH_MSC_IGNORE_SYNC
	bool "Do not attempt to sync data from the device's caches"
	default y
	help
	  A lot of cheap MSC devices don't support the SYNCHRONIZE CACHE command; this option skips
	  it.

module = USBH_MSC
module-str = usbh msc
default-count = 1
source "subsys/logging/Kconfig.template.log_config"
source "subsys/usb/common/Kconfig.template.instances_count"

endif # USBH_MSC_CLASS
```

## tests/boards/renesas/rcar/x5h/tsnes_loopback/testcase.yaml
```yaml
# Copyright (c) 2026 Renesas Electronics Corporation
# SPDX-License-Identifier: Apache-2.0

common:
  tags:
    - drivers
    - ethernet
    - net
tests:
  boards.renesas.rcar.x5h.tsnes_loopback:
    platform_allow:
      - rcar_ironhide_x5h/r8a78000/r52
    harness: ztest
```

## tests/drivers/can/api/boards/pb_rh850u2b_468pin_r7f70254xfabg-c.conf
```kconfig
# Copyright (c) 2026 Renesas Electronics Corporation
# SPDX-License-Identifier: Apache-2.0

CONFIG_COMMON_LIBC_MALLOC=y
CONFIG_COMMON_LIBC_MALLOC_ARENA_SIZE=32768
CONFIG_ISR_STACK_SIZE=4096
```

## tests/drivers/clock_control/clock_control_api/testcase.yaml
```yaml
common:
  tags:
    - drivers
    - clock_control

tests:
  drivers.clock.clock_control_api_default:
    platform_allow:
      - esp32_devkitc/esp32/procpu
      - esp32c3_devkitc
      - esp32s2_devkitc
      - esp32s3_devkitc/esp32s3/procpu
      - sltb010a@0
      - xg24_dk2601b
      - xg27_dk2602a
      - xg29_rb4412a
      - bg29_rb4420a
      - sam_e54_xpro
      - pic32cm_jh01_cpro
    integration_platforms:
      - esp32_devkitc/esp32/procpu

  drivers.clock.clock_control_nrf5:
    platform_allow:
      - nrf51dk/nrf51822
      - nrf52dk/nrf52832
      - nrf52840dk/nrf52840
      - nrf9160dk/nrf9160
      - nrf5340dk/nrf5340/cpuapp
      - nrf5340dk/nrf5340/cpunet
      - nrf54l15dk/nrf54l15/cpuapp
      - nrf54l15dk/nrf54l15/cpuapp/ns
      - nrf54lm20dk/nrf54lm20a/cpuapp
      - nrf54lm20dk/nrf54lm20b/cpuapp
      - nrf7120dk/nrf7120/cpuapp
      - nrf7120dk/nrf7120/cpuapp/ns
      - ophelia4ev/nrf54l15/cpuapp
    integration_platforms:
      - nrf51dk/nrf51822

  drivers.clock.clock_control_nrf5_lfclk_rc:
    platform_allow:
      - nrf51dk/nrf51822
      - nrf52dk/nrf52832
      - nrf52840dk/nrf52840
      - nrf54l15dk/nrf54l15/cpuapp
      - nrf54l15dk/nrf54l15/cpuapp/ns
      - nrf5340dk/nrf5340/cpuapp
      - nrf54lm20dk/nrf54lm20a/cpuapp
      - nrf54lm20dk/nrf54lm20b/cpuapp
      - nrf7120dk/nrf7120/cpuapp
      - nrf7120dk/nrf7120/cpuapp/ns
      - ophelia4ev/nrf54l15/cpuapp
    integration_platforms:
      - nrf51dk/nrf51822
    extra_args: EXTRA_CONF_FILE="nrf_lfclk_rc.conf"

  drivers.clock.clock_control_rh850:
    platform_allow:
      # RH850 U2A
      - pb_rh850u2a_144pin/r7f702302fafm-c
      - pb_rh850u2a_156pin/r7f702302fabd-c
      - pb_rh850u2a_176pin/r7f702302fafk-c
      - pb_rh850u2a_292pin/r7f702300afaba-c
      - pb_rh850u2a_292pin/r7f702300bfaba-c
      - pb_rh850u2a_292pin/r7f702300eaba-c
      - pb_rh850u2a_292pin/r7f702301afabg-c
      - pb_rh850u2a_292pin/r7f702301bfabg-c
      - pb_rh850u2a_292pin/r7f702301eabg-c
      - pb_rh850u2a_292pin/r7f702302fabb-c
      - pb_rh850u2a_373pin/r7f702300aebbb-c
      - pb_rh850u2a_373pin/r7f702300bebbb-c
      - pb_rh850u2a_373pin/r7f702300ebbb-c
      - pb_rh850u2a_373pin/r7f702301aebba-c
      - pb_rh850u2a_373pin/r7f702301bebba-c
      - pb_rh850u2a_373pin/r7f702301ebba-c
      - pb_rh850u2a_516pin/r7f702300bebbc-c
      - pb_rh850u2a_516pin/r7f702300ebbg-c
      - pb_rh850u2a_516pin/r7f702300aebbc-c
      - y_ask_rh850u2a/r7f702300bfaba-c
      - y_ask_rh850u2a/r7f702302fabb-c
      # RH850 U2B
      - pb_rh850u2b_292pin/r7f70254xafabb-c
      - pb_rh850u2b_292pin/r7f70254xfabb-c
      - pb_rh850u2b_292pin/r7f70255xafabb-c
      - pb_rh850u2b_292pin/r7f70255xbfabb-c
      - pb_rh850u2b_292pin/r7f70255xfabb-c
      - pb_rh850u2b_373pin/r7f70254xafaba-c
      - pb_rh850u2b_373pin/r7f70254xfaba-c
      - pb_rh850u2b_468pin/r7f70254xafabg-c
      - pb_rh850u2b_468pin/r7f70254xfabg-c
      - y_ask_rh850u2b/r7f70254xafabb-c
      - y_ask_rh850u2b/r7f70254xfabb-c
      - y_ask_rh850u2b/r7f70255xafabb-c
      - y_ask_rh850u2b/r7f70255xbfabb-c
      - y_ask_rh850u2b/r7f70255xfabb-c
      # RH850 U2C
      - pb_rh850u2c_100pin/r7f702606afafd-c
      - pb_rh850u2c_100pin/r7f702616afafd-c
      - pb_rh850u2c_100pin/r7f702613afafd-c
      - pb_rh850u2c_100pin/r7f702608afafd-c
      - pb_rh850u2c_144pin/r7f702606afafb-c
      - pb_rh850u2c_144pin/r7f702606afafm-c
      - pb_rh850u2c_144pin/r7f702616afafm-c
      - pb_rh850u2c_144pin/r7f702616afafb-c
      - pb_rh850u2c_144pin/r7f702614afafm-c
      - pb_rh850u2c_144pin/r7f702614afafb-c
      - pb_rh850u2c_144pin/r7f702615afafm-c
      - pb_rh850u2c_144pin/r7f702615afafb-c
      - pb_rh850u2c_292pin/r7f702600afabb-c
      - pb_rh850u2c_292pin/r7f702606afabb-c
      - pb_rh850u2c_292pin/r7f702616afabb-c
      - pb_rh850u2c_292pin/r7f702613afabb-c
      - y_ask_rh850u2c/r7f702600afabb-c
      - y_ask_rh850u2c/r7f702606afabb-c
```

## tests/drivers/disk/disk_access/boards/ek_rx74n.conf
```kconfig
# Copyright (c) 2026 Renesas Electronics Corporation
# SPDX-License-Identifier: Apache-2.0

CONFIG_MAIN_STACK_SIZE=1280
CONFIG_SPI_RENESAS_RX_SCI_B_INTERRUPT=y
CONFIG_SPI_ASYNC=y
```

## tests/drivers/firmware/scmi/renesas/rcar/clock/testcase.yaml
```yaml
# SPDX-License-Identifier: Apache-2.0

tests:
  drivers.firmware.scmi.renesas.rcar.clock:
    tags:
      - scmi
      - clock_control
    timeout: 30
    platform_allow:
      - rcar_ironhide_x5h/r8a78000/r52
    integration_platforms:
      - rcar_ironhide_x5h/r8a78000/r52
```

## tests/drivers/firmware/scmi/renesas/rcar/power_system/testcase.yaml
```yaml
# SPDX-License-Identifier: Apache-2.0

tests:
  drivers.firmware.scmi.renesas.rcar.power_system:
    tags:
      - scmi
      - power_domain
      - system_power
    timeout: 30
    platform_allow:
      - rcar_ironhide_x5h/r8a78000/r52
    integration_platforms:
      - rcar_ironhide_x5h/r8a78000/r52
```

## tests/drivers/firmware/scmi/renesas/rcar/reset/testcase.yaml
```yaml
# SPDX-License-Identifier: Apache-2.0

tests:
  drivers.firmware.scmi.renesas.rcar.reset:
    tags:
      - scmi
      - reset
    timeout: 30
    platform_allow:
      - rcar_ironhide_x5h/r8a78000/r52
    integration_platforms:
      - rcar_ironhide_x5h/r8a78000/r52
```

## tests/drivers/pinctrl/renesas/testcase.yaml
```yaml
tests:
  drivers.pinctrl.renesas:
    tags:
      - drivers
      - pinctrl
    platform_allow: rcar_ironhide_x5h/r8a78000/r52
```

## tests/drivers/psi5/psi5_api/Kconfig
```kconfig
# Copyright (c) 2026 Renesas Electronics Corporation
# SPDX-License-Identifier: Apache-2.0

config TEST_PSI5_CHANNEL
	int "PSI5 channel used by the test"
	range 0 7
	default 1
	help
	  Channel ID used by the psi5_api test suite. It must match the
	  channel node enabled in the board overlay.

source "Kconfig.zephyr"
```

## tests/drivers/psi5/psi5_rx/testcase.yaml
```yaml
common:
  tags:
    - drivers
    - psi5
  harness: ztest
  platform_allow:
    - pb_rh850u2a_144pin/r7f702302fafm-c
    - pb_rh850u2a_156pin/r7f702302fabd-c
    - pb_rh850u2a_176pin/r7f702302fafk-c
    - pb_rh850u2a_292pin/r7f702300afaba-c
    - pb_rh850u2a_292pin/r7f702300bfaba-c
    - pb_rh850u2a_292pin/r7f702300eaba-c
    - pb_rh850u2a_292pin/r7f702301afabg-c
    - pb_rh850u2a_292pin/r7f702301bfabg-c
    - pb_rh850u2a_292pin/r7f702301eabg-c
    - pb_rh850u2a_292pin/r7f702302fabb-c
    - pb_rh850u2a_373pin/r7f702300aebbb-c
    - pb_rh850u2a_373pin/r7f702300bebbb-c
    - pb_rh850u2a_373pin/r7f702300ebbb-c
    - pb_rh850u2a_373pin/r7f702301aebba-c
    - pb_rh850u2a_373pin/r7f702301bebba-c
    - pb_rh850u2a_373pin/r7f702301ebba-c
    - pb_rh850u2a_516pin/r7f702300aebbc-c
    - pb_rh850u2a_516pin/r7f702300bebbc-c
    - pb_rh850u2a_516pin/r7f702300ebbg-c
    - pb_rh850u2b_292pin/r7f70254xafabb-c
    - pb_rh850u2b_292pin/r7f70254xfabb-c
    - pb_rh850u2b_373pin/r7f70254xafaba-c
    - pb_rh850u2b_373pin/r7f70254xfaba-c
    - pb_rh850u2b_468pin/r7f70254xafabg-c
    - pb_rh850u2b_468pin/r7f70254xfabg-c
    - pb_rh850u2c_292pin/r7f702600afabb-c
  filter: dt_alias_exists("psi5-0")
tests:
  drivers.psi5.rx.sync.data_frame: {}
  drivers.psi5.rx.async.serial_message:
    extra_args:
      - EXTRA_DTC_OVERLAY_FILE="async.overlay;smc.overlay"
  drivers.psi5.rx.async.data_frame:
    extra_args:
      - EXTRA_DTC_OVERLAY_FILE="async.overlay"
```

## tests/drivers/sdhc/boards/ek_rx74n.conf
```kconfig
# Copyright (c) 2026 Renesas Electronics Corporation
# SPDX-License-Identifier: Apache-2.0

CONFIG_SPI_RENESAS_RX_SCI_B_INTERRUPT=y
CONFIG_SPI_ASYNC=y
```

## tests/drivers/spi/spi_controller_peripheral/boards/ek_rx74m.conf
```kconfig
# Copyright (c) 2026 Renesas Electronics Corporation
# SPDX-License-Identifier: Apache-2.0

CONFIG_TESTED_SPI_MODE=1
CONFIG_SPI_ASYNC=y
CONFIG_SPI_RENESAS_RX_SCI_B_INTERRUPT=y
```

## tests/drivers/watchdog/wdt_basic_reset_none/boards/rcar_ironhide_x5h_r8a78000_r52.conf
```kconfig
#
# Copyright (c) 2026 Renesas Electronics Corporation
#
# SPDX-License-Identifier: Apache-2.0
#
CONFIG_TEST_WDT_MAX_WINDOW_TIME=2000
CONFIG_TEST_WDT_SETUP_FLAGS=0
```

## tests/drivers/watchdog/wdt_variables/Kconfig
```kconfig
# Copyright (c) 2026 Renesas Electronics Corporation
# SPDX-License-Identifier: Apache-2.0

source "Kconfig.zephyr"

config TEST_WDT_NOINIT_SECTION
	string "Watchdog test's NOINIT section"
	default ".rcar_backup_buffer.test_wdt" if RCAR_BACKUP_BUFFER
	default ".noinit.test_wdt"
	help
	  Set the memory region used as NOINIT for the
	  wdt_variables test.
```

## tests/subsys/fs/littlefs/boards/ek_rx74m.conf
```kconfig
CONFIG_FS_LITTLEFS_PROG_SIZE=128
CONFIG_FS_LITTLEFS_CACHE_SIZE=128
CONFIG_HEAP_MEM_POOL_SIZE=2048
```

## tests/subsys/usb/dfu_host/testcase.yaml
```yaml
tests:
  usb.dfu_host:
    tags:
      - usb
      - dfu
    platform_allow:
      - native_sim/native
      - native_sim/native/64
      - ek_ra8m2/r7ka8m2jflcac/cm85
    integration_platforms:
      - native_sim/native
```
