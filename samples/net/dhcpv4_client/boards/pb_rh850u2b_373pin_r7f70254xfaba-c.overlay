/*
 * Copyright (c) 2026 Renesas Electronics Corporation
 *
 * SPDX-License-Identifier: Apache-2.0
 */

/* PHY reset on P10_8 */
&ioport10 {
	status = "okay";
};

&etnd0_mdio {
	status = "okay";
};

&eth_phy0 {
	status = "okay";
};

&etnd0 {
	status = "okay";
};
