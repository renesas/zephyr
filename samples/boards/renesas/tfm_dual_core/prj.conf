## CMakeLists.txt
```
# Copyright (c) 2026 Renesas Electronics Corporation
# SPDX-License-Identifier: Apache-2.0

cmake_minimum_required(VERSION 3.28.0)
find_package(Zephyr REQUIRED HINTS $ENV{ZEPHYR_BASE})
project(tfm_dual_core)

target_sources(app PRIVATE src/main.c)
```

## Kconfig.sysbuild
```
# Copyright (c) 2026 Renesas Electronics Corporation
# SPDX-License-Identifier: Apache-2.0

source "share/sysbuild/Kconfig"

config CM85_NS_BOARD
	string "Cortex-M85 non-secure board target"
	default "ek_ra8m2/r7ka8m2jflcac/cm85/ns" if "$(BOARD)/$(BOARD_QUALIFIERS)" = "ek_ra8m2/r7ka8m2jflcac/cm33/ns"
	default "ek_ra8p1/r7ka8p1kflcac/cm85/ns" if "$(BOARD)/$(BOARD_QUALIFIERS)" = "ek_ra8p1/r7ka8p1kflcac/cm33/ns"
	help
	  Board target of the Cortex-M85 non-secure image, built with TF-M.

config CM85_NS_APP_PATH
	string "Cortex-M85 non-secure application source directory"
	default "$(ZEPHYR_BASE)/samples/tfm_integration/tfm_ipc"
	help
	  Application built for the Cortex-M85 non-secure image. That image
	  starts the Cortex-M33.
```

## sysbuild.conf
```
# The Cortex-M85 TF-M image starts the Cortex-M33, not the RA second core
# launcher.
SB_CONFIG_RA_SECOND_CORE_LAUNCHER=n
```

## prj.conf
```kconfig
# The console is provided by the cm33/ns board configuration.
```

## src/main.c
```c
/*
 * Copyright (c) 2026 Renesas Electronics Corporation
 *
 * SPDX-License-Identifier: Apache-2.0
 */

#include <stdint.h>
#include <zephyr/kernel.h>
#include <zephyr/sys/printk.h>

int main(void)
{
	uint32_t count = 0U;

	printk("Hello from CM33 non-secure: %s\n", CONFIG_BOARD_TARGET);

	while (true) {
		k_msleep(1000);
		count++;
		printk("CM33 tick %u\n", count);
	}

	return 0;
}
```
