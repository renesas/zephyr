## CMakeLists.txt
```
# Copyright (c) 2026 Renesas Electronics Corporation
# SPDX-License-Identifier: Apache-2.0

cmake_minimum_required(VERSION 3.20.0)

find_package(Zephyr REQUIRED HINTS $ENV{ZEPHYR_BASE})
project(tfm_dual_core_ospi_cm85)

if(NOT CONFIG_BUILD_WITH_TFM)
  message(FATAL_ERROR "The Cortex-M85 image of this sample is a TF-M non-secure image")
endif()

FILE(GLOB app_sources src/*.c)
target_sources(app PRIVATE ${app_sources})

# Run ext_code from the external flash (XIP). No need to copy.
zephyr_code_relocate(FILES src/ext_code.c LOCATION EXTFLASH_TEXT NOCOPY)

# But still relocate (copy) the data to RAM
zephyr_code_relocate(FILES src/ext_code.c LOCATION RAM_DATA)

# sram_code instead runs entirely from SRAM after being copied there.
zephyr_code_relocate(FILES src/sram_code.c LOCATION RAM)

# Signature slot linked right after the relocated code in external flash
zephyr_linker_sources(SECTIONS ${CMAKE_CURRENT_SOURCE_DIR}/ospi_sig.ld)

set(OSPI_TEXT_SECTION .extflash_text_reloc)
set(OSPI_SIG_SECTION  .extflash_sig)
set(OSPI_SIGN_PY ${CMAKE_CURRENT_SOURCE_DIR}/../scripts/ospi_sign.py
    --mcuboot-scripts ${ZEPHYR_MCUBOOT_MODULE_DIR}/scripts)

# Key signing the OSPI code and the Cortex-M33 image, set by sysbuild.cmake
zephyr_get(OSPI_SIGN_KEY SYSBUILD GLOBAL)
if(NOT OSPI_SIGN_KEY)
  message(FATAL_ERROR "OSPI_SIGN_KEY is not set: build this sample with --sysbuild")
endif()
set_property(DIRECTORY APPEND PROPERTY CMAKE_CONFIGURE_DEPENDS ${OSPI_SIGN_KEY})

# Public key embedded in the MRAM image
execute_process(COMMAND ${PYTHON_EXECUTABLE} ${OSPI_SIGN_PY} header ${OSPI_SIGN_KEY}
                        ${PROJECT_BINARY_DIR}/ospi_pubkey.h
                COMMAND_ERROR_IS_FATAL ANY)
target_include_directories(app PRIVATE ${PROJECT_BINARY_DIR})

# zephyr.bin/.hex (the input of the TF-M signing flow) must only contain the
# MRAM image: the OSPI sections live in the OSPI window and would turn the
# binary into a ~2 GB file. They are produced by split_flash below.
set_property(TARGET bintools APPEND PROPERTY elfconvert_flag
             --remove-section=${OSPI_TEXT_SECTION} --remove-section=${OSPI_SIG_SECTION})

# The Non-secure OSPI_B driver reprograms OCTACLK (R_BSP_OctaclkUpdate).
# With secure clocks TF-M makes OCTACKCR Secure and the access faults, so
# hand only OCTACLK (CGFSAR.NONSEC17) to the Non-secure side.
set_property(TARGET zephyr_property_target APPEND PROPERTY TFM_CMAKE_OPTIONS
             -DRENESAS_RA_CGFSAR_NS_OCTACLK=ON)

find_program(SREC_CAT srec_cat REQUIRED)

dt_nodelabel(ext_flash_node NODELABEL ext_flash REQUIRED)
dt_reg_addr(ext_flash_addr PATH ${ext_flash_node})

set(ELF        $<TARGET_FILE:zephyr_final>)
set(SIGNED_ELF ${PROJECT_BINARY_DIR}/zephyr_signed.elf)
set(MERGED_HEX ${PROJECT_BINARY_DIR}/zephyr_merged.hex)

# The NS image is signed by the TF-M (BL2) flow, which produces
# zephyr_ns_signed.* and tfm_merged.hex (BL2 + TF-M S + NS)
set(TFM_MERGED_HEX ${PROJECT_BINARY_DIR}/zephyr/tfm_merged.hex)

add_custom_target(
  split_flash ALL
  DEPENDS zephyr_final
  # Sign the exact bytes the CPU will read from OSPI and patch the
  # signature into its reserved slot
  COMMAND ${CMAKE_OBJCOPY} -O binary -j ${OSPI_TEXT_SECTION} ${ELF}
          ${PROJECT_BINARY_DIR}/ospi_text.bin
  COMMAND ${PYTHON_EXECUTABLE} ${OSPI_SIGN_PY} sign ${OSPI_SIGN_KEY}
          ${PROJECT_BINARY_DIR}/ospi_text.bin ${PROJECT_BINARY_DIR}/ospi_sig.bin
  COMMAND ${CMAKE_OBJCOPY} --update-section ${OSPI_SIG_SECTION}=${PROJECT_BINARY_DIR}/ospi_sig.bin
          ${ELF} ${SIGNED_ELF}
  # OSPI data only (intermediate)
  COMMAND ${CMAKE_OBJCOPY} -j ${OSPI_TEXT_SECTION} -j ${OSPI_SIG_SECTION} -O ihex
          ${SIGNED_ELF} ${PROJECT_BINARY_DIR}/zephyr_ospi_raw.hex
  # Pad to an even length (the image is odd: the signature is 4627 bytes),
  # then byte-swap for octa-mode read order
  COMMAND ${SREC_CAT} ${PROJECT_BINARY_DIR}/zephyr_ospi_raw.hex -Intel
          -fill 0xFF -within ${PROJECT_BINARY_DIR}/zephyr_ospi_raw.hex -Intel -range-padding 2
          -byte_swap 2 -o ${PROJECT_BINARY_DIR}/zephyr_ospi.hex -Intel
  # Flash-ready OSPI binary, starting at offset 0 of the OSPI flash
  COMMAND ${SREC_CAT} ${PROJECT_BINARY_DIR}/zephyr_ospi.hex -Intel
          -offset -${ext_flash_addr} -o ${PROJECT_BINARY_DIR}/zephyr_ospi.signed.bin -Binary
  COMMAND ${SREC_CAT} ${TFM_MERGED_HEX} -Intel
          ${PROJECT_BINARY_DIR}/zephyr_ospi.hex -Intel -o ${MERGED_HEX} -Intel
  COMMENT "Signing and splitting OSPI (${OSPI_TEXT_SECTION}) image for octa-mode read order"
  VERBATIM
)
```

## prj.conf
```kconfig
CONFIG_CODE_DATA_RELOCATION=y
CONFIG_HAVE_CUSTOM_LINKER_SCRIPT=y
CONFIG_CUSTOM_LINKER_SCRIPT="linker_mram_ospi.ld"
CONFIG_COVERAGE=n
CONFIG_XIP=y
CONFIG_LOG=y
```

## boards/ek_ra8p1_r7ka8p1kflcac_cm85_ns.conf
```kconfig
# Copyright (c) 2026 Renesas Electronics Corporation
# SPDX-License-Identifier: Apache-2.0

CONFIG_FLASH=y

# The OSPI image is verified from MRAM with PSA Crypto (ML-DSA-87, FIPS 204,
# pure mode, mldsa-native) before any code in the OSPI flash is executed. The
# PSA calls are served by the TF-M crypto partition.
CONFIG_MBEDTLS=y
CONFIG_PSA_CRYPTO=y
CONFIG_PSA_WANT_ALG_SHAKE256=y
CONFIG_TF_PSA_CRYPTO_PQCP_MLDSA_ENABLED=y
CONFIG_TF_PSA_CRYPTO_PQCP_MLDSA_87_ENABLED=y
CONFIG_TF_PSA_CRYPTO_PQCP_REDUCE_RAM=y
CONFIG_MAIN_STACK_SIZE=4096

# Required by the OSPI_B driver when CODE_DATA_RELOCATION is on (MPU exec on RAM text)
CONFIG_CODE_DATA_RELOCATION_SRAM=y
```

## boards/ek_ra8p1_r7ka8p1kflcac_cm85_ns.overlay
```dts
/*
 * Copyright (c) 2026 Renesas Electronics Corporation
 * SPDX-License-Identifier: Apache-2.0
 */

/*
 * The Cortex-M85 image runs from MRAM and owns the OSPI_B controller: the
 * driver puts the MX25LW51245G in memory-mapped (XIP) mode at boot, before
 * the OSPI code and the Cortex-M33 image are verified and executed.
 */
#include "../../ospi_layout.dtsi"

&ext_flash_ctrl {
	status = "okay";
};

&ext_flash {
	status = "okay";
};
```

## src/main.c
```c
/*
 * Copyright (c) 2018 Intel Corporation.
 * Copyright (c) 2022 Carlo Caione <ccaione@baylibre.com>
 * Copyright (c) 2026 Renesas Electronics Corporation
 *
 * SPDX-License-Identifier: Apache-2.0
 */

#include <zephyr/kernel.h>
#include <zephyr/sys/printk.h>

#include "ospi_verify.h"

/*
 * This function will allow execute from sram region.  This is needed only for
 * this sample because by default all soc will disable the execute from SRAM.
 * An application that requires that the code be executed from SRAM will have
 * to configure the region appropriately in arm_mpu_regions.c.
 */
#ifdef CONFIG_ARM_MPU
#include <cmsis_core.h>
void disable_mpu_rasr_xn(void)
{
	uint32_t index;

	/*
	 * Kept the max index as 8(irrespective of soc) because the sram would
	 * most likely be set at index 2.
	 */
	for (index = 0U; index < 8; index++) {
		MPU->RNR = index;
#if defined(CONFIG_ARMV8_M_BASELINE) || defined(CONFIG_ARMV8_M_MAINLINE)
		if (MPU->RBAR & MPU_RBAR_XN_Msk) {
			MPU->RBAR ^= MPU_RBAR_XN_Msk;
		}
#else
		if (MPU->RASR & MPU_RASR_XN_Msk) {
			MPU->RASR ^= MPU_RASR_XN_Msk;
		}
#endif /* CONFIG_ARMV8_M_BASELINE || CONFIG_ARMV8_M_MAINLINE */
	}
}
#endif /* CONFIG_ARM_MPU */

extern void function_in_ext_flash(void);
extern void function_in_sram(void);

int main(void)
{
	int ret;

#ifdef CONFIG_ARM_MPU
	disable_mpu_rasr_xn();
#endif	/* CONFIG_ARM_MPU */

	printk("Address of %s function %p\n", __func__, &main);
	function_in_sram();

	/* Never execute code from the external flash unless its signature is valid */
	if (ospi_ext_code_verify() == 0) {
		printk("External flash image verified\n");
		function_in_ext_flash();
	} else {
		printk("External flash image verification FAILED, not executing it\n");
	}

	/* Never release the Cortex-M33 unless its image signature is valid */
	ret = cm33_verify_and_start();
	if (ret == 0) {
		printk("CM33 image verified, CM33 started\n");
	} else {
		printk("CM33 image verification FAILED (%d), CM33 not started\n", ret);
	}

	return 0;
}
```

## src/cm33_boot.c
```c
/*
 * Copyright (c) 2026 Renesas Electronics Corporation
 * SPDX-License-Identifier: Apache-2.0
 */

#include <errno.h>
#include <zephyr/devicetree.h>
#include <zephyr/kernel.h>
#include <zephyr/sys/printk.h>
#include <zephyr/toolchain.h>
#include <bsp_api.h>

#include "ospi_verify.h"

#define CM33_IMAGE_NODE    DT_NODELABEL(cm33_ospi_partition)
#define CM33_MANIFEST_NODE DT_NODELABEL(cm33_ospi_manifest_partition)

#define CM33_IMAGE_ADDR     DT_REG_ADDR(CM33_IMAGE_NODE)
#define CM33_IMAGE_MAX_SIZE DT_REG_SIZE(CM33_IMAGE_NODE)

/* Written by scripts/ospi_sign.py ("manifest" command) */
#define CM33_MANIFEST_MAGIC 0x33334D43U /* "CM33" */

/* Key code of CPU1ACTCSR, see R_BSP_SecondaryCoreStart() */
#define CPU1ACTCSR_KEY_CODE 0xA5U

struct cm33_manifest {
	uint32_t magic;
	uint32_t image_size;
	uint8_t sig[OSPI_SIG_LEN];
} __packed;

BUILD_ASSERT(sizeof(struct cm33_manifest) <= DT_REG_SIZE(CM33_MANIFEST_NODE),
	     "Cortex-M33 manifest does not fit its partition");
/* CPU1INITVTOR[6:0] are discarded by the hardware */
BUILD_ASSERT((CM33_IMAGE_ADDR & 0x7FU) == 0U,
	     "Cortex-M33 vector table must be 128-byte aligned");

int cm33_verify_and_start(void)
{
	const volatile struct cm33_manifest *manifest =
		(const volatile struct cm33_manifest *)DT_REG_ADDR(CM33_MANIFEST_NODE);
	const uint32_t *vector_table = (const uint32_t *)CM33_IMAGE_ADDR;
	uint32_t image_size;
	uint32_t reset_handler;
	int ret;

	if (manifest->magic != CM33_MANIFEST_MAGIC) {
		printk("CM33 manifest not found at %p\n", (const void *)manifest);
		return -ENOENT;
	}

	/* Read the size once: the signature check and the bounds check must
	 * use the same value.
	 */
	image_size = manifest->image_size;
	if ((image_size < (2U * sizeof(uint32_t))) || (image_size > CM33_IMAGE_MAX_SIZE)) {
		printk("CM33 image size %u out of range\n", image_size);
		return -EINVAL;
	}

	ret = ospi_mldsa87_verify((const uint8_t *)CM33_IMAGE_ADDR, image_size,
				  (const uint8_t *)manifest->sig);
	if (ret != 0) {
		return ret;
	}

	/* The vector table is part of the signed image; still refuse to start
	 * a reset handler that is not inside it.
	 */
	reset_handler = vector_table[1] & ~1U;
	if ((reset_handler < CM33_IMAGE_ADDR) || (reset_handler >= (CM33_IMAGE_ADDR + image_size))) {
		printk("CM33 reset handler 0x%08x outside the image\n", reset_handler);
		return -EINVAL;
	}

	R_CPU_CTRL->CPU1INITVTOR = CM33_IMAGE_ADDR;

	/* A debugger may already have activated CPU1 with CPU1WAITCR set */
	R_CPU_CTRL->CPU1WAITCR = 0U;

	R_CPU_CTRL->CPU1ACTCSR = (CPU1ACTCSR_KEY_CODE << R_CPU_CTRL_CPU1ACTCSR_KEY_Pos) |
				 R_CPU_CTRL_CPU1ACTCSR_ACTREQ_Msk;

	return 0;
}
```

## src/ospi_verify.c
```c
/*
 * Copyright (c) 2026 Renesas Electronics Corporation
 * SPDX-License-Identifier: Apache-2.0
 */

#include <errno.h>
#include <zephyr/kernel.h>
#include <zephyr/sys/printk.h>
#include <psa/crypto.h>

#include "ospi_pubkey.h"
#include "ospi_verify.h"

/* Signature slot of the Cortex-M85 OSPI code, patched after link by scripts/ospi_sign.py */
const uint8_t ospi_sig_slot[OSPI_SIG_LEN] __attribute__((section(".extflash_sig"), used));

/* Provided by the linker script */
extern const uint8_t __extflash_text_reloc_start[];
extern const uint8_t __extflash_text_reloc_size[];
extern const uint8_t __extflash_sig_start[];

int ospi_mldsa87_verify(const uint8_t *msg, size_t len, const uint8_t *sig)
{
	psa_key_attributes_t attr = PSA_KEY_ATTRIBUTES_INIT;
	psa_key_id_t key = PSA_KEY_ID_NULL;
	psa_status_t st;
	int ret = -EACCES;

	st = psa_crypto_init();
	if (st != PSA_SUCCESS) {
		printk("psa_crypto_init failed (%d)\n", (int)st);
		return -EIO;
	}

	psa_set_key_type(&attr, PSA_KEY_TYPE_ML_DSA_PUBLIC_KEY);
	/* For ML-DSA the "key bits" value is the parameter set (87), not the key size */
	psa_set_key_bits(&attr, 87);
	psa_set_key_usage_flags(&attr, PSA_KEY_USAGE_VERIFY_MESSAGE);
	psa_set_key_algorithm(&attr, PSA_ALG_DETERMINISTIC_ML_DSA);

	st = psa_import_key(&attr, ospi_pubkey, sizeof(ospi_pubkey), &key);
	if (st != PSA_SUCCESS) {
		printk("key import failed (%d)\n", (int)st);
		return -EIO;
	}

	/* ML-DSA runs in pure mode over the whole message. The OSPI window is
	 * read through memory-mapped mode, so this is the exact byte stream
	 * the CPU will fetch.
	 */
	st = psa_verify_message(key, PSA_ALG_DETERMINISTIC_ML_DSA, msg, len, sig, OSPI_SIG_LEN);
	if (st == PSA_SUCCESS) {
		ret = 0;
	} else {
		printk("signature invalid (%d)\n", (int)st);
	}

	psa_destroy_key(key);
	return ret;
}

int ospi_ext_code_verify(void)
{
	return ospi_mldsa87_verify(__extflash_text_reloc_start, (size_t)__extflash_text_reloc_size,
				   __extflash_sig_start);
}
```

## src/ospi_verify.h
```c
/*
 * Copyright (c) 2026 Renesas Electronics Corporation
 * SPDX-License-Identifier: Apache-2.0
 */

#ifndef OSPI_VERIFY_H_
#define OSPI_VERIFY_H_

#include <stddef.h>
#include <stdint.h>

/* ML-DSA-87 signature size (FIPS 204) */
#define OSPI_SIG_LEN 4627

/* Verify an ML-DSA-87 signature against the public key built into this image */
int ospi_mldsa87_verify(const uint8_t *msg, size_t len, const uint8_t *sig);

/* Verify the Cortex-M85 code in OSPI flash */
int ospi_ext_code_verify(void);

/* Verify the Cortex-M33 image in OSPI flash and start the Cortex-M33 from it */
int cm33_verify_and_start(void);

#endif /* OSPI_VERIFY_H_ */
```
