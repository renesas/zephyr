/*
 * Copyright (c) 2026 Renesas Electronics Corporation
 *
 * SPDX-License-Identifier: Apache-2.0
 */

#include <zephyr/dt-bindings/adc/adc.h>

/ {
	aliases {
		adc0 = &adcj0;
	};
};

&adcj0 {
	status = "okay";
	vref-mv = <3300>;
	channel-available-mask = <0x1>;

	renesas,unit = <0>;
	renesas,scan-group = <0>;
	renesas,start-virtual-channel = <0>;
	renesas,end-virtual-channel = <0>;
	renesas,data-format = "12-bit";

	channel@0 {
		reg = <0>;
		zephyr,gain = "ADC_GAIN_1";
		zephyr,reference = "ADC_REF_VDD_1";
		zephyr,acquisition-time = <ADC_ACQ_TIME_DEFAULT>;
		zephyr,resolution = <12>;
		zephyr,vref-mv = <3300>;

		renesas,virtual-channel = <0>;
		renesas,physical-channel = <4>; /* ADCJ0 AN10 = ADCJ_PHYSICAL_CHANNEL_AN10 */
	};
};
