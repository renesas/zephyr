
/*
 * Copyright (c) 2026 Renesas Electronics Corporation
 *
 * SPDX-License-Identifier: Apache-2.0
 */

&tmr01 {
	renesas,prescaler = <13>;
	status = "okay";

	counter0: counter {
		status = "okay";
	};
};

