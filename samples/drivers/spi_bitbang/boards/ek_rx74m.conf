## samples/net/dhcpv4_client/boards/rcar_ironhide_x5h_r8a78000_r52.conf
```kconfig
CONFIG_NET_L2_ETHERNET=y
CONFIG_ETH_RENESAS_RCARSOC_TSNES_ENABLE_DMA_CACHE_OPS=y
```

## samples/net/dhcpv4_client/sample.yaml
```yaml
sample:
  name: DHCP Client
tests:
  sample.net.dhcpv4_client:
    harness: net
    depends_on: netif
    tags:
      - net
      - http
  sample.net.dhcpv4_client.rcar_ironhide_x5h:
    build_only: true
    platform_allow: rcar_ironhide_x5h/r8a78000/r52
  sample.net.dhcpv4_client.rcar_ironhide_x5h.port4:
    build_only: true
    platform_allow: rcar_ironhide_x5h/r8a78000/r52
    required_snippets:
      - rcar-x5h-eth-port4
  sample.net.dhcpv4_client.rcar_ironhide_x5h.tsnes4:
    build_only: true
    platform_allow: rcar_ironhide_x5h/r8a78000/r52
    extra_args:
      - EXTRA_DTC_OVERLAY_FILE=boards/rcar_ironhide_x5h_r8a78000_r52_tsnes4.overlay
      - EXTRA_CONF_FILE=boards/rcar_ironhide_x5h_r8a78000_r52_tsnes4.conf
```

## samples/net/ethernet/gptp/boards/rcar_ironhide_x5h_r8a78000_r52.conf
```kconfig
# Copyright (c) 2026 Renesas Electronics Corporation
# SPDX-License-Identifier: Apache-2.0

CONFIG_NET_L2_ETHERNET=y
CONFIG_NET_STATISTICS=y

CONFIG_NET_TX_STACK_SIZE=8192
CONFIG_NET_RX_STACK_SIZE=8192
CONFIG_NET_MGMT_EVENT_STACK_SIZE=8192
```

## samples/net/ethernet/gptp/sample.yaml
```yaml
common:
  harness: net
  tags:
    - net
    - gptp
sample:
  description: Test gPTP functionality
  name: gPTP sample app
tests:
  sample.net.gptp:
    platform_allow:
      - frdm_k64f
      - sam_e70_xplained/same70q21
      - native_sim
      - native_sim/native/64
      - nucleo_f767zi
      - nucleo_h743zi
      - nucleo_h753zi
      - nucleo_h745zi_q/stm32h745xx/m7
    depends_on: eth
    integration_platforms:
      - frdm_k64f
  sample.net.gptp.rcar_ironhide_x5h:
    build_only: true
    platform_allow: rcar_ironhide_x5h/r8a78000/r52
  sample.net.gptp.rcar_ironhide_x5h.tsnes4:
    build_only: true
    platform_allow: rcar_ironhide_x5h/r8a78000/r52
    extra_args:
      - EXTRA_DTC_OVERLAY_FILE=boards/rcar_ironhide_x5h_r8a78000_r52_tsnes4.overlay
```

## samples/net/zperf/boards/rcar_ironhide_x5h_r8a7800_r52.conf
```kconfig
CONFIG_NET_L2_ETHERNET=y
CONFIG_NET_STATISTICS=y
CONFIG_NET_CONFIG_MY_IPV4_ADDR="10.239.136.215"
CONFIG_NET_CONFIG_PEER_IPV4_ADDR="10.239.136.1"

CONFIG_NET_PKT_RX_COUNT=512
CONFIG_NET_PKT_TX_COUNT=512
CONFIG_NET_BUF_RX_COUNT=512
CONFIG_NET_BUF_TX_COUNT=512
CONFIG_NET_BUF_DATA_SIZE=1024

CONFIG_NET_TX_STACK_SIZE=8192
CONFIG_NET_RX_STACK_SIZE=8192
CONFIG_NET_TCP_WORKQ_STACK_SIZE=8192
CONFIG_NET_MGMT_EVENT_STACK_SIZE=8192
CONFIG_NET_SOCKETS_SERVICE=y
CONFIG_NET_SOCKETS_SERVICE_STACK_SIZE=8192
```

## samples/net/zperf/boards/y_ask_rh850u2c_r7f702606afabb-c.conf
```kconfig
# Copyright (c) 2026 Renesas Electronics Corporation
# SPDX-License-Identifier: Apache-2.0

CONFIG_NET_DHCPV4=y
CONFIG_NET_CONFIG_MY_IPV4_ADDR=""
CONFIG_NET_CONFIG_PEER_IPV4_ADDR=""
CONFIG_NET_IP_ADDR_CHECK=n
CONFIG_NET_STATISTICS=n
CONFIG_NET_IPV6=n
CONFIG_NET_PKT_RX_COUNT=40
CONFIG_NET_PKT_TX_COUNT=40
CONFIG_NET_BUF_RX_COUNT=48
CONFIG_NET_BUF_TX_COUNT=32
CONFIG_NET_BUF_DATA_SIZE=1536
CONFIG_NET_ZPERF_MAX_PACKET_SIZE=8760
CONFIG_NET_SOCKETS_SERVICE_STACK_SIZE=2048

CONFIG_SHELL_STACK_SIZE=3072

CONFIG_NET_TC_RX_COUNT=0
CONFIG_ETH_RENESAS_RH850_ETNF_RX_THREAD_STACK_SIZE=2048
CONFIG_ETH_RENESAS_RH850_ETND_RX_THREAD_STACK_SIZE=2048

CONFIG_NET_TC_TX_COUNT=0
CONFIG_NET_TCP_MAX_SEND_WINDOW_SIZE=30000

# The POSIX API does not build with the IAR RH850 C library
CONFIG_POSIX_API=n
```

## samples/subsys/fs/littlefs/boards/ek_ra8m1.conf
```kconfig
# Copyright (c) 2026 Renesas Electronics Corporation
# SPDX-License-Identifier: Apache-2.0

CONFIG_FS_LITTLEFS_FC_HEAP_SIZE=1024
```

## soc/renesas/rcar/common/backup_buffer/Kconfig
```kconfig
# Copyright (c) 2026 Renesas Electronics Corporation
# SPDX-License-Identifier: Apache-2.0

config RCAR_BACKUP_BUFFER
	bool "R-Car Backup Buffer"
	default y
	depends on DT_HAS_RENESAS_RCAR_BACKUP_BUFFER_ENABLED
	help
	  Enable support for the Renesas R-Car backup buffer.

config RCAR_BACKUP_BUFFER_INIT_PRIORITY
	int "R-Car Backup Buffer init priority"
	default APPLICATION_INIT_PRIORITY
	depends on RCAR_BACKUP_BUFFER
	help
	  R-Car backup buffer device initialization priority.
```

## soc/renesas/rcar/rcar_gen5/Kconfig
```kconfig
# Copyright (c) 2026 Renesas Electronics Corporation
# SPDX-License-Identifier: Apache-2.0

DT_CHOSEN_Z_ITCM := zephyr,itcm

config SOC_R8A78000_R52
	select ARM
	select CPU_CORTEX_R52
	select GIC_SINGLE_SECURITY_STATE
	select CPU_HAS_DCLS
	select CPU_HAS_ARM_MPU
	select HAS_RENESAS_RCARSOC_DRV
	select SOC_EARLY_INIT_HOOK
	select SOC_RESET_HOOK

config RCAR_BACKUP_BUFFER
	bool "R-Car Backup Buffer"
	default y
	depends on DT_HAS_RENESAS_RCAR_BACKUP_BUFFER_ENABLED
	help
	  Enable support for the Renesas R-Car backup buffer.

config RCAR_BACKUP_BUFFER_INIT_PRIORITY
	int "R-Car Backup Buffer init priority"
	default APPLICATION_INIT_PRIORITY
	depends on RCAR_BACKUP_BUFFER
	help
	  R-Car backup buffer device initialization priority.

config RCAR_GEN5_R52_ITCM_NET_HOT_PATH
	bool "Run the network per-packet path from ITCM"
	depends on SOC_R8A78000_R52
	depends on $(dt_chosen_enabled,$(DT_CHOSEN_Z_ITCM))
	depends on NETWORKING
	depends on !XIP
	help
	  Link the functions of the network per-packet path (sockets, UDP,
	  TCP, IPv4, Ethernet L2, R-Switch 3 GWCA driver, net_pkt/net_buf,
	  scheduler and memcpy) into the ITCM. The path is larger than the
	  32 KB L1 instruction cache, and running it from the TCM removes the
	  instruction cache misses (about 80 CPU cycles each) on every frame.
	  The list is in r52/itcm.ld; functions that are not built are
	  ignored. Not for XIP images: their boot code runs memset() and
	  memcpy() before arch_data_copy() has loaded the ITCM.

config RCAR_GEN5_R52_FAST_MEMCPY
	bool "Optimized memcpy for the Cortex-R52"
	depends on SOC_R8A78000_R52
	depends on PICOLIBC
	help
	  Replace the C library memcpy() with the Armv8-R routine of
	  hal_renesas. picolibc only builds its optimized ARM memcpy for the
	  A profile, so the R52 otherwise gets the generic C version. The
	  routine moves 32 bytes per iteration with LDM/STM, and is placed in
	  the ITCM when one is chosen and the image is not XIP.

config RCAR_GEN5_R52_FAST_MEMCPY_NEON
	bool "Use Advanced SIMD in the optimized memcpy"
	depends on RCAR_GEN5_R52_FAST_MEMCPY
	depends on FPU_SHARING
	help
	  Move 32 bytes per iteration with VLD1/VST1 of d0-d3 instead of
	  LDM/STM (the X5H realtime core implements Advanced SIMD). memcpy()
	  runs in every thread and ISR, so this needs FPU sharing: each thread
	  that copies then saves and restores its FP registers on context
	  switches, and an ISR that copies takes an undefined instruction
	  exception to save the FP registers it interrupted.
```

## soc/renesas/rcar/rcar_gen5/Kconfig.defconfig
```kconfig
# Copyright (c) 2026 Renesas Electronics Corporation
# SPDX-License-Identifier: Apache-2.0

if SOC_SERIES_RCAR_GEN5

rsource "Kconfig.defconfig.r8a78000"

endif # SOC_SERIES_RCAR_GEN5
```

## soc/renesas/rh850/common/pic/Kconfig
```kconfig
# Copyright (c) 2026 Renesas Electronics Corporation
# SPDX-License-Identifier: Apache-2.0

# Renesas RH850 Peripheral Interconnect Controller config options (included by
# soc/renesas/rh850/common_fsp/Kconfig, inside if SOC_FAMILY_RENESAS_RH850)

menuconfig RENESAS_PIC
	bool "Renesas Peripheral Interconnect Controller (PIC) drivers"
	default y if DT_HAS_RENESAS_RH850_PIC_ENABLED
	help
	  Enable support for the Peripheral Interconnect Controller (PIC). Enabled
	  automatically when a renesas,rh850-pic node is enabled in devicetree.

if RENESAS_PIC

module = RENESAS_PIC
module-str = pic
source "subsys/logging/Kconfig.template.log_config"

config RENESAS_PIC_INIT_PRIORITY
	int "PIC driver init priority"
	default KERNEL_INIT_PRIORITY_DEVICE
	help
	  PIC driver initialization priority.

# zephyr-keep-sorted-start
rsource "Kconfig.renesas_rh850"
# zephyr-keep-sorted-stop

endif # RENESAS_PIC
```

## soc/renesas/rh850/common/pic/Kconfig.renesas_rh850
```kconfig
# Copyright (c) 2026 Renesas Electronics Corporation
# SPDX-License-Identifier: Apache-2.0

config RENESAS_RH850_PIC
	bool "Renesas RH850 PIC driver"
	default y
	depends on DT_HAS_RENESAS_RH850_PIC_ENABLED
	select USE_RH850_FSP_PIC
	help
	  Enable the Renesas RH850 PIC driver. The settings come from the
	  renesas,rh850-pic devicetree node.
```

## soc/renesas/rh850/rh850u2a/Kconfig.soc
```kconfig
# SPDX-License-Identifier: Apache-2.0

config SOC_SERIES_RH850U2A
	bool
	select SOC_FAMILY_RENESAS_RH850
	help
	  Renesas RH850U2A series

config SOC_R7F702300AEBBC_C
	bool
	select SOC_SERIES_RH850U2A

config SOC_R7F702300BEBBC_C
	bool
	select SOC_SERIES_RH850U2A

config SOC_R7F702300EBBG_C
	bool
	select SOC_SERIES_RH850U2A

config SOC_R7F702300BEBBB_C
	bool
	select SOC_SERIES_RH850U2A

config SOC_R7F702300EBBB_C
	bool
	select SOC_SERIES_RH850U2A

config SOC_R7F702300AEBBB_C
	bool
	select SOC_SERIES_RH850U2A

config SOC_R7F702300BFABA_C
	bool
	select SOC_SERIES_RH850U2A

config SOC_R7F702300EABA_C
	bool
	select SOC_SERIES_RH850U2A

config SOC_R7F702300AFABA_C
	bool
	select SOC_SERIES_RH850U2A

config SOC_R7F702301BEBBA_C
	bool
	select SOC_SERIES_RH850U2A

config SOC_R7F702301EBBA_C
	bool
	select SOC_SERIES_RH850U2A

config SOC_R7F702301AEBBA_C
	bool
	select SOC_SERIES_RH850U2A

config SOC_R7F702301BFABG_C
	bool
	select SOC_SERIES_RH850U2A

config SOC_R7F702301EABG_C
	bool
	select SOC_SERIES_RH850U2A

config SOC_R7F702301AFABG_C
	bool
	select SOC_SERIES_RH850U2A

config SOC_R7F702302FABB_C
	bool
	select SOC_SERIES_RH850U2A

config SOC_R7F702302FAFK_C
	bool
	select SOC_SERIES_RH850U2A

config SOC_R7F702302FABD_C
	bool
	select SOC_SERIES_RH850U2A

config SOC_R7F702302FAFM_C
	bool
	select SOC_SERIES_RH850U2A

config SOC_SERIES
	default "rh850u2a" if SOC_SERIES_RH850U2A

config SOC
	default "r7f702300aebbc-c" if SOC_R7F702300AEBBC_C
	default "r7f702300bebbc-c" if SOC_R7F702300BEBBC_C
	default "r7f702300ebbg-c" if SOC_R7F702300EBBG_C
	default "r7f702300bebbb-c" if SOC_R7F702300BEBBB_C
	default "r7f702300ebbb-c" if SOC_R7F702300EBBB_C
	default "r7f702300aebbb-c" if SOC_R7F702300AEBBB_C
	default "r7f702300bfaba-c" if SOC_R7F702300BFABA_C
	default "r7f702300eaba-c" if SOC_R7F702300EABA_C
	default "r7f702300afaba-c" if SOC_R7F702300AFABA_C
	default "r7f702301bebba-c" if SOC_R7F702301BEBBA_C
	default "r7f702301ebba-c" if SOC_R7F702301EBBA_C
	default "r7f702301aebba-c" if SOC_R7F702301AEBBA_C
	default "r7f702301bfabg-c" if SOC_R7F702301BFABG_C
	default "r7f702301eabg-c" if SOC_R7F702301EABG_C
	default "r7f702301afabg-c" if SOC_R7F702301AFABG_C
	default "r7f702302fabb-c" if SOC_R7F702302FABB_C
	default "r7f702302fafk-c" if SOC_R7F702302FAFK_C
	default "r7f702302fabd-c" if SOC_R7F702302FABD_C
	default "r7f702302fafm-c" if SOC_R7F702302FAFM_C
```

## soc/renesas/rh850/rh850u2c/Kconfig.soc
```kconfig
# SPDX-License-Identifier: Apache-2.0

config SOC_SERIES_RH850U2C
	bool
	select SOC_FAMILY_RENESAS_RH850
	help
	  Renesas RH850U2C series

config SOC_R7F702600AFABB_C
	bool
	select SOC_SERIES_RH850U2C

config SOC_R7F702606AFABB_C
	bool
	select SOC_SERIES_RH850U2C

config SOC_R7F702616AFABB_C
	bool
	select SOC_SERIES_RH850U2C

config SOC_R7F702613AFABB_C
	bool
	select SOC_SERIES_RH850U2C

config SOC_R7F702606AFAFB_C
	bool
	select SOC_SERIES_RH850U2C

config SOC_R7F702606AFAFM_C
	bool
	select SOC_SERIES_RH850U2C

config SOC_R7F702616AFAFM_C
	bool
	select SOC_SERIES_RH850U2C

config SOC_R7F702616AFAFB_C
	bool
	select SOC_SERIES_RH850U2C

config SOC_R7F702614AFAFM_C
	bool
	select SOC_SERIES_RH850U2C

config SOC_R7F702614AFAFB_C
	bool
	select SOC_SERIES_RH850U2C

config SOC_R7F702606AFAFD_C
	bool
	select SOC_SERIES_RH850U2C

config SOC_R7F702616AFAFD_C
	bool
	select SOC_SERIES_RH850U2C

config SOC_R7F702613AFAFD_C
	bool
	select SOC_SERIES_RH850U2C

config SOC_R7F702615AFAFM_C
	bool
	select SOC_SERIES_RH850U2C

config SOC_R7F702615AFAFB_C
	bool
	select SOC_SERIES_RH850U2C

config SOC_R7F702608AFAFD_C
	bool
	select SOC_SERIES_RH850U2C

config SOC_SERIES
	default "rh850u2c" if SOC_SERIES_RH850U2C

config SOC
	default "r7f702600afabb-c"   if SOC_R7F702600AFABB_C
	default "r7f702606afabb-c"   if SOC_R7F702606AFABB_C
	default "r7f702616afabb-c"   if SOC_R7F702616AFABB_C
	default "r7f702613afabb-c"   if SOC_R7F702613AFABB_C
	default "r7f702606afafb-c"   if SOC_R7F702606AFAFB_C
	default "r7f702606afafm-c"   if SOC_R7F702606AFAFM_C
	default "r7f702616afafm-c"   if SOC_R7F702616AFAFM_C
	default "r7f702616afafb-c"   if SOC_R7F702616AFAFB_C
	default "r7f702614afafm-c"   if SOC_R7F702614AFAFM_C
	default "r7f702614afafb-c"   if SOC_R7F702614AFAFB_C
	default "r7f702606afafd-c"   if SOC_R7F702606AFAFD_C
	default "r7f702616afafd-c"   if SOC_R7F702616AFAFD_C
	default "r7f702613afafd-c"   if SOC_R7F702613AFAFD_C
	default "r7f702615afafm-c"   if SOC_R7F702615AFAFM_C
	default "r7f702615afafb-c"   if SOC_R7F702615AFAFB_C
	default "r7f702608afafd-c"   if SOC_R7F702608AFAFD_C
```

## soc/renesas/rx/rx74m/Kconfig
```kconfig
# Copyright (c) 2025 Renesas Electronics Corporation
# SPDX-License-Identifier: Apache-2.0

config SOC_SERIES_RX74M
	select RX
	select CPU_RXV3E
	select CPU_HAS_FPU
	select CPU_HAS_FPU_DOUBLE_PRECISION
	select XIP
	select CLOCK_CONTROL_RENESAS_RX_CGC if CLOCK_CONTROL
	select HAS_RENESAS_RX_FSP
	select SOC_EARLY_INIT_HOOK
	select CLOCK_CONTROL
	select CLOCK_CONTROL_FIXED_RATE_CLOCK
	select CPU_HAS_MPU
	select CPU_HAS_RX_MPU
	select RX_MPU

config SOC_RX74M_SKIP_OSPI_CLOCK_SETUP
	bool "Skip OSPI clock frequency configuration in system initialization"
	default n
	help
	  With this option, the OSPI clock frequency is not set during system
	  initialization. This is required when the OSPI flash is used as the
	  boot source
```

## soc/renesas/rx/rx74n/Kconfig
```kconfig
# Copyright (c) 2026 Renesas Electronics Corporation
# SPDX-License-Identifier: Apache-2.0

config SOC_SERIES_RX74N
	select RX
	select CPU_RXV3E
	select CPU_HAS_FPU
	select CPU_HAS_FPU_DOUBLE_PRECISION
	select XIP
	select CLOCK_CONTROL_RENESAS_RX_CGC if CLOCK_CONTROL
	select HAS_RENESAS_RX_FSP
	select SOC_EARLY_INIT_HOOK
	select SOC_PREP_HOOK
	select CLOCK_CONTROL
	select CLOCK_CONTROL_FIXED_RATE_CLOCK
	select CPU_HAS_MPU
	select CPU_HAS_RX_MPU
	select RX_MPU

config RX74N_LRAM0_NS
	bool "Use LRAM0 via its non-secure CPU alias (0x00000000)"
	default n
	help
	  When enabled, CPSCU.LRMSABAR0 is cleared in soc_prep_hook() so that
	  the entire LRAM0 is accessible through the non-secure CPU alias at
	  0x00000000 before arch_data_copy() copies the .itcm section there.

	  Use this when a pre-built binary library must execute from the fixed
	  address 0x00000000.

	  The board DTS (or an application overlay) must also redirect the
	  zephyr,itcm chosen node to the itcm_ns alias:
	    &itcm   { status = "disabled"; };
	    &itcm_ns { status = "okay"; };
	    / { chosen { zephyr,itcm = &itcm_ns; }; };

	  Enabling both itcm and itcm_ns simultaneously is caught by a
	  BUILD_ASSERT in soc.c — they alias the same physical LRAM0.

config SOC_RX74N_SKIP_OSPI_CLOCK_SETUP
	bool "Skip OSPI clock frequency configuration in system initialization"
	default n
	help
	  With this option, the OSPI clock frequency is not set during system
	  initialization. This is required when the OSPI flash is used as the
	  boot source
```

## subsys/usb/host/class/Kconfig
```kconfig
# SPDX-FileCopyrightText: Copyright Nordic Semiconductor ASA
# SPDX-FileCopyrightText: Copyright 2025 - 2026 NXP
# SPDX-FileCopyrightText: Copyright 2026 Renesas, Embedd
# SPDX-License-Identifier: Apache-2.0

rsource "Kconfig.cdc_ecm"
rsource "Kconfig.uvc"
rsource "Kconfig.hub"
rsource "Kconfig.cdc_acm"
rsource "hid/Kconfig"
```
