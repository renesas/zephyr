/*
 * Copyright 2025 - 2026 NXP
 * SPDX-License-Identifier: Apache-2.0
 */

/ {
	cdc_ecm_eth0: cdc_ecm_eth0 {
		compatible = "zephyr,cdc-ecm-ethernet";
		remote-mac-address = "00005EAABBCC";
		status = "okay";
	};
};
