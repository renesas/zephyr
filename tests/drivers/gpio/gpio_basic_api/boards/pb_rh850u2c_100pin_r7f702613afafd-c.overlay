/*
 * Copyright (c) 2026 Renesas Electronics Corporation
 * SPDX-License-Identifier: Apache-2.0
 */

/ {
	resources {
		compatible = "test-gpio-basic-api";
		out-gpios = <&ioport6 11 GPIO_ACTIVE_HIGH>;
		in-gpios = <&ioport6 10 GPIO_ACTIVE_HIGH>;
	};
};

&ioport6 {
	irqs = <&irq23 10>, <&irq26 11>;
	status = "okay";
};
