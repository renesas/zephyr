/*
 * Copyright (c) 2026 Renesas Electronics Corporation
 * SPDX-License-Identifier: Apache-2.0
 */

/ {
	resources {
		compatible = "test-gpio-basic-api";
		out-gpios = <&ioport34 1 GPIO_ACTIVE_HIGH>;
		in-gpios = <&ioport34 0 GPIO_ACTIVE_HIGH>;
	};
};

&ioport34 {
	irqs = <&irq35 0>, <&irq36 1>;
	status = "okay";
};
