/*
 * Copyright (c) 2026 Renesas Electronics Corporation
 * SPDX-License-Identifier: Apache-2.0
 */

/ {
	resources {
		compatible = "test-gpio-basic-api";
		out-gpios = <&ioport2 5 GPIO_ACTIVE_HIGH>;
		in-gpios = <&ioport2 4 GPIO_ACTIVE_HIGH>;
	};
};

&ioport2 {
	irqs = <&irq35 4>, <&irq17 5>;
	status = "okay";
};
