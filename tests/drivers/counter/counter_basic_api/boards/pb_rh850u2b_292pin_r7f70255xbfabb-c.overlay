/*
 * Copyright (c) 2026 Renesas Electronics Corporation
 *
 * SPDX-License-Identifier: Apache-2.0
 */

&ostm1 {
	status = "okay";

	counter {
		status = "okay";
	};
};

&ostm2 {
	status = "okay";

	counter {
		status = "okay";
	};
};
