/*
* Copyright (c) 2026 Renesas Electronics Corporation
*
* SPDX-License-Identifier: Apache-2.0
*/

/delete-node/ &memc;

&xspi1 {
	status = "okay";
	ranges = <0x00000000 0x40000000 DT_SIZE_M(512)>;

	memc: s70kl1283dpbhv020: memory@10000000 {
		compatible = "renesas,rx-xspi-psram";
		reg = <0x10000000 DT_SIZE_M(16)>;
		size = <DT_SIZE_M(16)>; /* 16 Megabytes = 128 Mbit */
		cs = <0>;
		ospi-max-frequency = <DT_FREQ_M(200)>;
		command-bytes = <2>;
		address-bytes = <4>;
		read-command = <0xeeee>;
		write-command = <0xdede>;
		write-enable-command = <0x06>;
		read-dummy-cycles = <14>;
		write-dummy-cycles = <14>;
		status = "okay";
	};
};
