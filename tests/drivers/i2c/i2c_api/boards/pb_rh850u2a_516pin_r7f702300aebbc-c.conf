## tests/drivers/spi/spi_controller_peripheral/boards/pb_rh850u2c_292pin_r7f702600afabb-c.conf
```kconfig
CONFIG_SPI_RENESAS_RH850_INTERRUPT=y
CONFIG_SPI_ASYNC=y
CONFIG_TESTED_SPI_MODE=0
```

## tests/drivers/spi/spi_loopback/boards/pb_rh850u2c_292pin_r7f702600afabb-c.conf
```kconfig
CONFIG_SPI_RENESAS_RH850_INTERRUPT=y
CONFIG_SPI_LOOPBACK_MODE_LOOP=y
CONFIG_SPI_ASYNC=y
```

## tests/misc/renesas_dtc/testcase.yaml
```yaml
common:
  platform_exclude:
    - rsk_rx130_512kb
  tags:
    - drivers
    - dtc
```
