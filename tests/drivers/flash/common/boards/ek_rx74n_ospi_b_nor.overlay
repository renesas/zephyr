/*
 * Copyright (c) 2025 Renesas Electronics Corporation
 * SPDX-License-Identifier: Apache-2.0
 */

&mx25lw51245g_ctrl {
	status = "okay";
};

&mx25lw51245g {
	status = "okay";

	partitions {
		#address-cells = <1>;
		#size-cells = <1>;

		storage_partition: partition@0 {
			compatible = "zephyr,mapped-partition";
			label = "nor";
			reg = <0x00000000 DT_SIZE_M(1)>;
		};
	};
};
