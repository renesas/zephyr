## arch/rh850/Kconfig
```kconfig
# Renesas RH850 architecture configuration options

# Copyright (c) 2026 Renesas Electronics Corporation
# SPDX-License-Identifier: Apache-2.0

menu "Renesas RH850 Options"
	depends on RH850

config ARCH
	string
	default "rh850"

config HAS_EXCEPT_VECTOR_TABLE
	bool
	help
	  Set if the processor has the exception vector table.

config CPU_G4MH
	bool
	help
	  Set if the processor supports the Renesas G4MH instruction set.

config CPU_HAS_FXU
	bool
	help
	  This option is enabled when the CPU has hardware Extended
	  floating-point operation unit.

config FXU
	bool "Extended floating-point operation unit (FXU)"
	depends on CPU_HAS_FXU
	help
	  This option enables the hardware Extended floating-point operation unit (FPU),
	  in order to support using the floating point registers and instructions.

	  The execution of one extended floating-point operation
	  instruction allows the execution of four single-precision
	  floating-point (vector data) operations.
	  This is an operation generally referred to as an
	  SIMD(Single Instruction Multiple Data) operation.

	  Note: The use of FXU instructions depends on compiler support.
	  Ensure your compiler is configured to generate FXU instructions when
	  targeting this feature.

config XIP
	default y

config NUM_IRQ_PRIO_LEVELS
	int "Number of supported interrupt priority levels"
	range 1 16
	default 16
	help
	  Interrupt priorities available will be 0 to NUM_IRQ_PRIO_LEVELS-1. The
	  minimum value is 1. The BSP must provide a valid default for proper
	  operation.

config NUM_IRQS
	int
	default 1024

config GEN_ISR_TABLES
	default y

config GEN_SW_ISR_TABLE
	default y

config GEN_IRQ_VECTOR_TABLE
	default y

config GEN_IRQ_START_VECTOR
	default 0

config DYNAMIC_INTERRUPTS
	default y

config ARCH_IRQ_VECTOR_TABLE_ALIGN
	default 512

config MAIN_STACK_SIZE
	default 4096

config INITIALIZATION_STACK_SIZE
	int "Initialization stack size (in bytes)"
	default 512
	help
	  Stack size for initialization process of kernel (in bytes)

endmenu
```

## boards/renesas/ek_ra8d1/Kconfig.defconfig
```kconfig
# Copyright (c) 2024-2025 Renesas Electronics Corporation
# SPDX-License-Identifier: Apache-2.0

if BOARD_EK_RA8D1

if NETWORKING

config NET_L2_ETHERNET
	default y

endif # NETWORKING

if DISPLAY

if SHIELD_RTKMIPILCDB00000BE

config MEMC
	default y

config RENESAS_RA_GLCDC_FRAME_BUFFER_SECTION
	default ".sdram"
	depends on RENESAS_RA_GLCDC

endif # SHIELD_RTKMIPILCDB00000BE

endif # DISPLAY

if LVGL

config LV_Z_VDB_CUSTOM_SECTION
	default y

endif # LVGL

config SYS_CLOCK_HW_CYCLES_PER_SEC
	default 32768 if ULPT_RENESAS_RA
	default 480000000

endif # BOARD_EK_RA8D1
```

## boards/renesas/mck_ra8t1/Kconfig.defconfig
```kconfig
# Copyright (c) 2024 Renesas Electronics Corporation
# SPDX-License-Identifier: Apache-2.0

config SYS_CLOCK_HW_CYCLES_PER_SEC
	default 32768 if ULPT_RENESAS_RA
	default 480000000
```

## boards/renesas/pb_rh850u2a_516pin/Kconfig.pb_rh850u2a_516pin
```kconfig
# Copyright (c) 2026 Renesas Electronics Corporation
# SPDX-License-Identifier: Apache-2.0

config BOARD_PB_RH850U2A_516PIN
	select SOC_R7F702300AEBBC_C if BOARD_PB_RH850U2A_516PIN_R7F702300AEBBC_C
	select SOC_R7F702300BEBBC_C if BOARD_PB_RH850U2A_516PIN_R7F702300BEBBC_C
	select SOC_R7F702300EBBG_C if BOARD_PB_RH850U2A_516PIN_R7F702300EBBG_C
```

## boards/renesas/pb_rh850u2a_516pin/board.yml
```yaml
board:
  name: pb_rh850u2a_516pin
  full_name: RH850/U2A 516pin PiggyBack Board
  vendor: renesas
  socs:
  - name: r7f702300aebbc-c
  - name: r7f702300bebbc-c
  - name: r7f702300ebbg-c
```

## boards/renesas/pb_rh850u2b_292pin/pb_rh850u2b_292pin_defconfig
```kconfig
# Copyright (c) 2025 Renesas Electronics Corporation
# SPDX-License-Identifier: Apache-2.0

# Enable GPIO
CONFIG_GPIO=n

# Enable Console
# CONFIG_SERIAL=y
# CONFIG_UART_INTERRUPT_DRIVEN=y
CONFIG_CONSOLE=y
# CONFIG_UART_CONSOLE=y
# CONFIG_RH850_OSTM_SYSTEM_TIMER=y
# CONFIG_TICKLESS_KERNEL=y
CONFIG_SYS_CLOCK_TICKS_PER_SEC=1000
CONFIG_SYS_CLOCK_HW_CYCLES_PER_SEC=80000000
CONFIG_MULTITHREADING=y
```

## boards/renesas/pb_rh850u2b_292pin/pb_rh850u2b_292pin_r7f70254xafabb-c_defconfig
```kconfig
# Copyright (c) 2025 Renesas Electronics Corporation
# SPDX-License-Identifier: Apache-2.0

# Enable GPIO
CONFIG_GPIO=n

# Serial Drivers
CONFIG_SERIAL=y
CONFIG_UART_INTERRUPT_DRIVEN=y

# Enable Console
CONFIG_CONSOLE=y
CONFIG_UART_CONSOLE=y

# Enable Timer and Sys clock
CONFIG_TICKLESS_KERNEL=y
CONFIG_SYS_CLOCK_TICKS_PER_SEC=1000
CONFIG_SYS_CLOCK_HW_CYCLES_PER_SEC=80000000
CONFIG_MULTITHREADING=y
```

## boards/renesas/pb_rh850u2b_468pin/Kconfig.pb_rh850u2b_468pin
```kconfig
# Copyright (c) 2026 Renesas Electronics Corporation
# SPDX-License-Identifier: Apache-2.0

config BOARD_PB_RH850U2B_468PIN
	select SOC_R7F70254xAFABG_C
```

## boards/renesas/pb_rh850u2c_292pin/Kconfig.pb_rh850u2c_292pin
```kconfig
# Copyright (c) 2026 Renesas Electronics Corporation
# SPDX-License-Identifier: Apache-2.0

config BOARD_PB_RH850U2C_292PIN
	select SOC_R7F702600AFABB_C if BOARD_PB_RH850U2C_292PIN_R7F702600AFABB_C
	select SOC_R7F702600FABB_C if BOARD_PB_RH850U2C_292PIN_R7F702600FABB_C
```

## boards/renesas/pb_u2b10_292pin/Kconfig.pb_u2b10_292pin
```kconfig
# Copyright (c) 2025 Renesas Electronics Corporation
# SPDX-License-Identifier: Apache-2.0

config BOARD_PB_U2B10_292PIN
	select SOC_R7F70254xAFABB_C
```

## boards/renesas/pb_u2b10_292pin/board.yml
```yaml
board:
  name: pb_u2b10_292pin
  full_name: Piggy Board RH850 U2B10 292pin
  vendor: renesas
  socs:
  - name: r7f70254xafabb-c
```

## boards/renesas/rcar_ironhide_x5h/Kconfig.rcar_ironhide_x5h
```kconfig
# Copyright (c) 2026 Renesas Electronics Corporation
# SPDX-License-Identifier: Apache-2.0

config BOARD_RCAR_IRONHIDE_X5H
	select SOC_R8A7800_R52
```

## boards/renesas/rcar_ironhide_x5h/board.yml
```yaml
board:
  name: rcar_ironhide_x5h
  full_name: R-Car Ironhide X5H
  vendor: renesas
  socs:
  - name: r8a7800
```

## boards/renesas/rcar_ironhide_x5h/rcar_ironhide_x5h_r8a7800_r52_defconfig
```kconfig
# Copyright (c) 2026 Renesas Electronics Corporation
# SPDX-License-Identifier: Apache-2.0

CONFIG_ARM_ARCH_TIMER=y
CONFIG_CLOCK_CONTROL=y
CONFIG_SYS_CLOCK_HW_CYCLES_PER_SEC=1066666666
CONFIG_SYS_CLOCK_TICKS_PER_SEC=1000
CONFIG_CONSOLE=y
CONFIG_RAM_CONSOLE=n
CONFIG_FLASH_SIZE=0
CONFIG_FLASH_BASE_ADDRESS=0
CONFIG_SERIAL=y
CONFIG_UART_CONSOLE=y
CONFIG_UART_INTERRUPT_DRIVEN=n
```

## boards/shields/rtkmipilcdb00000be/Kconfig.defconfig
```kconfig
# Copyright (c) 2024 Renesas Electronics Corporation
# SPDX-License-Identifier: Apache-2.0

if SHIELD_RTKMIPILCDB00000BE
if DISPLAY

config INPUT_INIT_PRIORITY
	default 89

# Enable MIPI DSI, as this display controller requires it.

endif # DISPLAY

if LVGL

# Configure LVGL to use touchscreen with KSCAN API

config INPUT
	default y

config INPUT_GT911_INTERRUPT
	default n

# LVGL should allocate buffers equal to size of display
config LV_Z_VDB_SIZE
	default 100

# Enable double buffering
config LV_Z_DOUBLE_VDB
	default y

# Force full refresh. This prevents memory copy associated with partial
# display refreshes, which is not necessary for the eLCDIF driver
config LV_Z_FULL_REFRESH
	default y

config LV_Z_BITS_PER_PIXEL
	default 32

# Use offloaded render thread
config LV_Z_FLUSH_THREAD
	default y

choice LV_COLOR_DEPTH
	default LV_COLOR_DEPTH_16
endchoice

# Force display buffers to be aligned to cache line size (64 bytes)
config LV_Z_VDB_ALIGN
	default 64

endif # LVGL

endif # SHIELD_RTKMIPILCDB00000BE
```

## boards/shields/rtkmipilcdb00000be/boards/ek_ra8d1.conf
```kconfig
# Copyright (c) 2024 Renesas Electronics Corporation
# SPDX-License-Identifier: Apache-2.0

CONFIG_MEMC=y
CONFIG_LV_Z_VBD_CUSTOM_SECTION=y
```

## drivers/clock_control/Kconfig.rcar
```kconfig
# Copyright (c) 2021-2023 IoT.bzh
# Copyright (c) 2026 Renesas Electronics Corporation
# SPDX-License-Identifier: Apache-2.0

config CLOCK_CONTROL_RCAR_CPG_MSSR
	bool "RCar CPG MSSR driver"
	default y
	depends on SOC_FAMILY_RENESAS_RCAR && !SOC_SERIES_RCAR_GEN5
	help
	  Enable support for Renesas RCar CPG MSSR driver.

config CLOCK_CONTROL_RCAR_CLKC_MDLC
	bool "Renesas R-Car CLKC MDLC driver"
	default y
	depends on DT_HAS_RENESAS_R8A7800_CLKC_MDLC_ENABLED
	help
	  Enable the Renesas R-Car Clock controller (CLKC) and Module controller (MDLC) driver.
```

## drivers/clock_control/Kconfig.renesas_rh850_cgc
```kconfig
# Copyright (c) 2026 Renesas Electronics Corporation
# SPDX-License-Identifier: Apache-2.0

menuconfig CLOCK_CONTROL_RENESAS_RH850_CGC
	bool "Renesas RH850 CGC clock-control driver"
	default y
	depends on DT_HAS_RENESAS_RH850_CGC_ENABLED
	select USE_RH850_FSP_CGC
	help
	  Enable the Renesas RH850 Clock Generation Circuit (CGC) driver.
	  The driver uses Renesas FSP CGC/BSP APIs for module standby,
	  oscillator status, and clock-rate lookup.

if CLOCK_CONTROL_RENESAS_RH850_CGC

config RH850_CLOCK_MOSC_CONTINUE_IN_STANDBY
	bool "Continue MainOSC in chip standby mode"
	default n
	help
	  Keep the Main Oscillator running in chip standby mode.

config RH850_CLOCK_PLL_CONTINUE_IN_STANDBY
	bool "Continue PLL in chip standby mode"
	default n
	help
	  Keep the PLL running in chip standby mode.

config RH850_CLOCK_HSOSC_CONTINUE_IN_STANDBY
	bool "Continue HSOSC in chip standby mode"
	default n
	help
	  Keep the high-speed internal oscillator running in chip standby mode.

endif # CLOCK_CONTROL_RENESAS_RH850_CGC
```

## drivers/counter/Kconfig.renesas_rh850
```kconfig
# Copyright (c) 2026 Renesas Electronics Corporation
# SPDX-License-Identifier: Apache-2.0

config COUNTER_RENESAS_RH850_OSTM
	bool "Renesas RH850 OS Timer (OSTM) Counter driver"
	default y
	depends on DT_HAS_RENESAS_RH850_OSTM_COUNTER_ENABLED
	select USE_RH850_FSP_OSTM
	help
	  Enable the counter driver for the Renesas RH850 OS Timer (OSTM).
```

## drivers/crc/Kconfig
```kconfig
# Copyright (c) 2024 Brill Power Ltd.
# SPDX-License-Identifier: Apache-2.0

if CRC

module = CRC
module-str = CRC

source "subsys/logging/Kconfig.template.log_config"

config CRC_INIT_PRIORITY
	int "CRC init priority"
	default KERNEL_INIT_PRIORITY_DEVICE
	help
	  CRC driver device initialization priority.

source "drivers/crc/Kconfig.renesas_ra"

config CRC_HAS_CRC4
	bool
	help
	  CRC driver has CRC4 computation

config CRC_HAS_CRC4_TI
	bool
	help
	  CRC driver has CRC4 TI computation

config CRC_HAS_CRC7_BE
	bool
	help
	  CRC driver has CRC7 BE computation

config CRC_HAS_CRC8
	bool
	help
	  CRC driver has CRC8 computation

config CRC_HAS_CRC8_CCITT
	bool
	help
	  CRC driver has CRC8 CCITT computation

config CRC_HAS_CRC8_ROHC
	bool
	help
	  CRC driver has CRC8 ROHC computation

config CRC_HAS_CRC16
	bool
	help
	  CRC driver has CRC16 computation

config CRC_HAS_CRC16_CCITT
	bool
	help
	  CRC driver has CRC16 CCITT computation

config CRC_HAS_CRC16_ITU_T
	bool
	help
	  CRC driver has CRC16 ITU-T computation

config CRC_HAS_CRC16_ANSI
	bool
	depends on CRC_HAS_CRC16_REFLECT
	help
	  CRC driver has CRC16 Ansi computation

config CRC_HAS_CRC16_REFLECT
	bool
	help
	  CRC driver has CRC16 reflect computation

config CRC_HAS_CRC24_PGP
	bool
	help
	  CRC driver has CRC24 PGP computation

config CRC_HAS_CRC32_C
	bool
	help
	  CRC driver has CRC32C computation

config CRC_HAS_CRC32_IEEE
	bool
	help
	  CRC driver has CRC32 IEEE computation

endif #CRC
```

## drivers/crc/Kconfig.renesas_rh850
```kconfig
# Copyright (c) 2026 Renesas Electronics Corporation
# SPDX-License-Identifier: Apache-2.0

config CRC_DRIVER_RENESAS_RH850
	bool
	depends on DT_HAS_RENESAS_RH850_CRC_ENABLED
	default y
	select CRC_DRIVER_HAS_CRC8
	select CRC_DRIVER_HAS_CRC8_ROHC
	select CRC_DRIVER_HAS_CRC8_CCITT
	select CRC_DRIVER_HAS_CRC16
	select CRC_DRIVER_HAS_CRC16_CCITT
	select CRC_DRIVER_HAS_CRC16_ANSI
	select CRC_DRIVER_HAS_CRC16_ITU_T
	select CRC_DRIVER_HAS_CRC16_REFLECT
	select CRC_DRIVER_HAS_CRC32_C
	select CRC_DRIVER_HAS_CRC32_IEEE
	select CRC_DRIVER_SUPPORT_TYPE_64_BIT
	select USE_RH850_FSP_CRC
	help
	  Enable the driver implementation for Renesas RH850
```

## drivers/display/Kconfig.ili9806e_dsi
```kconfig
# Copyright (c) 2024 Renesas Electronics Corporation
# SPDX-License-Identifier: Apache-2.0

config ILI9806E_DSI
	bool "ILI9806E_DSI display driver"
	default y
	depends on DT_HAS_ILITEK_ILI9806E_DSI_ENABLED
	select MIPI_DSI
	help
	  Enable driver for ILI9806E_DSI display driver.
```

## drivers/display/Kconfig.renesas_ra
```kconfig
# Renesas RA Family

# Copyright (c) 2024 Renesas Electronics Corporation
# SPDX-License-Identifier: Apache-2.0

config RENESAS_RA_DISPLAY
	bool "Renesas display controller driver"
	default y
	depends on DT_HAS_RENESAS_RA_DISPLAY_ENABLED
	select USE_RA_FSP_DISPLAY
	help
	  Enable Renesas display controller.

if RENESAS_RA_DISPLAY

config RENESAS_RA_DISPLAY_ALIGN
	int "buffer alignment"
	default 64
	help
	  Rendering buffer alignment.

endif # RENESAS_RA_DISPLAY
```

## drivers/dma/Kconfig.renesas_rh850
```kconfig
# Copyright (c) 2026 Renesas Electronics Corporation
# SPDX-License-Identifier: Apache-2.0

config DMA_RENESAS_RH850
	bool "Renesas RH850 DMAC"
	default y
	depends on DT_HAS_RENESAS_RH850_DMA_ENABLED
	select USE_RH850_FSP_DMAC
	help
	  Enable Renesas RH850 DMA Driver.
```

## drivers/ethernet/Kconfig.renesas_ra
```kconfig
# Copyright (c) 2024 Renesas Electronics Corporation
# SPDX-License-Identifier: Apache-2.0

config ETH_RENESAS_RA
	bool "Renesas RA Ethernet"
	default y
	select USE_RA_FSP_ETHER
	help
	  Enable Renesas RA Ethernet Driver.

if ETH_RENESAS_RA

config ETH_RA_RX_THREAD_STACK_SIZE
	int "Stack size for internal incoming packet handler"
	default 800
	help
	  Size of the stack used for internal thread which is ran for
	  incoming packet processing.

config ETH_RA_RX_THREAD_PRIORITY
	int "Renesas RA Ethernet receive thread priority"
	default 2

endif
```
