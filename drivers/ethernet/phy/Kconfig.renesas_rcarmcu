## drivers/ethernet/phy/Kconfig.renesas_rcarmcu
```kconfig
# Renesas CT25205-RTL 10BASE-T1S PHY driver configuration options

# Copyright (c) 2026 Renesas Electronics Corporation
# SPDX-License-Identifier: Apache-2.0

config PHY_RENESAS_CT25205
	bool "Renesas CT25205-RTL PHY Driver"
	default y
	depends on DT_HAS_RENESAS_CT25205_PHY_ENABLED
	help
	  Enable Renesas CT25205-RTL Ethernet PHY Driver
```

## drivers/flash/Kconfig.renesas_rx
```kconfig
# Renesas RX Family

# Copyright (c) 2025 Renesas Electronics Corporation
# SPDX-License-Identifier: Apache-2.0

config SOC_FLASH_RX
	bool "RX flash driver"
	depends on DT_HAS_RENESAS_RX_FLASH_ENABLED
	default y
	select FLASH_HAS_DRIVER_ENABLED
	select FLASH_PAGE_LAYOUT
	select FLASH_HAS_PAGE_LAYOUT
	select FLASH_HAS_EXPLICIT_ERASE
	select USE_RX_RDP_FLASH
	help
	  Enable flash driver for RX series

if SOC_FLASH_RX

config RX_FLASH_TYPE1
	bool
	depends on SOC_SERIES_RX130
	default y
	help
	  Enable the RX flash driver type 1

endif
```

## drivers/i2c/Kconfig.renesas_rx
```kconfig
# Renesas RX Family

# Copyright (c) 2024 - 2025 Renesas Electronics Corporation
# SPDX-License-Identifier: Apache-2.0

config I2C_RENESAS_RX_RIIC
	bool "Renesas RX I2C Master"
	default y
	depends on DT_HAS_RENESAS_RX_I2C_ENABLED
	select USE_RX_RDP_I2C
	select PINCTRL
	help
	  Enable Renesas RX I2C Driver.

config I2C_RENESAS_RX_RIIC_CALLBACK
	bool "Renesas RX I2C Callback Support"
	depends on I2C_CALLBACK && I2C_RENESAS_RX_RIIC
	default y
	help
	  Enable Callback support for the I2C Driver

config RENESAS_RX_I2C_DTC
	bool "Renesas RX I2C transfer through DTC"
	default y
	depends on I2C_RENESAS_RX_RIIC
	depends on DT_HAS_RENESAS_RX_DTC_ENABLED
	select RENESAS_RX_DTC
	help
	  Enable Using DTC module to transfer data
```

## drivers/input/Kconfig.renesas
```kconfig
# Copyright (c) 2025 Renesas Electronics Corporation
# SPDX-License-Identifier: Apache-2.0

config INPUT_CTSU_RENESAS_RX
	bool "Renesas Capacitive Touch Sensing Unit"
	default y
	depends on DT_HAS_RENESAS_RX_CTSU_ENABLED
	select USE_RX_RDP_CTSU
	select PINCTRL
	help
	  Enable RX series CTSU driver

if INPUT_CTSU_RENESAS_RX

config CTSU_SHOW_COUNT
	bool "Show measured count"
	help
	  Show Count value that is measured for each TS Node
	  This could be use when you need to know the raw count output of CTSU
		in order to set an appropriate threshold

config CTSU_DEBOUNCE_INTERVAL_MS
	int "CTSU debounce interval time"
	default 30
	help
	  Debouncing interval time in milliseconds

config CTSU_NUM_MOVING_AVERAGE
	int "CTSU Moving average"
	default 4
	help
	   Number of moving average for measurement data

config CTSU_POWER_SUPPLY_CAPACITY
	int "CTSU Power supply capacity"
	default 0
	range 0 1
	help
	  Power Supply Capacity Adjustment
	  - 0: Normal (40uA)
	  - 1: High-current output (80uA)

config CTSU_TRANSMISSION_POWER_SUPPLY
	int "CTSU transmission power supply"
	default 0
	range 0 1
	help
	  Transmission Power Supply Select
	  - 0: VCC selected
	  - 1: Internal logic power supply selected

config CTSU_PCLK_DIVISION
	int "CTSU: Division of PCLK"
	default 0
	range 0 2
	help
	  Division of PCLK
	  - 0: PCLK/1
	  - 1: PCLK/2
	  - 2: PCLK/4

endif #INPUT_CTSU
```

## drivers/interrupt_controller/Kconfig.renesas_rh850
```kconfig
# Copyright (c) 2026 Renesas Electronics Corporation
# SPDX-License-Identifier: Apache-2.0

config RENESAS_RH850_EXT_IRQ
	bool "Renesas RH850 external interrupt controller driver"
	default y
	depends on DT_HAS_RENESAS_RH850_EXT_IRQ_ENABLED
	select USE_RH850_FSP_EXT_IRQ
	select PINCTRL
	help
	  Renesas RH850 external interrupt controller driver
```

## drivers/misc/renesas_lvd/Kconfig
```kconfig
# Copyright (c) 2025 Renesas Electronics Corporation
# SPDX-License-Identifier: Apache-2.0

# Renesas RX Voltage Detection Circuit

config RENESAS_RX_LVD
	bool "Renesas RX External Interrupt Driver"
	default y
	depends on DT_HAS_RENESAS_RX_LVD_ENABLED
	select USE_RX_RDP_LVD
	select PINCTRL
	help
	  Enable Renesas RX low voltage detection driver

config RENESAS_RX_LVD_INIT_PRIORITY
	int "RX LVD initialization priority"
	default KERNEL_INIT_PRIORITY_DEVICE
	help
	  System initialization priority for RX LVD driver.
```

## drivers/misc/renesas_rx_dtc/Kconfig
```kconfig
# Copyright (c) 2025 Renesas Electronics Corporation
# SPDX-License-Identifier: Apache-2.0

# Renesas RX Data Transfer Controller (DTC) Option

config RENESAS_RX_DTC
	bool "Renesas RX Data Transfer Controller (DTC) Driver"
	help
	  Enable config options for Renesas RX Data Transfer Controller
```

## drivers/rtc/Kconfig.renesas_ra
```kconfig
# Renesas RA Family

# Copyright (c) 2025 Renesas Electronics Corporation
# SPDX-License-Identifier: Apache-2.0

config RTC_RENESAS_RA
	bool "Renesas RA RTC"
	default y
	depends on DT_HAS_RENESAS_RA_RTC_ENABLED
	select USE_RA_FSP_RTC
	help
	  Enable Renesas RA RTC Driver.

config RTC_RENESAS_RA_ALWAYS_SET_CLOCK_SOURCE
	bool "Force RTC clock source setup during init"
	depends on RTC_RENESAS_RA
	help
	  Always configure the RTC clock source during initialization.
```

## drivers/rtc/Kconfig.renesas_rh850
```kconfig
# Copyright (c) 2026 Renesas Electronics Corporation
# SPDX-License-Identifier: Apache-2.0

config RTC_RENESAS_RH850
	bool "Renesas RH850 RTCA"
	default y
	depends on DT_HAS_RENESAS_RH850_RTC_ENABLED
	select USE_RH850_FSP_RTCA
	help
	  Enable Renesas RH850 RTC Driver.
```

## drivers/spi/Kconfig.renesas_rh850
```kconfig
# Copyright (c) 2026 Renesas Electronics Corporation
# SPDX-License-Identifier: Apache-2.0

config SPI_RENESAS_RH850
	bool "Renesas RH850 SPI"
	default y
	depends on DT_HAS_RENESAS_RH850_SPI_ENABLED
	select USE_RH850_FSP_MSPI
	select PINCTRL
	help
	Enable Renesas RH850 SPI Driver.

if SPI_RENESAS_RH850

config SPI_RENESAS_RH850_INTERRUPT
	bool "RH850 SPI Interrupt Support"
	default y
	help
		Enable Interrupt support for the SPI Driver of RH850 family.

endif # SPI_RENESAS_RH850

if SPI_RENESAS_RH850

config SPI_RH850_SYNC_TRANSFER_TIMEOUT_VALUE
	hex "Maximum time to wait for the transceiver operation in Polling mode."
	default 0xFFFFFFFF
	help
		Maximum amount of time that SPI (master/slave) should wait for the transceiver
		operation. Used only in Polling mode.

endif # SPI_RENESAS_RH850
```

## drivers/watchdog/Kconfig.renesas_rh850
```kconfig
# Copyright (c) 2026 Renesas Electronics Corporation
# SPDX-License-Identifier: Apache-2.0

config WDT_RENESAS_RH850
	bool "Watchdog Driver for Renesas RH850"
	default y
	depends on DT_HAS_RENESAS_RH850_WDTB_ENABLED
	select HAS_WDT_DISABLE_AT_BOOT
	select USE_RH850_FSP_WDT
	help
	  Enable watchdog driver for Renesas RH850
```

## dts/bindings/can/renesas,rh850-canfd.yaml
```yaml
# Copyright (c) 2026 Renesas Electronics Corporation
# SPDX-License-Identifier: Apache-2.0

description: Renesas RH850 CANFD controller

compatible: "renesas,rh850-canfd"

include: [can-fd-controller.yaml, pinctrl-device.yaml]

properties:
  interrupts:
    required: true

  channel:
    type: int
    required: true

  clock-frequency:
    type: int
    required: true

  rx-max-filters:
    type: int
    required: true
    description: |
      To determine the maximum rx filters can be added on this CAN device.
      Valid range: 1 - 128
```

## dts/bindings/clock/renesas,r8a7800-clkc-mdlc.yaml
```yaml
# Copyright (c) 2026 Renesas Electronics Corporation
# SPDX-License-Identifier: Apache-2.0

description: Renesas R8A7800 SoC Clock Controller(CLKC) / Module Controller(MDLC)

compatible: "renesas,r8a7800-clkc-mdlc"

include: [clock-controller.yaml, base.yaml]

properties:
  reg:
    required: true

  "#clock-cells":
    const: 2

clock-cells:
  - domain
  - module
```

## dts/bindings/clock/renesas,r8a7800-cpg-mssr.yaml
```yaml
# Copyright (c) 2026 Renesas Electronics Corporation
# SPDX-License-Identifier: Apache-2.0

description: Renesas R8A7800 SoC Clock Pulse Generator / Module Standby and Software Reset

compatible: "renesas,r8a7800-cpg-mssr"

include: renesas,rcar-cpg-mssr.yaml
```

## dts/bindings/clock/renesas,ra8m1-clock.yaml
```yaml
# Copyright (c) 2024 Renesas Electronics Corporation
# SPDX-License-Identifier: Apache-2.0

description: Renesas RA8M1 Clock Generation Circuit

compatible: "renesas,ra8m1-clock"

include: [clock-controller.yaml, base.yaml]

properties:
  pll-source:
    type: int
    required: true
  pll-div:
    type: int
    required: true
  pll-mul:
    type: array
    required: true
  pll-divp:
    type: int
    required: true
  pll-freqp:
    type: int
    required: true
  pll-divq:
    type: int
    required: true
  pll-freqq:
    type: int
    required: true
  pll-divr:
    type: int
    required: true
  pll-freqr:
    type: int
    required: true

  pll2-source:
    type: int
    required: true
  pll2-div:
    type: int
    required: true
  pll2-mul:
    type: array
    required: true
  pll2-divp:
    type: int
    required: true
  pll2-freqp:
    type: int
    required: true
  pll2-divq:
    type: int
    required: true
  pll2-freqq:
    type: int
    required: true
  pll2-divr:
    type: int
    required: true
  pll2-freqr:
    type: int
    required: true

  sysclock-source:
    type: int
    required: true
  cpuclk-div:
    type: int
    required: true
  iclk-div:
    type: int
    required: true
  pclka-div:
    type: int
    required: true
  pclkb-div:
    type: int
    required: true
  pclkc-div:
    type: int
    required: true
  pclkd-div:
    type: int
    required: true
  pclke-div:
    type: int
    required: true
  bclk-div:
    type: int
    required: true
  bclk-out:
    type: int
    required: true
  fclk-div:
    type: int
    required: true
  sdclk-out:
    type: int
    required: true

  uclk-source:
    type: int
    required: true
  uclk-div:
    type: int
    required: true
  u60clk-source:
    type: int
    required: true
  u60clk-div:
    type: int
    required: true
  octaspiclk-source:
    type: int
    required: true
  octaspiclk-div:
    type: int
    required: true
  canfdclk-source:
    type: int
    required: true
  canfdclk-div:
    type: int
    required: true
  clkout-source:
    type: int
    required: true
  clkout-div:
    type: int
    required: true
  sciclk-source:
    type: int
    required: true
  sciclk-div:
    type: int
    required: true
  spiclk-source:
    type: int
    required: true
  spiclk-div:
    type: int
    required: true
  i3cclk-source:
    type: int
    required: true
  i3cclk-div:
    type: int
    required: true
```

## dts/bindings/clock/renesas,rh850-cgc.yaml
```yaml
# Copyright (c) 2026 Renesas Electronics Corporation
# SPDX-License-Identifier: Apache-2.0

description: Renesas RH850 Clock Generation Circuit controller

compatible: "renesas,rh850-cgc"

include: [base.yaml, clock-controller.yaml]

properties:
  "#clock-cells":
    const: 1

clock-cells:
  - clk_id
```

## dts/bindings/counter/renesas,rh850-ostm-counter.yaml
```yaml
# Copyright (c) 2026 Renesas Electronics Corporation
# SPDX-License-Identifier: Apache-2.0

description: Renesas RH850 OSTM Counter

compatible: "renesas,rh850-ostm-counter"

include: [base.yaml]
```

## dts/bindings/crc/renesas,rh850-crc.yaml
```yaml
# Copyright (c) 2025 Renesas Electronics Corporation
# SPDX-License-Identifier: Apache-2.0

title: Renesas RH850 CRC (Cyclic Redundancy Check) device

description: Renesas RH850 CRC (Cyclic Redundancy Check) driver

compatible: "renesas,rh850-crc"

include: [base.yaml]

properties:
  reg:
    required: true
  channel:
    type: int
    required: true
```

## dts/bindings/display/renesas,ra-display.yaml
```yaml
# Copyright (c) 2024 Renesas Electronics Corporation
# SPDX-License-Identifier: Apache-2.0

description: Renesas Graphic LCD controller

compatible: "renesas,ra-display"

include: [display-controller.yaml, lcd-controller.yaml, pinctrl-device.yaml]

properties:
  reg:
    required: true

  clocks:
    required: true

  pinctrl-0:
    required: true

  backlight-gpios:
    type: phandle-array
    required: true
    description: |
      The BLn pin is asserted to control the backlight of the panel.
      The sensor receives this as an active-high signal.
```

## dts/bindings/dma/renesas,rh850-dma.yaml
```yaml
# Copyright (c) 2026 Renesas Electronics Corporation
# SPDX-License-Identifier: Apache-2.0

description: Renesas RH850 DMA Controller

compatible: "renesas,rh850-dma"

include: dma-controller.yaml

properties:
  reg:
    required: true

  interrupts:
    required: true

  dma-channels:
    required: true

  "#dma-cells":
    const: 2

  dma-unit:
    type: int
    required: true

dma-cells:
  - channel
  - config
```

## dts/bindings/ethernet/phy/renesas,ct25205-phy.yaml
```yaml
# Copyright (c) 2026 Renesas Electronics Corporation
# SPDX-License-Identifier: Apache-2.0

description: Renesas CT25205 Ethernet PHY device

compatible: "renesas,ct25205-phy"

# No "on mdio bus" suffix — this PHY is a child of the MAC node,
# not of an MDIO bus controller (following NXP PR #105033 pattern).
# PLCA properties included from shared binding.
include:
  - name: ethernet-phy-plca.yaml

properties:
  phy-lsi-addr:
    type: int
    required: true
    description: PHY LSI address (0-31) for MDIO access.

  no-reset:
    type: boolean
    description: Skip software reset (Control register bit 15) during initialization.

  reset-gpios:
    type: phandle-array
    description: GPIO connected to active-low hardware reset pin.

  reset-assert-us:
    type: int
    default: 0
    description: Delay in microseconds after asserting hardware reset.

  reset-deassert-us:
    type: int
    default: 0
    description: Delay in microseconds after deasserting hardware reset.
```

## dts/bindings/ethernet/renesas,ra-eswm.yaml
```yaml
# Copyright (c) 2025 Renesas Electronics Corporation
# SPDX-License-Identifier: Apache-2.0

description: Renesas RA Ethernet MAC Controller

compatible: "renesas,ra-eswm"

include: [base.yaml, pinctrl-device.yaml]

properties:
  interrupts:
    required: true

  clocks:
    required: true

  clock-names:
    required: true
    enum:
      - "gwcaclk"
      - "pclk"
      - "eswclk"
      - "eswphyclk"
      - "ethphyclk"
    description: |
      Clocks must be given corresponding names so that the shim driver can recognize them.
      "gwcaclk": operating clock for gateway CPU agent
      "pclk": peripheral clock for COMA and PTP timer
      "eswclk": operating clock for ethernet switch module
      "eswphyclk": operating clock for xMII interface
      "ethphyclk": operating clock for ETHPHYLCK pin output. Enable this clock if any PHY
      device use ETHPHYCLK pin output as clock source.

  port0-fwd:
    type: int
    required: false
    default: 0x4
    description: |
      Bitmask of destination ports for forwarding packets received on port 0.
      Values can be OR-combined:
        - 0x1: PORT0 (1 << 0)
        - 0x2: PORT1 (1 << 1)
        - 0x4: PORT2/CPU (1 << 2)
      Example: 0x7 forwards to all ports.

  port1-fwd:
    type: int
    required: false
    default: 0x4
    description: |
      Bitmask of destination ports for forwarding packets received on port 1.
      Values can be OR-combined:
        - 0x1: PORT0 (1 << 0)
        - 0x2: PORT1 (1 << 1)
        - 0x4: PORT2/CPU (1 << 2)
      Example: 0x7 forwards to all ports.
```

## dts/bindings/ethernet/renesas,ra-ethernet.yaml
```yaml
# Copyright (c) 2024 Renesas Electronics Corporation
# SPDX-License-Identifier: Apache-2.0

description: Renesas RA Ethernet

compatible: "renesas,ra-ethernet"

include: [ethernet-controller.yaml, pinctrl-device.yaml]

properties:
  reg:
    required: true

  interrupts:
    required: true

  phy-type:
    type: int
    description: |
      Specifies the interface connection type between ethernet MAC and PHY.
        1: RA_PHY_KSZ8091RNB
        2: RA_PHY_KSZ8041
        3: RA_PHY_DP83620
        4: RA_PHY_ICS1894
    enum:
      - 1
      - 2
      - 3
      - 4
```
