## drivers/ethernet/Kconfig.renesas_rh850
```kconfig
# Copyright (c) 2026 Renesas Electronics Corporation
# SPDX-License-Identifier: Apache-2.0

config ETH_RENESAS_RH850_ETNF
	bool "Renesas RH850 Ethernet T1S (10BASE-T1S) MAC Driver"
	default y
	depends on DT_HAS_RENESAS_RH850_ETHERNET_ETNF_ENABLED
	select USE_RH850_FSP_ETHER_ETNF if RH850
	select PINCTRL
	select CLOCK_CONTROL
	help
	  Enable Ethernet T1S (10BASE-T1S, IEEE 802.3cg) MAC driver for the
	  Renesas RH850 family based on the ETNF0 controller.
	  Uses the Renesas FSP r_ether_t1s HAL module.

if ETH_RENESAS_RH850_ETNF

config ETH_RENESAS_RH850_ETNF_RX_THREAD_STACK_SIZE
	int "RX processing thread stack size (bytes)"
	default 1500
	help
	  Stack size in bytes for the dedicated RX packet processing thread.
	  Increase this value if net_pkt allocation or L3 processing causes
	  stack overflows.

config ETH_RENESAS_RH850_ETNF_RX_THREAD_PRIORITY
	int "RX thread cooperative priority"
	default 2

config ETH_RENESAS_RH850_ETNF_USE_ZEROCOPY
	bool "RH850 Ethernet T1S zero-copy TX/RX mode"
	help
	  When enabled, the driver uses zero-copy mode: RX buffer pointers are
	  passed directly to the network stack without memcpy, and TX buffers
	  are provided by the caller. Reduces CPU overhead and memory usage.
	  Maps to ETHER_ZEROCOPY_ENABLE in the FSP ether_cfg_t.

endif # ETH_RENESAS_RH850_ETNF

config ETH_RENESAS_RH850_ETND
	bool "Renesas RH850 MCU Ethernet TSN (ETND) MAC Driver"
	default y
	depends on DT_HAS_RENESAS_RH850_ETHERNET_ETND_ENABLED
	select USE_RH850_FSP_ETHER_ETND
	select PINCTRL
	select CLOCK_CONTROL
	help
	  Enable the Ethernet TSN (ETND) MAC driver for the Renesas RH850 MCU
	  family. Uses the Renesas FSP r_ether_tsn HAL module together with an
	  external 10/100 PHY (e.g. LAN8700) via r_ether_phy.

if ETH_RENESAS_RH850_ETND

config ETH_RENESAS_RH850_ETND_RX_THREAD_STACK_SIZE
	int "RX processing thread stack size (bytes)"
	default 1600
	help
	  Stack size in bytes for the dedicated RX packet processing thread.
	  Increase this value if net_pkt allocation or L3 processing causes
	  stack overflows.

config ETH_RENESAS_RH850_ETND_RX_THREAD_PRIORITY
	int "RX thread cooperative priority"
	default 2
	help
	  The driver reads received frames and hands them to the network
	  stack in a cooperative thread, so other threads cannot preempt it
	  for every frame. This option sets its priority, passed through
	  K_PRIO_COOP(): a lower value means a higher priority.

config ETH_RENESAS_RH850_ETND_USE_ZEROCOPY
	bool "Zero-copy TX/RX mode"
	default y
	help
	  Maps to ETHER_ZEROCOPY_ENABLE in the FSP ether_cfg_t.

config ETH_RENESAS_RH850_ETND_ADDR_FILTER
	bool "Destination address filter table"
	help
	  Program r_ether_tsn's destination-address filter table (up to 32
	  entries). This is a software filter inside the FSP RX path: the HAL
	  still receives every frame into memory, then drops the ones whose
	  destination address is not in the table before handing them to the
	  driver, instead of passing all multicast frames through.
	  Broadcast and the interface's own unicast address always pass.

	  The table comes from the "zephyr,mac-address-filter" devicetree
	  property of the ETND node and is programmed once at
	  R_ETHER_TSN_Open(); it is not updated at runtime when the network
	  stack joins or leaves multicast groups. Any multicast address the
	  application needs must be listed there, otherwise it is dropped
	  (e.g. with IPv6, 33:33:00:00:00:01 and the solicited-node address
	  33:33:ff:xx:xx:xx are required for neighbor discovery).

endif # ETH_RENESAS_RH850_ETND
```

## drivers/ethernet/Kconfig.renesas_rx
```kconfig
# Copyright (c) 2025 Renesas Electronics Corporation
# SPDX-License-Identifier: Apache-2.0

config ETH_RENESAS_RX_RMAC
	bool "Renesas RX ethernet RMAC driver"
	default y
	depends on DT_HAS_RENESAS_RX_RMAC_ENABLED
	select USE_RX_FSP_RMAC
	select USE_RX_FSP_LAYER3_SWITCH
	select RENESAS_RX_GRP_INTC_FSP
	select NOCACHE_MEMORY if ARCH_HAS_NOCACHE_MEMORY_SUPPORT
	select MDIO
	help
	  Add support for Renesas RX RMAC Ethernet device driver.

if ETH_RENESAS_RX_RMAC

config ETH_RENESAS_RX_RX_THREAD_STACK_SIZE
	int "Stack size for internal incoming packet handler"
	default 1500
	help
	  Size of the stack used for internal thread which is ran for
	  incoming packet processing.

config ETH_RENESAS_RX_RX_THREAD_PRIORITY
	int "Renesas RX Ethernet receive thread priority"
	default 2

config ETH_RENESAS_RX_USE_ZERO_COPY
	bool "Use zero-copy for ethernet buffers"
	default y
	help
	  Enable this option to use zero-copy mode, allowing the driver to directly
	  access DMA buffers without using a staging buffer.

config ETH_RENESAS_RX_USE_HW_WRITEBACK
	bool "Wait hardware writeback of ethernet buffers"
	default n
	help
	  Enable this option to wait for Ethernet descriptor writeback, ensuring
	  that the TX frame is written successfully. Note that enabling this option
	  may cause ethernet write operations to take slightly longer.

config ESWM_RENESAS_RX_INIT_PRIORITY
	int "Ethernet driver init priority"
	default 55
	help
	  Ethernet switch module ESWM device driver initialization priority.

config ETH_RENESAS_RX_RECEIVE_BUDGET
	int "Receive thread budget"
	default 128
	range 1 1024
	help
	  The budget parameter places a limit on the amount of work the driver
	  may do in the RX thread before yielding the processor, in case there
	  is more work to do. This is to prevent the RX thread to starve other
	  threads. Each received frame counts as one unit of work.

endif
```

## drivers/ethernet/mdio/Kconfig.renesas_rcar
```kconfig
# Copyright (c) 2026 Renesas Electronics Corporation
# SPDX-License-Identifier: Apache-2.0

config MDIO_RENESAS_RCAR_RSW3
	bool "Renesas R-Switch3 (RSW3) MDIO controller driver"
	default y
	depends on DT_HAS_RENESAS_RCAR_RSW3_MDIO_ENABLED
	select PINCTRL
	help
	  Enable Renesas R-Switch3 (RSW3) MDIO support.
```

## drivers/ethernet/mdio/Kconfig.renesas_rh850
```kconfig
# Copyright (c) 2026 Renesas Electronics Corporation
# SPDX-License-Identifier: Apache-2.0

config MDIO_RENESAS_RH850_ETND
	bool "Renesas RH850 MCU ETND MDIO controller driver"
	default y
	depends on DT_HAS_RENESAS_RH850_ETND_MDIO_ENABLED
	select PINCTRL
	select CLOCK_CONTROL
	select USE_RH850_FSP_ETHER_ETND
	help
	  Enable the MDIO controller driver for the Renesas RH850 MCU ETND
	  (TSN) Ethernet MAC. The MDIO state machine is part of the RMACAn
	  register block; this driver bridges the Zephyr MDIO API to the FSP
	  r_ether_phy register access path.
```

## drivers/ethernet/mdio/Kconfig.renesas_rx
```kconfig
# Copyright (c) 2025 Renesas Electronics Corporation
# SPDX-License-Identifier: Apache-2.0

config MDIO_RENESAS_RX_RMAC_PHY
	bool "RENESAS MDIO RMAC controller driver"
	default y
	depends on DT_HAS_RENESAS_RX_RMAC_MDIO_ENABLED
	help
	  Enable RENESAS MDIO RMAC support.
```

## drivers/ethernet/phy/Kconfig.renesas_rcarsoc
```kconfig
# Copyright (c) 2026 Renesas Electronics Corporation
# SPDX-License-Identifier: Apache-2.0

config PHY_RENESAS_PCS
	bool "Renesas R-Car Ethernet PCS channel driver"
	select RENESAS_RCAR_MP_PHY
	help
	  Enable this to support the Ethernet Physical Coding Sublayer (PCS)
	  channels found on Renesas R-Car SoCs. Each channel acts as an
	  internal PHY, connecting the MAC to a SERDES lane (MP-PHY).

if PHY_RENESAS_PCS

config PHY_RENESAS_PCS_BLOCK_INIT_PRIORITY
	int "Renesas R-Car Ethernet PCS block init priority"
	default 51
	help
	  Renesas R-Car Ethernet PCS block (renesas,r8a78000-ether-pcs)
	  initialization priority. Releases Module Standby for every PCS
	  channel underneath it. Must run after the MP-PHY device and before
	  PHY_RENESAS_PCS_INIT_PRIORITY.

config PHY_RENESAS_PCS_INIT_PRIORITY
	int "Renesas R-Car Ethernet PCS channel init priority"
	default 52
	help
	  Renesas R-Car Ethernet PCS channel initialization priority.
	  This must run after the PCS block device and before R-Switch 3.

config PHY_RENESAS_PCS_TIMEOUT_US
	int "Register access timeout (us)"
	default 100000
	help
	  Timeout in microseconds for waiting on PCS register bit changes
	  during SERDES bring-up.

endif # PHY_RENESAS_PCS

config PHY_RENESAS_Q32XX
	bool "Renesas Q32XX PHY Driver"
	default y
	depends on DT_HAS_RENESAS_Q32XX_PHY_ENABLED
	select MDIO
	help
	  Enable Renesas Q32XX Ethernet PHY driver
```

## drivers/firmware/scmi/renesas/Kconfig
```kconfig
# Copyright (c) 2026 Renesas Electronics Corporation
# SPDX-License-Identifier: Apache-2.0

config ARM_SCMI_RENESAS_VENDOR_EXTENSIONS
	bool "Allow Renesas-specific SCMI features"
	help
	  Enable SCMI features implemented by Renesas vendor protocols.

if ARM_SCMI_RENESAS_VENDOR_EXTENSIONS

config RENESAS_SCMI_RESET_STATUS_HELPERS
	bool "Helper functions for Renesas SCMI reset status"
	default y
	depends on DT_HAS_RENESAS_SCMI_RESET_STATUS_ENABLED
	help
	  Enable support for the Renesas vendor RESET_GET_STATUS command.

endif # ARM_SCMI_RENESAS_VENDOR_EXTENSIONS
```

## drivers/flash/Kconfig.renesas_ra_ospi
```kconfig
# Renesas RA Family

# Copyright (c) 2024-2025 Renesas Electronics Corporation
# SPDX-License-Identifier: Apache-2.0

config FLASH_RENESAS_RA_OSPI_B
	bool "Renesas RA Octal-SPI driver"
	default y
	depends on DT_HAS_RENESAS_RA_OSPI_B_NOR_ENABLED
	select FLASH_HAS_DRIVER_ENABLED
	select FLASH_HAS_PAGE_LAYOUT
	select FLASH_HAS_EXPLICIT_ERASE
	select USE_RA_FSP_OSPI_B_NOR_FLASH
	select FLASH_JESD216
	select PINCTRL
	help
	  Enable Octal-SPI Nor flash driver for RA series.

	  If the application (or MCUboot) executes directly out of the
	  OSPI flash (XIP), also enable CONFIG_CODE_DATA_RELOCATION so
	  this driver and its underlying FSP HAL are relocated to RAM.
	  Otherwise the driver's own code would become unreachable the
	  moment it switches the OSPI_B peripheral out of memory-mapped
	  mode to issue erase/write/status commands.

if FLASH_RENESAS_RA_OSPI_B

DT_CHOSEN_RA_OSPI_FLASH_CTRL := zephyr,flash-controller
DT_RA_OSPI_FLASH_CTRL_PATH := $(dt_chosen_path,$(DT_CHOSEN_RA_OSPI_FLASH_CTRL))

config FLASH_RENESAS_RA_OSPI_B_XIP
	bool
	default y if BOOTLOADER_MCUBOOT && \
		$(dt_node_has_compat,$(DT_RA_OSPI_FLASH_CTRL_PATH),$(DT_COMPAT_RENESAS_RA_OSPI_B_NOR))
	select XIP
	help
	  Set when this image is chain-loaded by MCUboot (CONFIG_BOOTLOADER_MCUBOOT
	  - notably false when *building* MCUboot itself, since that sets
	  CONFIG_MCUBOOT instead) and its "zephyr,flash-controller" chosen node
	  is a Renesas OSPI_B NOR flash controller, i.e. this image executes XIP
	  directly out of the same OSPI flash this driver manages.

	  This gates SoC-level early clock init (see
	  fsp_cfg/bsp/*/bsp_clock_cfg.h) that must not touch OctaCLK in that
	  case: doing so this early in boot - before any RAM relocation or
	  runtime locking this driver does could help - would stop the exact
	  clock this CPU depends on to keep fetching its own next instruction.

	  MCUboot's own build is deliberately excluded: it still needs OCTACLK
	  properly configured to talk to the OSPI chip and read/verify/swap the
	  image slots that live there.

endif
```

## drivers/flash/Kconfig.renesas_rx_ospi
```kconfig
# Renesas RX Family

# Copyright (c) 2025 Renesas Electronics Corporation
# SPDX-License-Identifier: Apache-2.0

config FLASH_RENESAS_RX_OSPI_B
	bool "Renesas RX Octal-SPI driver"
	default y
	depends on DT_HAS_RENESAS_RX_OSPI_B_NOR_ENABLED
	select FLASH_HAS_DRIVER_ENABLED
	select FLASH_HAS_PAGE_LAYOUT
	select FLASH_HAS_EXPLICIT_ERASE
	select USE_RX_FSP_OSPI_B
	select FLASH_JESD216
	select FLASH_HAS_EX_OP
	select PINCTRL
	help
	  Enable Octal-SPI Nor flash driver for RX series
```

## drivers/flash/Kconfig.renesas_rx_xspi
```kconfig
# Renesas RX Family

# Copyright (c) 2025 Renesas Electronics Corporation
# SPDX-License-Identifier: Apache-2.0

config FLASH_RENESAS_RX_XSPI
	bool "Renesas RX Octal-SPI driver"
	default y
	depends on DT_HAS_RENESAS_RX_XSPI_NOR_ENABLED
	select FLASH_HAS_DRIVER_ENABLED
	select FLASH_HAS_PAGE_LAYOUT
	select FLASH_HAS_EXPLICIT_ERASE
	select USE_RX_FSP_XSPI_CONTROLLER
	select FLASH_JESD216
	select FLASH_HAS_EX_OP
	select PINCTRL
	help
	  Enable Octal-SPI Nor flash driver for RX series
```

## drivers/hwinfo/Kconfig.renesas_rx
```kconfig
# Copyright The Zephyr Project Contributors
# SPDX-License-Identifier: Apache-2.0

config HWINFO_RENESAS_RX
	bool "Renesas RX device ID"
	default y
	depends on SOC_FAMILY_RENESAS_RX
	select HWINFO_HAS_DRIVER
	help
	  Enable RENESAS RX hwinfo driver
```

## drivers/i2c/Kconfig.renesas_rh850
```kconfig
# Copyright (c) 2026 Renesas Electronics Corporation
# SPDX-License-Identifier: Apache-2.0

config I2C_RENESAS_RH850_IIC
	bool "Renesas RH850 IIC driver"
	default y
	depends on DT_HAS_RENESAS_RH850_IIC_ENABLED
	depends on CLOCK_CONTROL
	select USE_RH850_FSP_IIC if !I2C_RENESAS_RH850_IIC_B
	select USE_RH850_FSP_IIC_B if I2C_RENESAS_RH850_IIC_B
	select PINCTRL
	help
		Enable Renesas RH850 I2C Driver.

if I2C_RENESAS_RH850_IIC

config I2C_RENESAS_RH850_IIC_B
	bool
	default y if SOC_SERIES_RH850U2C
	help
		Use the RH850 IIC_B driver.

config IIC_RENESAS_RH850_INTERRUPT
	bool "RH850 IIC Interrupt Support"
	default y
	help
		Enable Interrupt support for the IIC Driver of RH850 family.

endif #I2C_RENESAS_RH850_IIC
```

## drivers/i2s/Kconfig.renesas_rcar
```kconfig
# Copyright (c) 2026 Renesas Electronics Corporation
# SPDX-License-Identifier: Apache-2.0

config I2S_RENESAS_RCAR_SSI
	bool "Renesas R-Car I2S SSI"
	default y
	depends on DT_HAS_RENESAS_RCAR_I2S_SSI_ENABLED
	help
	  Enable Renesas R-Car I2S Driver.

if I2S_RENESAS_RCAR_SSI

config I2S_RENESAS_RCAR_SSI_DMA
	bool "Renesas R-Car I2S SSI DMA"
	default y
	depends on DMA
	select DMA_RENESAS_RCAR
	help
	  Enable DMA support for R-Car I2S Driver

config I2S_RENESAS_RCAR_SSI_RX_BLOCK_COUNT
	int "RX queue length"
	default 4

config I2S_RENESAS_RCAR_SSI_TX_BLOCK_COUNT
	int "TX queue length"
	default 4

endif #I2S_RENESAS_RCAR_SSI
```

## drivers/i2s/Kconfig.renesas_rh850
```kconfig
# Renesas RH850 U2x Family

# Copyright (c) 2025 Renesas Electronics Corporation
# SPDX-License-Identifier: Apache-2.0

config I2S_RENESAS_RH850_SSIF
	bool "Renesas RH850 I2S SSIF"
	default y
	depends on DT_HAS_RENESAS_RH850_I2S_SSIF_ENABLED
	select USE_RH850_FSP_SSI
	select PINCTRL
	help
	  Enable Renesas RH850 I2S SSIF Driver.

if I2S_RENESAS_RH850_SSIF

config I2S_RENESAS_RH850_SSIF_RX_BLOCK_COUNT
	int "RX queue length"
	default 4
	range 1 255

config I2S_RENESAS_RH850_SSIF_TX_BLOCK_COUNT
	int "TX queue length"
	default 4
	range 1 255

endif # I2S_RENESAS_RH850_SSIF
```

## drivers/mbox/Kconfig.renesas_rcar
```kconfig
# Copyright (c) 2026 Renesas Electronics Corporation
# SPDX-License-Identifier: Apache-2.0

config MBOX_RENESAS_RCAR_MFIS
	bool "Renesas R-Car MBOX (MFIS) driver"
	default y
	depends on DT_HAS_RENESAS_RCAR_MFIS_COMMON_MBOX_ENABLED || \
		   DT_HAS_RENESAS_RCAR_MFIS_SCP_MBOX_ENABLED
	select USE_RCARSOC_DRV_MFIS
	help
	  Enable Renesas R-Car MBOX (MFIS) driver
```

## drivers/memc/Kconfig.renesas_rx
```kconfig
# Renesas RX Family

# Copyright (c) 2025-2026 Renesas Electronics Corporation
# SPDX-License-Identifier: Apache-2.0

config MEMC_RENESAS_RX_XSPI_CONTROLLER_PSRAM
	bool "Renesas RX XSPI Controller PSRAM controller"
	default y
	depends on DT_HAS_RENESAS_RX_XSPI_PSRAM_ENABLED
	select USE_RX_FSP_XSPI_CONTROLLER
	select PINCTRL
	help
	  Enable Renesas RX XSPI Controller PSRAM controller

config MEMC_RENESAS_RX_SDRAM
	bool "Renesas RX sdram controller"
	default y
	depends on DT_HAS_RENESAS_RX_SDRAM_ENABLED
	select USE_RX_FSP_SDRAM
	help
	  Enable Renesas RX sdram controller
```
