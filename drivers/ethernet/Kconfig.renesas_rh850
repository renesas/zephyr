## drivers/misc/renesas_rcar_mp_phy/Kconfig
```kconfig
# Copyright (c) 2026 Renesas Electronics Corporation
# SPDX-License-Identifier: Apache-2.0

# Renesas RCar Multi Protocol PHY Option

config RENESAS_RCAR_MP_PHY
	bool "Renesas RCar Multi Protocol PHY Driver"
	depends on DT_HAS_RENESAS_RCAR_MP_PHY_ENABLED
	help
	  Enable config options for Renesas RCar Multi Protocol PHY

if RENESAS_RCAR_MP_PHY

config RENESAS_RCAR_MP_PHY_NUM_CHANNELS
	int "Number of MP-PHY channels"
	default 4
	help
	  Specifies the number of PHY channels supported by the
	  Renesas R-Car Multi Protocol PHY.

	  Each channel represents one PHY instance, which may be
	  connected to a PCIe, Ethernet, or USB controller depending
	  on the hardware configuration.

	  This value should match the capabilities of the target SoC
	  and the hardware design. In most R-Car Gen5 systems, this
	  is fixed to 4 channels.

endif
```

## drivers/misc/renesas_rx_external_interrupt/Kconfig
```kconfig
# Copyright (c) 2025 Renesas Electronics Corporation
# SPDX-License-Identifier: Apache-2.0

# Renesas RX External Interrupt Option

config RENESAS_RX_EXTERNAL_INTERRUPT
	bool "Renesas RX External Interrupt Driver"
	depends on DT_HAS_RENESAS_RX_EXTERNAL_INTERRUPT_ENABLED
	default y
	help
	  Enable config options for Renesas RX external interrupt

config RENESAS_RX_EXTERNAL_INTERRUPT_ICUM
	bool "Renesas RX ICUM External Interrupt Driver"
	depends on DT_HAS_RENESAS_RX_EXTERNAL_INTERRUPT_ICUM_ENABLED
	default y
	help
	  Enable config options for Renesas RX ICUM external interrupt
```

## drivers/psi5/Kconfig.renesas_rh850
```kconfig
# Copyright (c) 2026 Renesas Electronics Corporation
# SPDX-License-Identifier: Apache-2.0

config PSI5_RENESAS_RH850
	bool "Renesas RH850 PSI5 driver"
	default y
	depends on DT_HAS_RENESAS_RH850_PSI5_ENABLED
	select PINCTRL
	select USE_RH850_FSP_PSI5
	select CLOCK_CONTROL
	help
	  Enable support for the Renesas RH850 PSI5 driver.
```

## drivers/ptp_clock/Kconfig.renesas_rcar
```kconfig
# Copyright (c) 2026 Renesas Electronics Corporation
# SPDX-License-Identifier: Apache-2.0

config PTP_CLOCK_RENESAS_RCAR
	bool "Renesas R-Car PTP Clock driver"
	default y
	depends on DT_HAS_RENESAS_RCAR_PTP_CLOCK_CHANNEL_ENABLED
	depends on NET_L2_PTP
	depends on ETH_RENESAS_RCARSOC_TSNES || ETH_RENESAS_RSWITCH3_PORT
	help
	  Enable Renesas R-Car PTP Clock support.
```

## drivers/pwm/Kconfig.renesas_rh850
```kconfig
# Copyright (c) 2026 Renesas Electronics Corporation
# SPDX-License-Identifier: Apache-2.0

config PWM_RENESAS_RH850
	bool "Renesas RH850 TAUD PWM driver"
	default y
	depends on DT_HAS_RENESAS_RH850_TAUD_PWM_ENABLED
	depends on CLOCK_CONTROL
	select PINCTRL
	select USE_RH850_FSP_TAUD
	help
	  Enable the Renesas RH850 TAUD PWM driver.
	  See the devicetree binding for the primary/synchronized channel model.
```

## drivers/pwm3p/Kconfig
```kconfig
# PWM3P (3-phase PWM) configuration options

# Copyright (c) 2026 Renesas Electronics Corporation
# SPDX-License-Identifier: Apache-2.0

menuconfig PWM3P
	bool "3-phase PWM (PWM3P) drivers"
	help
	  Enable config options for 3-phase PWM (PWM3P) drivers.

if PWM3P

module = PWM3P
module-str = pwm3p
source "subsys/logging/Kconfig.template.log_config"

config PWM3P_INIT_PRIORITY
	int "PWM3P initialization priority"
	default KERNEL_INIT_PRIORITY_DEVICE
	help
	  System initialization priority for PWM3P drivers.

source "drivers/pwm3p/Kconfig.renesas_rh850"

endif # PWM3P
```

## drivers/pwm3p/Kconfig.renesas_rh850
```kconfig
# Copyright (c) 2026 Renesas Electronics Corporation
# SPDX-License-Identifier: Apache-2.0

config PWM3P_RENESAS_RH850_TAUD3P
	bool "Renesas RH850 TAUD3P 3-Phase PWM (PWM3P) driver"
	default y
	depends on DT_HAS_RENESAS_RH850_TAUD3P_PWM3P_ENABLED
	select PINCTRL
	select CLOCK_CONTROL
	select USE_RH850_FSP_TAUD_THREE_PHASE
	select USE_RH850_FSP_TAUD
	select USE_RH850_FSP_TAPA
	help
	  Enable the Renesas RH850 TAUD3P (13 coordinated TAUD channels) 3-phase PWM (PWM3P) driver.
```

## drivers/rtc/Kconfig.renesas_rx
```kconfig
# Renesas RX Family

# Copyright (c) 2026 Renesas Electronics Corporation
# SPDX-License-Identifier: Apache-2.0

config RTC_RENESAS_RX
	bool "Renesas RX RTC"
	default y
	depends on DT_HAS_RENESAS_RX_RTC_ENABLED
	select USE_RX_FSP_RTC
	help
	  Enable Renesas RX RTC Driver.
```

## drivers/sdhc/Kconfig.renesas_rx
```kconfig
# Copyright (c) 2026 Renesas Electronics Corporation
# SPDX-License-Identifier: Apache-2.0

config SDHC_RENESAS_RX
	bool "Renesas RX SDHI driver"
	default y
	depends on DT_HAS_RENESAS_RX_SDHC_ENABLED
	select SDHC_SUPPORTS_NATIVE_MODE
	select USE_RX_FSP_SDHI
	select USE_RX_FSP_DTC
	select PINCTRL
	help
	  Enables Renesas SD Host controller driver
```
