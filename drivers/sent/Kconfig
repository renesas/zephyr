## dts/bindings/adc/renesas,rh850-adck.yaml
```yaml
# Copyright (c) 2026 Renesas Electronics Corporation
# SPDX-License-Identifier: Apache-2.0

description: Renesas RH850 ADCK ADC controller

compatible: "renesas,rh850-adck"

include:
  - base.yaml
  - adc-controller.yaml

properties:
  reg:
    required: true

  interrupts:
    required: true

  interrupt-names:
    required: true
    description: |
      Scan-group completion interrupts are named sg0 through sg4.
      An additional interrupt named error is used for upper/lower-limit
      interrupt notification.

  clocks:
    required: true
    description: Optional clock controller reference used to enable the ADCK peripheral clock.

  vref-mv:
    type: int
    description: ADC reference voltage in millivolts for raw-to-millivolt conversion.

  dmas:
    description: DMA channel used to transfer ADC conversion results.

  channel-available-mask:
    type: int
    required: true
    description: Bit mask of Zephyr ADC channel IDs available on this controller.

  renesas,physical-channel-mask:
    type: array
    required: true
    description: |
      Two 32-bit cells describing the physical input selector values supported
      by this ADCK instance. Cell 0 covers selectors 0 through 31 and cell 1
      covers selectors 32 through 63. This mask documents the selector values
      available on the target SoC instance.

  renesas,unit:
    type: int
    required: true
    description: Hardware ADCK unit index.

  renesas,scan-group:
    type: int
    required: true
    enum: [0, 1, 2, 3, 4]
    description: Scan group used for software-triggered conversion.

  renesas,start-virtual-channel:
    type: int
    default: 0
    description: |
      First virtual channel included in the selected scan group.
      If omitted, the scan group starts at virtual channel 0.

  renesas,end-virtual-channel:
    type: int
    default: 0
    description: |
      Last virtual channel included in the selected scan group.
      If omitted, the scan group ends at virtual channel 0.

  renesas,data-format:
    type: string
    default: "12-bit-unsigned-right-justified"
    enum:
      - "12-bit-signed-fixed-point"
      - "12-bit-signed-integer"
      - "12-bit-unsigned-fixed-point"
      - "10-bit-unsigned-fixed-point"
      - "12-bit-unsigned-right-justified"
      - "12-bit-unsigned-left-justified"
    description: |
      Static controller-wide ADCK result format. Non-integer formats are
      returned in the 16-bit raw representation defined by the hardware.

  renesas,wait-time-cycles:
    type: array
    default: [0, 0, 0, 0, 0, 0, 0, 0]
    description: |
      Wait times before A/D sampling, expressed in CLKAD cycles.

      Entries 0 through 7 configure wait-time tables 0 through 7.
      At most eight entries may be provided. Missing entries are zero.
      Each entry must be in the range 0 through 16383.
      A value of zero produces no effective wait.

      Each channel selects a table using renesas,wait-table:
      0 disables table selection, and 1 through 8 select tables 0
      through 7.

  renesas,addition-count:
    type: int
    default: 2
    enum: [2, 4]
    description: |
      Number of consecutive A/D conversions summed for each channel
      configured as "addition" or "mpx-addition".

      2: Perform two conversions and store the average of both results.
      4: Perform four conversions and store the average of all four results.

  renesas,scan-mode:
    type: string
    default: "multicycle"
    enum:
      - "continuous"
      - "multicycle"
    description: Select scan mode for adck.

  renesas,trigger-method:
    type: string
    default: "software"
    enum: ["software", "hardware", "ad-timer", "th-a", "th-b"]
    description: |
      Static scan-group start method.

      "th-a" and "th-b" use a software hold trigger of T&H group A
      and group B, respectively.

      The driver uses one statically selected scan group and one
      T&H group per ADCK instance. Concurrent operation of both
      T&H groups and hardware-triggered hold are not supported
      by this configuration model.

  renesas,pin-self-diagnostic-level:
    type: int
    default: 0
    enum: [0, 1, 2, 3]
    description: |
      Controller-wide pin-level self-diagnostic voltage selection
      encoded by TDCR.TDLV.

      0: Even inputs use AnVSS; odd inputs use AnVCC.
      1: Even inputs use AnVCC; odd inputs use AnVSS.
      2: Even inputs use AnVSS; odd inputs use AnVCC / 2.
      3: Even inputs use AnVCC / 2; odd inputs use AnVSS.

      This setting applies to pin-level self-diagnostic conversions.
      It does not select the ADcore self-diagnostic voltage.

  renesas,wiring-break-pulse-width:
    type: int
    default: 1
    enum: [1, 2, 3, 4, 5, 6, 7, 8, 9, 10, 11, 12, 13, 14, 15, 16, 17]
    description: |
      Controller-wide pull-down pulse width for wiring-break
      detection mode 1 and its self-diagnostic conversion.

      The value is expressed in internal clock states.
      The ODPW register encoding is this value plus three.

      Wiring-break addition mode is not enabled by this property.

  renesas,trigger-source:
    type: string
    default: "disabled"
    enum: ["disabled", "pic2"]
    description: Hardware trigger route for ADCK. LPS is intentionally excluded.

  renesas,ad-timer-trigger-method:
    type: string
    default: "software"
    enum: ["software", "hardware"]
    description: |
      Method used to start the A/D timer when renesas,trigger-method
      is "ad-timer".

      "software": Start the A/D timer by a software command.
      "hardware": Start the A/D timer by the selected hardware trigger.

  renesas,ad-timer-initial-phase:
    type: int
    default: 0
    description: |
      Initial down-counter value loaded when the A/D timer starts.
      One timer count corresponds to one CLKAD cycle.

      The timer generates the first scan-group start trigger when
      the counter reaches zero. Subsequent triggers use
      renesas,ad-timer-cycle.

      Valid values are 0 through 2097151.

  renesas,ad-timer-cycle:
    type: int
    default: 2097151
    description: |
      Down-counter reload value used after each A/D timer trigger.
      One timer count corresponds to one CLKAD cycle.

      The timer reloads this value and continues generating
      scan-group start triggers until stopped.

      The maximum value is 2097151.

  renesas,th-channel-mask:
    type: int
    default: 0
    description: Bit mask enabling T&H units 0 through 3.

  renesas,th-supported-mask:
    type: int
    required: true
    enum: [0, 15, 63]
    description: |
      Track-and-hold circuits implemented by this ADCK instance.

      Zero means that the instance does not support track and hold.
      0x0f means that T&H0 through T&H3 are implemented.

      This is a SoC capability property and must be provided by the
      SoC Devicetree description. It does not enable track and hold.

  renesas,lower-limit-values:
    type: array
    default: [0, 0, 0, 0, 0, 0, 0, 0]
    description: |
      Lower thresholds for hardware upper/lower limit tables 0 through 7.

      Provide exactly eight entries when overriding this property.
      Entries are 16-bit hardware threshold encodings, not millivolts.
      The encoding depends on the controller data format and addition mode.

  renesas,upper-limit-values:
    type: array
    default: [32767, 32767, 32767, 32767, 32767, 32767, 32767, 32767]
    description: |
      Upper thresholds for hardware upper/lower limit tables 0 through 7.

      Provide exactly eight entries when overriding this property.
      Entries are 16-bit hardware threshold encodings, not millivolts.
      The encoding depends on the controller data format and addition mode.

  renesas,trigger-overlap-interrupt:
    type: boolean
    description: |
      Enable hardware scan-group trigger-overlap detection and
      its error interrupt.

      A trigger received while the same scan group is operating
      is ignored by hardware and can generate an error event.

      The controller must provide an interrupt named error.

io-channel-cells:
  - input

child-binding:
  description: ADCK ADC channel configuration

  properties:
    reg:
      required: true
      description: Zephyr ADC channel ID used in adc_sequence.channels.

    zephyr,gain:
      required: true

    zephyr,reference:
      required: true

    zephyr,acquisition-time:
      required: true

    zephyr,resolution:
      type: int
      enum: [10, 12]
      description: Channel resolution used by Zephyr devicetree helpers.

    renesas,virtual-channel:
      type: int
      description: Hardware virtual channel associated with this Zephyr channel.

    renesas,conversion-type:
      type: string
      default: "normal"
      enum:
        - "normal"
        - "hold"
        - "extended-sampling"
        - "ad-core-self-diagnostic"
        - "addition"
        - "mpx-normal"
        - "mpx-addition"
        - "pin-level-self-diagnostic"
        - "wiring-break-mode-1"
        - "wiring-break-mode-2-pull-down"
        - "wiring-break-mode-2-pull-up"
        - "self-diagnostic-wiring-break-mode-1"
        - "self-diagnostic-wiring-break-mode-2-pull-down"
        - "self-diagnostic-wiring-break-mode-2-pull-up"
        - "ad-conversion-path-diagnostic"
      description: |
        ADCK virtual channel conversion type.
        If omitted, the virtual channel is configured for normal A/D
        conversion. Use "hold" for T&H hold-value conversion channels such as
        T&H00, T&H01, and T&H02.

    renesas,physical-channel:
      type: int
      description: |
        SoC-specific hardware analog input selector associated with this
        Zephyr ADC channel.
        For renesas,conversion-type = "normal", this value selects the normal
        A/D conversion input selector defined by the ADCK channel mapping of
        the target SoC.
        For renesas,conversion-type = "hold", this value selects the T&H hold
        input index:
          0 = T&H0, 1 = T&H1, 2 = T&H2, 3 = T&H3.
        If renesas,conversion-type is omitted, "normal" is used.

    renesas,mpx-value:
      type: int
      default: 0
      enum: [0, 1, 2, 3, 4, 5, 6, 7]
      description: |
        Static external multiplexer selection value.
        Non-zero values are valid only for mpx-normal and mpx-addition.
        The driver supports direct MPXCUR[2:0] output only.

    renesas,wait-table:
      type: int
      default: 0
      enum: [0, 1, 2, 3, 4, 5, 6, 7, 8]
      description: |
        Zero disables wait-table selection.
        Values 1 through 8 select WAITTR0 through WAITTR7.

        MPX conversions require a non-zero selector and a sufficiently
        long wait in the selected table.

        Wait selection is not supported for hold, AD-core self-diagnostic,
        or ADVAL conversions. A scan group containing hold conversions
        must not configure wait for any of its virtual channels.

    renesas,upper-lower-limit-table:
      type: int
      default: 0
      description: Zero disables checking; values 1 through 8 select limit tables 0 through 7.

    renesas,limit-interrupt:
      type: boolean
      description: |
        Enable upper/lower-limit interrupt notification for this
        hardware virtual channel.

        A non-zero renesas,upper-lower-limit-table must also be selected.
        The controller must provide an interrupt named error.

    renesas,self-diagnostic-level:
      type: int
      default: 0
      enum: [0, 4, 8, 12, 16]
      description: AD core self-diagnostic voltage selector encoded by ADCK VCR.GCTRL.

    renesas,adval-data:
      type: int
      default: 0
      enum: [0, 1]
      description: A/D conversion path diagnostic fixed data selector (0xAAA or 0x555).
```

## dts/bindings/adc/renesas,rx-adc-b-controller.yaml
```yaml
# Copyright (c) 2026 Renesas Electronics Corporation
# SPDX-License-Identifier: Apache-2.0

description: Renesas RX ADC-B controller node.

compatible: "renesas,rx-adc-b-controller"

include: [adc-controller.yaml, pinctrl-device.yaml]

properties:
  reg:
    required: true

  "#io-channel-cells":
    const: 1

  clock-div:
    type: int
    required: true
    enum: [1, 2, 3, 4, 5, 6, 7, 8]
    description: |
      Clock divider value for the ADC_B controller clock. The driver uses this
      value along with the clock frequency to calculate timing parameters for
      ADC conversions.

io-channel-cells:
  - input
```
