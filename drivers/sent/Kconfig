## dts/bindings/clock/renesas,rh850-cgc-clock-config.yaml
```yaml
# Copyright (c) 2026 Renesas Electronics Corporation
# SPDX-License-Identifier: Apache-2.0

description: Shared RH850 derived clock configuration

properties:
  clock-source:
    type: phandle
    required: true
    description: Parent clock node, validated against the destination's hardware inputs.

  div:
    type: int
    required: true
    description: |
      Physical division factor relative to clock-source, including any fixed
      prescaler. The derived rate is the parent's rate divided by this value,
      rounded down to integer Hz. This is not a register encoding. Zero is
      valid only for EXTCLK outputs and stops the output. For example WDT
      HSIOSC/640 uses 640; EXTCLK HSIOSC/20/10 uses 200; RLIN MOSC/8 uses 8.
      Fixed bus ratios must match the programmed option-byte clock profile.

  renesas,cyclicrun-clock-source:
    type: phandle
    description: |
      Parent in cyclic-run mode. If absent, use clock-source and evaluate
      that parent's cyclic-run rate.

  renesas,cyclicrun-div:
    type: int
    description: Physical cyclic-run division factor; if absent, use div.

  renesas,pll0-divider:
    type: int
    enum: [0]
    description: |
      Legacy U2A BSP PLL0 divider setting (0 means no division). This field
      currently has no FSP consumer and is not the raw CKD_PLLC encoding.
```

## dts/bindings/clock/renesas,rh850-cgc-pclk.yaml
```yaml
# Copyright (c) 2026 Renesas Electronics Corporation
# SPDX-License-Identifier: Apache-2.0

description: |
  Renesas RH850 peripheral and bus clock configuration.

compatible: "renesas,rh850-cgc-pclk"

include: [base.yaml, clock-controller.yaml, "renesas,rh850-cgc-clock-config.yaml"]

properties:
  clock-source:
    type: phandle
    required: true
    description: |
      Parent/source clock node for this clock in the Zephyr clock
      tree model, for example clk_hsb, clkc_hsb, mosc, hsiosc or lsiosc.

  "#clock-cells":
    const: 0
```

## dts/bindings/clock/renesas,rh850-cgc-sysclk.yaml
```yaml
# Copyright (c) 2026 Renesas Electronics Corporation
# SPDX-License-Identifier: Apache-2.0

description: |
  Renesas RH850 system clock configuration.

compatible: "renesas,rh850-cgc-sysclk"

include: [base.yaml, clock-controller.yaml, "renesas,rh850-cgc-clock-config.yaml"]

properties:
  clock-source:
    type: phandle
    required: true
    description: |
      Parent/source clock node, for example pll, sscg0, sscg1 or iosc.
      This is intentionally a phandle instead of a raw selector number so the
      DTS describes the clock tree clearly. If a future SoC register operation
      needs a raw selector value, the driver should map this phandle plus
      the destination node to the SoC-specific selector encoding.

  modulation-enable:
    type: boolean
    description: Enable SSCG modulation for SYS_SSCG/SYS_SSCG1 paths.

  modulation-value:
    type: int
    default: 30
    description: |
      Raw hardware encoding for SSCG modulation frequency selection.
      Valid values depend on the selected SSCG input clock.
      The default corresponds to the reset value of the SELMFREQ register
      field used by the current FSP BSP clock configuration.

  modulation-dithered-range:
    type: int
    default: 0
    enum:
      - 0
      - 1
      - 2
      - 3
      - 4
    description: |
      Raw SSCG dithered-range encoding:
      0 = -1%, 1 = -2%, 2 = -3%, 3 = -4%, 4 = -5%.
      The default corresponds to the reset value of the SELMPERCENT register
      field used by the current FSP BSP clock configuration.

  "#clock-cells":
    const: 0
```

## dts/bindings/clock/renesas,rx-cgc-subclk.yaml
```yaml
# Copyright (c) 2026 Renesas Electronics Corporation
# SPDX-License-Identifier: Apache-2.0

description: Renesas RX Sub-Clock

compatible: "renesas,rx-cgc-subclk"

include: fixed-clock.yaml

properties:
  drive-capability:
    type: int
    default: 0
    enum:
    - 0
    - 1
    - 2
    - 3
    description: |
      Sub-Clock Oscillator Drive Capability Switching
      - 0: Standard (12.5pf)
      - 1: Lowpower mode 1 (9pf)
      - 2: Lowpower mode 2 (7pf)
      - 3: Lowpower mode 3 (4pf)

  stabilization-time:
    type: int
    default: 1000
    description: |
      Sub-Clock stabilization time in micro seconds
```

## dts/bindings/counter/renesas,rcar-ostm-counter.yaml
```yaml
# Copyright (c) 2026 Renesas Electronics Corporation
# SPDX-License-Identifier: Apache-2.0

description: Renesas R-Car OSTM Counter

compatible: "renesas,rcar-ostm-counter"

include: base.yaml

properties:
  reg:
    required: true

  interrupts:
    required: true

  clocks:
    required: true

  channel:
    type: int
    required: true
```

## dts/bindings/counter/renesas,rx-tmr-counter.yaml
```yaml
# Copyright (c) 2026 Renesas Electronics Corporation
# SPDX-License-Identifier: Apache-2.0

description: Renesas RX TMR Counter

compatible: "renesas,rx-tmr-counter"

include: [base.yaml]
```

## dts/bindings/dma/renesas,rcar-dma.yaml
```yaml
# Copyright (c) 2026 Renesas Electronics Corporation
# SPDX-License-Identifier: Apache-2.0

description: |
  Renesas RCAR DMA Controller

  The following example displays the minimum DMA node layout:

    dma0: dma@ec700000 {
        compatible = "renesas,rcar-dma";
        reg = <0x0xec700000 0x10000>;
        clocks = <&iclk MSTPA 22>;
        dma-channels = <16>;
        #dma-cells = <2>;
        status = "disabled";
    };

  By default, the DMA controller node appears with `status = "disabled"`.
  To enable and use the DMA controller, add an overlay that sets `status = "okay"`
  and provides the required `interrupts` and `interrupt-names` properties.

  Example overlay to enable the DMA controller for specific channels:

    &dma0 {
        status = "okay";
        interrupts = <95 1>, <94 1>;
        interrupt-names = "ch0", "ch1";
    };

  Note:
  - The `interrupts` property specifies only the channels intended for use.
    It is not necessary to declare interrupts for all available DMA channels;
    just include entries for the channels intended for use.
  - The `interrupt-names` property provides human-readable names corresponding
    to each interrupt, typically matching the channel number.

compatible: "renesas,rcar-dma"

include: [dma-controller.yaml, base.yaml]

properties:
  reg:
    required: true

  interrupts:
    required: true

  interrupt-names:
    required: true
    description: |
      The `interrupt-names` property is required and must be specified as an array,
      with one entry for each DMA channel in use.
      Each entry must strictly follow the format "chX", where X is the DMA channel number.
      The order of entries must correspond to the channels defined in the `interrupts` property.

      Example:
        interrupt-names = "ch0", "ch1";

      In this example, "ch0" and "ch1" are the interrupt names assigned to DMA Channel 0 and
      DMA Channel 1, each corresponding to its respective entry in the `interrupts` property.

  dma-channels:
    required: true

  dma-type:
    type: string
    description: |
      Type DMAC, each DMAC support for each different kind of Peripheral trigger event.
    enum:
      - RT-DMAC
      - SYS-DMAC
      - Audio-DMAC
      - SCP-DMAC
      - RTT-DMAC

  channel:
    type: int
    description: |
      DMAC channel index
      e.g.:
        - audio-dmac2 => type: Audio-DMAC, channel: 2
        - sys-dmac12 => type: SYS-DMAC, channel: 3
        - sys-dmac10 => type: SYS-DMAC, channel: 1

  "#dma-cells":
    const: 2

dma-cells:
  - channel
  - slot
```
