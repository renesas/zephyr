## drivers/sent/Kconfig
```kconfig
# Copyright 2025 NXP
# SPDX-License-Identifier: Apache-2.0

menuconfig SENT
	bool "Single Edge Nibble Transmission (SENT) drivers"
	help
	  Enable SENT Driver Configuration

if SENT

module = SENT
module-str = sent
source "subsys/logging/Kconfig.template.log_config"

config SENT_INIT_PRIORITY
	int "SENT driver init priority"
	default KERNEL_INIT_PRIORITY_DEVICE
	help
	  SENT driver device initialization priority.

source "drivers/sent/Kconfig.nxp_s32"
source "drivers/sent/Kconfig.renesas_rh850"

endif # SENT
```

## drivers/sent/Kconfig.renesas_rh850
```kconfig
# Copyright (c) 2026 Renesas Electronics Corporation
# SPDX-License-Identifier: Apache-2.0

config SENT_RENESAS_RH850
	bool "Renesas RH850 RSENT driver"
	default y
	depends on DT_HAS_RENESAS_RH850_SENT_ENABLED
	depends on SOC_FAMILY_RENESAS_RH850
	select PINCTRL
	select USE_RH850_FSP_RSENT_SENT
	select CLOCK_CONTROL
	select CLOCK_CONTROL_RENESAS_RH850_CGC
	help
	  Enable the Zephyr SENT driver for the Renesas RH850 RSENT
	  receiver peripheral.

	  This driver uses the Renesas FSP RSENT implementation and
	  exposes it through the generic Zephyr SENT API.

config SENT_RENESAS_RH850_SERIAL_SHORT_FRAME
	int "Number of frames for SENT short serial message"
	default 16
	range 1 255
	help
	  Set the number of frames required to receive a complete
	  SENT short serial message.

	  The default value is 16. This value can be changed to support
	  sensors that use a different number of frames.

config SENT_RENESAS_RH850_SERIAL_ENHANCED_FRAME
	int "Number of frames for SENT enhanced serial message"
	default 18
	range 1 255
	help
	  Set the number of frames required to receive a complete
	  SENT enhanced serial message.

	  The default value is 18. This value can be changed to support
	  sensors that use a different number of frames.
```

## drivers/serial/Kconfig.renesas_rx
```kconfig
# Copyright (c) 2024-2025 Renesas Electronics Corporation
# SPDX-License-Identifier: Apache-2.0

config UART_RENESAS_RX
	bool "Renesas RX Series UART Driver"
	default y
	depends on DT_HAS_RENESAS_RX_UART_SCI_ENABLED
	select SERIAL_HAS_DRIVER
	select SERIAL_SUPPORT_INTERRUPT
	select SERIAL_SUPPORT_ASYNC
	select USE_RX_RDP_SCI_UART
	select RENESAS_RX_DTC if UART_ASYNC_API
	select PINCTRL
	help
	  Enable Renesas RX series UART driver.

config UART_RENESAS_RX_SCI_B
	bool "Renesas RX Series UART Driver"
	default y
	depends on DT_HAS_RENESAS_RX_UART_SCI_B_ENABLED
	select SERIAL_HAS_DRIVER
	select SERIAL_SUPPORT_INTERRUPT
	select USE_RX_FSP_SCI_B_UART
	select PINCTRL
	help
	  Enable Renesas RX series UART on SCI B HW driver.

if UART_RENESAS_RX_SCI_B && (UART_INTERRUPT_DRIVEN || UART_ASYNC_API)

config UART_RENESAS_RX_SCI_B_UART_FIFO_ENABLE
	bool "RX SCI_B UART FIFO usage enable"
	default y if UART_INTERRUPT_DRIVEN
	default n if UART_ASYNC_API
	help
	  Enable RX SCI_B FIFO

endif
```

## drivers/usb/udc/Kconfig.renesas_rx
```kconfig
# Copyright (c) 2025 Renesas Electronics Corporation
# SPDX-License-Identifier: Apache-2.0

config UDC_RENESAS_RX
	bool "Renesas RX family UDC driver"
	default y
	depends on DT_HAS_RENESAS_RX_UDC_ENABLED
	select USE_RX_FSP_USB_DEVICE
	select UDC_DRIVER_HAS_HIGH_SPEED_SUPPORT
	select PINCTRL
	help
	  Enable Renesas RX family UDC driver.

if UDC_RENESAS_RX

config UDC_RENESAS_RX_STACK_SIZE
	int "UDC controller driver internal thread stack size"
	default 512
	help
	  Renesas RX device controller driver internal thread stack size.

config UDC_RENESAS_RX_THREAD_PRIORITY
	int "Renesas RX family UDC driver thread priority"
	default 8
	help
	  Renesas RX device controller driver thread priority.

config UDC_RENESAS_RX_MAX_QMESSAGES
	int "Renesas RX family UDC driver maximum number of ISR event messages"
	range 4 64
	default 8
	help
	  Maximum number of messages for handling of Renesas RX USBD ISR events.

endif
```

## drivers/video/Kconfig.renesas_ra_vin
```kconfig
# Copyright (c) 2026 Renesas Electronics Corporation
# SPDX-License-Identifier: Apache-2.0

config VIDEO_RENESAS_RA_VIN
	bool
	default y
	depends on DT_HAS_RENESAS_RA_VIN_ENABLED
	select PINCTRL
	select CLOCK_CONTROL
	select USE_RA_FSP_VIN
	select USE_RA_FSP_MIPI_CSI
	help
	  Enable Renesas RA VIN driver.
```

## drivers/watchdog/Kconfig.renesas_rcar
```kconfig
# Copyright (c) 2026 Renesas Electronics Corporation
# SPDX-License-Identifier: Apache-2.0

config WDT_RENESAS_RCAR
	bool "Window Watchdog Timer Driver for Renesas R-Car"
	default y
	depends on DT_HAS_RENESAS_RCAR_WWDT_ENABLED
	select USE_RCARSOC_DRV_WATCHDOG
	select USE_RCARSOC_DRV_ECM
	help
	  Enable Window Watchdog Timer driver for Renesas R-Car
```

## drivers/watchdog/Kconfig.renesas_rx
```kconfig
# Renesas RX Watchdog configuration

# Copyright (c) 2025 Renesas Electronics Corporation
# SPDX-License-Identifier: Apache-2.0

config WDT_RENESAS_RX_IWDT
	bool "Renesas RX Series Independent Watchdog Driver"
	default y
	depends on DT_HAS_RENESAS_RX_IWDT_ENABLED
	select HAS_WDT_DISABLE_AT_BOOT if WDT_RENESAS_RX_IWDT_REGISTER_START_MODE
	select USE_RX_RDP_IWDT
	help
	  Enable Renesas RX series watchdog driver.

if WDT_RENESAS_RX_IWDT

config WDT_RENESAS_RX_IWDT_USE_NMI
	bool "Non-maskable interrupt for IWDT"
	default y
	help
	  Enable NMI for IWDT.

choice
	prompt "IWDT Start Mode"
	default WDT_RENESAS_RX_IWDT_REGISTER_START_MODE
	help
	  Select the IWDT start mode.
	  - WDT_RENESAS_RX_IWDT_AUTO_START_MODE: Counting automatically starts after a reset
	  (auto-start mode), controlled by option function select register 0 (OFS0).
	  - WDT_RENESAS_RX_IWDT_REGISTER_START_MODE: Counting is started by refreshing the counter.
	  (controlled by the IWDT registers)

config WDT_RENESAS_RX_IWDT_AUTO_START_MODE
	bool "Start IWDT automatically on reset"

config WDT_RENESAS_RX_IWDT_REGISTER_START_MODE
	bool "IWDT Start Mode Select"

endchoice

endif # WDT_RENESAS_RX_IWDT

config WDT_RENESAS_RX_IWDT_FSP
	bool "Renesas RX Series Independent Watchdog Driver using FSP"
	default y
	depends on DT_HAS_RENESAS_RX_IWDT_FSP_ENABLED
	select USE_RX_FSP_IWDT
	help
	  Enable Renesas RX series watchdog driver using FSP

if WDT_RENESAS_RX_IWDT_FSP

config WDT_RENESAS_RX_IWDT_IRQ
	bool "Interrupt request on IWDT underflow/refresh error"
	default y
	help
	  Respond to an IWDT underflow or refresh error with the IWUNI interrupt
	  (wdt_timeout_cfg callback) instead of only allowing a direct SoC reset.

endif # WDT_RENESAS_RX_IWDT_FSP
```
