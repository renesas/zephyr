## dts/bindings/adc/renesas,rx-adc-b.yaml
```yaml
# Copyright (c) 2026 Renesas Electronics Corporation
# SPDX-License-Identifier: Apache-2.0

description: |
  Renesas RX ADC_B converter unit node.

  Represents one ADC converter (ADC0, ADC1 or ADC2) of the ADC_B
  controller. This is the Zephyr ADC device that applications reference
  through io-channels.

  Each channel child node is one virtual channel. It maps a physical
  analog input (zephyr,input-positive) to a scan-group via the
  renesas,scan-group phandle. The scan-group, in turn, selects the
  converter that runs it (see renesas,rx-adc-b-scan-group). A channel
  must therefore be placed under the adc-unit whose unit-id matches the
  scan-group's renesas,converter-unit-id.

  The calibration-end and conversion-error interrupts of each converter
  are routed through the RX group interrupt controller (group_irq_al5),
  while the scan-end interrupt belongs to the scan-group node.

  Example:
    zephyr,user {
        io-channels = <&adc0 0>, <&adc0 1>;
    };

    &adc0 {
        channel@0 {
            reg = <0>;
            zephyr,gain = "ADC_GAIN_1";
            zephyr,reference = "ADC_REF_INTERNAL";
            zephyr,resolution = <16>;
            zephyr,acquisition-time = <ADC_ACQ_TIME_DEFAULT>;
            zephyr,input-positive = <0>;
            zephyr,oversampling = <2>;
            renesas,scan-group = <&scan_group0>;
        };
    };

compatible: "renesas,rx-adc-b"

include: [adc-controller.yaml, pinctrl-device.yaml]

properties:
  unit-id:
    type: int
    required: true
    enum: [0, 1, 2]
    description: |
      ADC converter ID (0 for ADC0, 1 for ADC1, 2 for ADC2).

  channel-available-mask:
    type: int
    required: false
    description: |
      Bitmask of physical analog channels this converter can sample.
      The driver uses it to validate zephyr,input-positive of each
      channel.

  interrupts:
    required: false
    description: |
      Calibration-end and conversion-error interrupts for this converter
      unit (both routed through the RX group interrupt controller).

  interrupt-names:
    required: false
    description: |
      Interrupt names for this converter unit, e.g. "calend", "convserr".

  vref-mv:
    type: int
    required: false
    description: ADC reference voltage in millivolts for this unit.

  pinctrl-0:
    required: false

  pinctrl-names:
    required: false

  "#io-channel-cells":
    const: 1

  "#address-cells":
    type: int
    required: true
    const: 1

  "#size-cells":
    type: int
    required: true
    const: 0

  renesas,adc-method:
    type: string
    default: "oversample"
    enum: ["sar", "oversample", "hybrid"]
    description: |
      Conversion method for this converter. Determines how each virtual
      channel under this unit is converted:

        - "sar": every channel uses Successive Approximation, one
          conversion per trigger, up to 12-bit. Digital filter disabled.
          zephyr,oversampling on a channel is ignored.

        - "oversample": every channel is oversampled, multiple conversions
          per trigger averaged in hardware, up to 16-bit. Digital filter
          enabled. zephyr,oversampling on each channel selects the average
          count (2^N samples); if omitted it defaults to no averaging.

        - "hybrid": channels may mix SAR and oversampling within the same
          converter. Each channel decides individually via
          zephyr,oversampling: 0 (or omitted) runs SAR (<=12-bit),
          >=1 runs oversampling with 2^N averaging (<=16-bit). Use this
          when some channels need speed (SAR) and others need precision
          (oversample) on the same converter.

io-channel-cells:
  - input

child-binding:
  description: |
    Virtual channel under this ADC_B unit.

  properties:
    renesas,scan-group:
      type: phandle
      required: true
      description: |
        Selects the scan-group this virtual channel belongs to. The
        scan-group's renesas,converter-unit-id MUST equal this
        adc-unit's unit-id (the driver enforces this with BUILD_ASSERT
        so a mismatch fails the build).

        zephyr,input-positive of the channel must also be within the
        channel-available-mask of this adc-unit.
```

## dts/bindings/audio/asahi-kasei,ak4619.yaml
```yaml
# Copyright (c) 2026 Renesas Electronics Corporation
# SPDX-License-Identifier: Apache-2.0

description: |
  AKM AK4619VN 4-channel 192kHz Audio CODEC.

compatible: "asahi-kasei,ak4619"

include: i2c-device.yaml

properties:
  pdn-gpios:
    type: phandle-array
    required: true
    description: GPIO connected to the PDN pin (active high).

  adc1-disable:
    type: boolean
    description: |
      ADC1 channel is not wired up on this board; keep PMAD1 powered down
      regardless of the requested audio route.

  adc2-disable:
    type: boolean
    description: |
      ADC2 channel is not wired up on this board; keep PMAD2 powered down
      regardless of the requested audio route.

  dac1-disable:
    type: boolean
    description: |
      DAC1 channel is not wired up on this board; keep PMDA1 powered down
      regardless of the requested audio route.

  dac2-disable:
    type: boolean
    description: |
      DAC2 channel is not wired up on this board; keep PMDA2 powered down
      regardless of the requested audio route.

  mclk:
    type: phandle-array
    specifier-space: clock
    required: true
    description: |
      MCLK clock provider.

  mic1-gain-l-mode:
    type: int
    default: 2
    description: |
      MGN1L[3:0] mic gain amp mode for ADC1 left channel.
      The following options are available:
      - 0: -6dB
      - 1: -3dB
      - 2: 0dB (default)
      - 3: 3dB
      - 4: 6dB
      - 5: 9dB
      - 6: 12dB
      - 7: 15dB
      - 8: 18dB
      - 9: 21dB
      - 10: 24dB
      - 11: 27dB
    enum:
      - 0
      - 1
      - 2
      - 3
      - 4
      - 5
      - 6
      - 7
      - 8
      - 9
      - 10
      - 11

  mic1-gain-r-mode:
    type: int
    default: 2
    description: |
      MGN1R[3:0] mic gain amp mode for ADC1 right channel.
      The following options are available:
      - 0: -6dB
      - 1: -3dB
      - 2: 0dB (default)
      - 3: 3dB
      - 4: 6dB
      - 5: 9dB
      - 6: 12dB
      - 7: 15dB
      - 8: 18dB
      - 9: 21dB
      - 10: 24dB
      - 11: 27dB
    enum:
      - 0
      - 1
      - 2
      - 3
      - 4
      - 5
      - 6
      - 7
      - 8
      - 9
      - 10
      - 11

  mic2-gain-l-mode:
    type: int
    default: 2
    description: |
      MGN2L[3:0] mic gain amp mode for ADC2 left channel.
      The following options are available:
      - 0: -6dB
      - 1: -3dB
      - 2: 0dB (default)
      - 3: 3dB
      - 4: 6dB
      - 5: 9dB
      - 6: 12dB
      - 7: 15dB
      - 8: 18dB
      - 9: 21dB
      - 10: 24dB
      - 11: 27dB
    enum:
      - 0
      - 1
      - 2
      - 3
      - 4
      - 5
      - 6
      - 7
      - 8
      - 9
      - 10
      - 11

  mic2-gain-r-mode:
    type: int
    default: 2
    description: |
      MGN2R[3:0] mic gain amp mode for ADC2 right channel.
      The following options are available:
      - 0: -6dB
      - 1: -3dB
      - 2: 0dB (default)
      - 3: 3dB
      - 4: 6dB
      - 5: 9dB
      - 6: 12dB
      - 7: 15dB
      - 8: 18dB
      - 9: 21dB
      - 10: 24dB
      - 11: 27dB
    enum:
      - 0
      - 1
      - 2
      - 3
      - 4
      - 5
      - 6
      - 7
      - 8
      - 9
      - 10
      - 11

  adc1-filter-mode:
    type: int
    default: 0
    description: |
      AD1VO/AD1SD/AD1SL digital filter mode for ADC1.
      The following options are available:
      - 0: Sharp Roll-Off Filter (default)
      - 1: Slow Roll-Off Filter
      - 2: Short Delay Sharp Roll-Off Filter
      - 3: Short Delay Slow Roll-Off Filter
      - 4: Voice Filter (fs <= 48kHz only)
    enum:
      - 0
      - 1
      - 2
      - 3
      - 4

  adc2-filter-mode:
    type: int
    default: 0
    description: |
      AD2VO/AD2SD/AD2SL digital filter mode for ADC2.
      The following options are available:
      - 0: Sharp Roll-Off Filter (default)
      - 1: Slow Roll-Off Filter
      - 2: Short Delay Sharp Roll-Off Filter
      - 3: Short Delay Slow Roll-Off Filter
      - 4: Voice Filter (fs <= 48kHz only)
    enum:
      - 0
      - 1
      - 2
      - 3
      - 4

  dac1-filter-mode:
    type: int
    default: 2
    description: |
      DA1SD/DA1SL digital filter mode for DAC1.
      The following options are available:
      - 0: Sharp Roll-Off Filter
      - 1: Slow Roll-Off Filter
      - 2: Short Delay Sharp Roll-Off Filter (default)
      - 3: Short Delay Slow Roll-Off Filter
    enum:
      - 0
      - 1
      - 2
      - 3

  dac2-filter-mode:
    type: int
    default: 2
    description: |
      DA2SD/DA2SL digital filter mode for DAC2.
      The following options are available:
      - 0: Sharp Roll-Off Filter
      - 1: Slow Roll-Off Filter
      - 2: Short Delay Sharp Roll-Off Filter (default)
      - 3: Short Delay Slow Roll-Off Filter
    enum:
      - 0
      - 1
      - 2
      - 3

  dac1-input:
    type: int
    default: 0
    description: |
      DAC1SEL[1:0] PCM source select for DAC1.
      The following options are available:
      - 0: SDIN1 (default)
      - 1: SDIN2
      - 2: SDOUT1
      - 3: SDOUT2
    enum:
      - 0
      - 1
      - 2
      - 3

  dac2-input:
    type: int
    default: 1
    description: |
      DAC2SEL[1:0] PCM source select for DAC2.
      The following options are available:
      - 0: SDIN1
      - 1: SDIN2 (default)
      - 2: SDOUT1
      - 3: SDOUT2
    enum:
      - 0
      - 1
      - 2
      - 3

  dac1-deemphasis:
    type: boolean
    description: |
      Enable the DAC1 de-emphasis IIR filter.
      Only takes effect when the sampling rate is 32kHz, 44.1kHz, or 48kHz and
      the audio route includes playback; otherwise the filter is kept OFF.

  dac2-deemphasis:
    type: boolean
    description: |
      Enable the DAC2 de-emphasis IIR filter.
      Only takes effect when the sampling rate is 32kHz, 44.1kHz, or 48kHz and
      the audio route includes playback; otherwise the filter is kept OFF.

  adc1-l-input-mode:
    type: string
    default: "differential"
    description: |
      AD1LSEL[1:0] input mode for ADC1 left channel.
      The following options are available:
      - "differential": 00, IN1P/IN1N (default)
      - "single-ended-1": 01, AIN1L
      - "single-ended-2": 10, AIN2L
      - "pseudo-differential": 11, AIN3L/GND3L
    enum:
      - "differential"
      - "single-ended-1"
      - "single-ended-2"
      - "pseudo-differential"

  adc1-r-input-mode:
    type: string
    default: "differential"
    description: |
      AD1RSEL[1:0] input mode for ADC1 right channel.
      The following options are available:
      - "differential": 00, IN2P/IN2N (default)
      - "single-ended-1": 01, AIN1R
      - "single-ended-2": 10, AIN2R
      - "pseudo-differential": 11, AIN3R/GND3R
    enum:
      - "differential"
      - "single-ended-1"
      - "single-ended-2"
      - "pseudo-differential"

  adc2-l-input-mode:
    type: string
    default: "differential"
    description: |
      AD2LSEL[1:0] input mode for ADC2 left channel.
      The following options are available:
      - "differential": 00, IN3P/IN3N (default)
      - "single-ended-1": 01, AIN4L
      - "single-ended-2": 10, AIN5L
      - "pseudo-differential": 11, AIN6L/GND6L
    enum:
      - "differential"
      - "single-ended-1"
      - "single-ended-2"
      - "pseudo-differential"

  adc2-r-input-mode:
    type: string
    default: "differential"
    description: |
      AD2RSEL[1:0] input mode for ADC2 right channel.
      The following options are available:
      - "differential": 00, IN4P/IN4N (default)
      - "single-ended-1": 01, AIN4R
      - "single-ended-2": 10, AIN5R
      - "pseudo-differential": 11, AIN6R/GND6R
    enum:
      - "differential"
      - "single-ended-1"
      - "single-ended-2"
      - "pseudo-differential"
```

## dts/bindings/can/renesas,rh850-canfd-global.yaml
```yaml
# Copyright (c) 2026 Renesas Electronics Corporation
# SPDX-License-Identifier: Apache-2.0

description: Renesas RH850 CANFD controller global

compatible: "renesas,rh850-canfd-global"

include: [base.yaml]

properties:
  clocks:
    required: true
    description: Module clock shared by all CAN FD channels in this unit.

  unit:
    type: int
    required: true
    description: CAN FD unit index

  interrupts:
    required: true
```

## dts/bindings/can/renesas,rx-canfd-global.yaml
```yaml
# Copyright (c) 2025 Renesas Electronics Corporation
# SPDX-License-Identifier: Apache-2.0

description: Renesas RX CANFD controller global

compatible: "renesas,rx-canfd-global"

include: [base.yaml]

properties:
  clocks:
    required: true

  clock-names:
    required: true

  dll-min-freq:
    type: int
    description: |
      Specifies the Data Link Layer clock limit on this device: DLL clock frequency > dll-min-freq.

  dll-max-freq:
    type: int
    description: |
      Specifies the Data Link Layer clock limit on this device: DLL clock frequency <= dll-max-freq.
```

## dts/bindings/can/renesas,rx-canfd.yaml
```yaml
# Copyright (c) 2025 Renesas Electronics Corporation
# SPDX-License-Identifier: Apache-2.0

description: Renesas RX CANFD controller

compatible: "renesas,rx-canfd"

include: [can-fd-controller.yaml, pinctrl-device.yaml]

properties:
  clocks:
    required: true

  clock-names:
    required: true

  channel:
    type: int
    required: true

  rx-max-filters:
    type: int
    default: 64
    description: |
      To determine the maximum number of rx filters in the Acceptance Filter List can be added on this CAN device.
      The total number of filters must be less than or equal to 64 per channel.
```

## dts/bindings/clock/renesas,r8a78000-clkc-mdlc.yaml
```yaml
# Copyright (c) 2026 Renesas Electronics Corporation
# SPDX-License-Identifier: Apache-2.0

description: Renesas R8A78000 SoC Clock Controller(CLKC) / Module Controller(MDLC)

compatible: "renesas,r8a78000-clkc-mdlc"

include: [clock-controller.yaml, base.yaml]

properties:
  reg:
    required: true

  "#clock-cells":
    const: 2

clock-cells:
  - domain
  - module
```

## dts/bindings/clock/renesas,ra-cgc-pclk-block.yaml
```yaml
# Copyright (c) 2024-2026 Renesas Electronics Corporation
# SPDX-License-Identifier: Apache-2.0

description: Renesas RA Clock Control node pclk block

compatible: "renesas,ra-cgc-pclk-block"

include: [clock-controller.yaml, base.yaml]

properties:
  secure-clocks:
    type: boolean
    description: |
      The CGC registers are owned by a secure image. A non-secure image does not configure the
      clock tree directly, it reads clock dividers and clock source selections through secure
      veneers or a secure service API.
```

## dts/bindings/clock/renesas,rcar-adg.yaml
```yaml
# Copyright (c) 2026 Renesas Electronics Corporation
# SPDX-License-Identifier: Apache-2.0

description: Renesas R-Car Audio Clock Generator

compatible: "renesas,rcar-adg"

include: [clock-controller.yaml, base.yaml]

properties:
  reg:
    required: true

  clocks:
    required: true

  clock-names:
    required: true

  audio-clkout-sel:
    type: array
    required: true
    description: |
      Selects the clock output to AUDIO_CLKOUT0, AUDIO_CLKOUT1, AUDIO_CLKOUT2, AUDIO_CLKOUT3 pins.
      e.g. audio-clkout-sel = <ADG_CLKSRC(BRGB) ADG_CLKSRC(AVB0) ADG_CLKSRC(AVB1) ADG_CLKSRC(AVB2)>;

  brga-clk-sel:
    type: int
    required: true
    description: |
      Selects the clock input for BRGA. Use ADG_BRGSRC(CLKA|CLKB|CLKC|S0D4).

  brgb-clk-sel:
    type: int
    required: true
    description: |
      Selects the clock input for BRGB. Use ADG_BRGSRC(CLKA|CLKB|CLKC|S0D4).

  "#clock-cells":
    const: 1

clock-cells:
  - clock_source
```
