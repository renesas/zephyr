## dts/bindings/i2c/renesas,rh850-iic.yaml
```yaml
# Copyright (c) 2026 Renesas Electronics Corporation
# SPDX-License-Identifier: Apache-2.0

description: Renesas RH850 I2C Controller

compatible: "renesas,rh850-iic"

include: [i2c-controller.yaml, pinctrl-device.yaml]

properties:
  reg:
    required: true

  channel:
    required: true
    type: int

  interrupts:
    required: true

  rise-time-ns:
    type: int
    default: 120

  fall-time-ns:
    type: int
    default: 120

  duty-cycle-percent:
    type: int
    default: 50

  interrupt-priority-level:
    type: int
    default: 12
```

## dts/bindings/interrupt-controller/renesas,rh850-intc.yaml
```yaml
# Copyright (c) 2026 Renesas Electronics Corporation
# SPDX-License-Identifier: Apache-2.0

description: Renesas RH850 Interrupt controller (INTC)
compatible: "renesas,rh850-intc"

include: [interrupt-controller.yaml, base.yaml]

properties:
  reg:
    required: true

  "#interrupt-cells":
    const: 2

interrupt-cells:
  - irq
  - priority
```

## dts/bindings/memory-controllers/renesas,ra-sdram.yaml
```yaml
# Copyright (c) 2024 Renesas Electronics Corporation
# SPDX-License-Identifier: Apache-2.0

description: Renesas RA sdram controller.

compatible: "renesas,ra-sdram"

include: [base.yaml, pinctrl-device.yaml, "zephyr,memory-region.yaml"]

properties:
  reg:
    required: true

  pinctrl-0:
    required: true

  pinctrl-names:
    required: true
```

## dts/bindings/rtc/renesas,rh850-rtc.yaml
```yaml
# Copyright (c) 2026 Renesas Electronics Corporation
# SPDX-License-Identifier: Apache-2.0

description: Renesas RH850 RTC

compatible: "renesas,rh850-rtc"

include:
  - rtc.yaml
  - rtc-device.yaml

properties:
  reg:
    required: true

  interrupts:
    required: true

  interrupt-names:
    required: true
    enum:
      - "one_second"
      - "periodic"
      - "alarm"
    description: |
      - "one_second": one-second interrupt
      - "periodic": periodic interrupt
      - "alarm": alarm interrupt

  clock-frequency:
    type: int
    required: true
    description: clock frequency for RTC counter
```

## dts/bindings/serial/renesas,ra8-uart-sci-b.yaml
```yaml
# Copyright (c) 2024 Renesas Electronics Corporation
# SPDX-License-Identifier: Apache-2.0

description: Renesas RA SCI_B UART controller

compatible: "renesas,ra8-uart-sci-b"

include: [pinctrl-device.yaml, uart-controller.yaml]

properties:
  channel:
    type: int
    required: true

  tx-dtc:
    type: boolean

  rx-dtc:
    type: boolean

  reg:
    required: true

  pinctrl-0:
    required: true

  pinctrl-names:
    required: true

  interrupts:
    required: true

  interrupt-names:
    required: true
```

## dts/bindings/spi/renesas,rh850-spi.yaml
```yaml
# Copyright (c) 2026 Renesas Electronics Corporation
# SPDX-License-Identifier: Apache-2.0

description: RENESAS RH850 SPI

compatible: "renesas,rh850-spi"

include: [spi-controller.yaml, pinctrl-device.yaml]

properties:
  reg:
    required: true

  channel:
    type: int
    required: true
    description: |
      The channel of MSPI unit

  tx-dtc:
    type: boolean

  rx-dtc:
    type: boolean

  spi-sck-cs-delay:
    type: int
    description: |
      A delay between the stop of clock signal and
      deactivating Chip Select at the stop of transfer.
      If not set, the default value is used.
      This value will be used to configurate the MSPInHOLDm register.
      Delay time = MSPInHOLDm * MSPInCLK
      This value will affect to all inner CS signals of SPI module when active.
      This value will not be applied for CS lines controlled by GPIO.

  spi-cs-sck-delay:
    type: int
    description: |
      A delay between activating Chip Select and the start
      of clock signal at the start of transfer.
      If not set, the default value is used.
      This value will be used to configurate the MSPInSEUPm register.
      Delay time = MSPInSEUPm * MSPInCLK
      This value will affect to all inner CS signals of SPI module when active.
      This value will not be applied for CS lines controlled by GPIO.

  spi-cs-cs-delay:
    type: int
    description: |
      A delay between deactivating Chip Select at the stop
      of previous transfer and activating Chip Select at the start of
      next transfer.
      If not set, the default value is used.
      This value will be used to configurate the MSPInIDLEm register.
      Delay time = MSPInIDLEm * MSPInCLK
      This value will affect to all inner CS signals of SPI module when active.
      This value will not be applied for CS lines controlled by GPIO.

  spi-sck-sck-delay:
    type: int
    description: |
      A delay between clock operation stop and clock
      operation start between two frames with same configuration.
      If not set, the default value is used.
      This value will be used to configurate the MSPInINDAm register.
      Delay time = MSPInINDAm * MSPInCLK
      This value will affect to all inner CS signals of SPI module when active.
      This value will not be applied for CS lines controlled by GPIO.
```

## dts/bindings/usb/renesas/renesas,ra-usbfs.yaml
```yaml
# Copyright (c) 2024 Renesas Electronics Corporation
# SPDX-License-Identifier: Apache-2.0

description: Renesas RA USB full-speed controller

compatible: "renesas,ra-usbfs"

include: [pinctrl-device.yaml, usb-ep.yaml]

properties:
  reg:
    required: true

  phys:
    type: phandle
    description: PHY provider specifier

  bus-wait-cycles:
    type: int
    description: Specifies CPU bus access wait cycles
```

## dts/bindings/watchdog/renesas,rh850-wdtb.yaml
```yaml
# Copyright (c) 2026 Renesas Electronics Corporation
# SPDX-License-Identifier: Apache-2.0

description: Renesas RH850 Watchdog Timer (wdtb)

compatible: "renesas,rh850-wdtb"

include: base.yaml

properties:
  reg:
    required: true

  unit:
    required: true
    type: int

  window-open-mode:
    type: string
    description: Window open function mode selection
    required: true
    enum:
      - "select-by-window-start"
      - "set-by-worst"

  error-mode:
    type: string
    description: Error mode setting
    required: true
    enum:
      - "nmi-mode"
      - "reset-mode"

  clock-freq:
    type: int
    description: watchdog WDTBTCKI clock frequency (Hz)
    required: true
```

## modules/rh850_core/Kconfig
```kconfig
# Copyright (c) 2026 Renesas Electronics Corporation
# SPDX-License-Identifier: Apache-2.0

config ZEPHYR_RH850_CORE_MODULE
	bool

config HAS_RH850_CORE
	bool
```

## samples/net/cloud/aws_iot_mqtt/boards/ek_ra8m1.conf
```kconfig
CONFIG_ENTROPY_DEVICE_RANDOM_GENERATOR=y

CONFIG_NET_DHCPV4=y
CONFIG_NET_DHCPV4_INITIAL_DELAY_MAX=2

CONFIG_NET_L2_ETHERNET=y
CONFIG_ETH_DRIVER=y
CONFIG_DEBUG=y
CONFIG_NET_L2_ETHERNET_LOG_LEVEL_DBG=y
```

## samples/net/cloud/aws_iot_mqtt/boards/mck_ra8t1.conf
```kconfig
# Copyright (c) 2024 Renesas Electronics Corporation
# SPDX-License-Identifier: Apache-2.0

CONFIG_ENTROPY_DEVICE_RANDOM_GENERATOR=y

CONFIG_NET_DHCPV4=y
CONFIG_NET_DHCPV4_INITIAL_DELAY_MAX=2
```

## samples/net/dhcpv4_client/boards/ek_ra8d1.conf
```kconfig
# Copyright (c) 2024 Renesas Electronics Corporation
# SPDX-License-Identifier: Apache-2.0

CONFIG_NET_L2_ETHERNET=y
```

## samples/net/dhcpv4_client/boards/pb_rh850u2c_292pin_r7f702600fabb-c.conf
```kconfig
# Copyright (c) 2026 Renesas Electronics Corporation
# SPDX-License-Identifier: Apache-2.0

CONFIG_NET_L2_ETHERNET=y
CONFIG_SPEED_OPTIMIZATIONS=y
CONFIG_POSIX_API=n
```

## samples/subsys/task_wdt/boards/pb_rh850u2a_516pin_r7f702300ebbg-c.conf
```kconfig
# Copyright (c) 2026 Renesas Electronics Corporation
# SPDX-License-Identifier: Apache-2.0

# Due to IAR RH850 does not support alloca function so
# the Zephyr logging module only use deferred mode
CONFIG_LOG_MODE_IMMEDIATE=n
CONFIG_LOG_MODE_DEFERRED=y
```

## soc/renesas/ra/ra8/Kconfig.soc
```kconfig
# Copyright (c) 2024 Renesas Electronics Corporation
# SPDX-License-Identifier: Apache-2.0


config SOC_SERIES_RA8
	bool
	select SOC_FAMILY_RENESAS_RA
	help
		Renesas RA8 series

config SOC_R7FA8M1AHECBD
	bool
	select SOC_SERIES_RA8
	help
		R7FA8M1AHECBD

config SOC_SERIES
	default "ra8" if SOC_SERIES_RA8

config SOC
	default "ra8m1" if SOC_R7FA8M1AHECBD
```

## soc/renesas/rcar/rcar_gen5/Kconfig.soc
```kconfig
# Copyright (c) 2026 Renesas Electronics Corporation
# SPDX-License-Identifier: Apache-2.0

config SOC_SERIES_RCAR_GEN5
	bool
	select SOC_FAMILY_RENESAS_RCAR

config SOC_R8A7800_R52
	bool
	select SOC_SERIES_RCAR_GEN5
	help
	  r8a7800 r52

config SOC_SERIES
	default "rcar_gen5" if SOC_SERIES_RCAR_GEN5

config SOC
	default "r8a7800" if SOC_R8A7800_R52
```

## soc/renesas/rh850/rh850u2b/Kconfig.soc
```kconfig
# SPDX-License-Identifier: Apache-2.0

config SOC_SERIES_RH850U2B
	bool
	select SOC_FAMILY_RENESAS_RH850
	help
	  Renesas RH850U2B series

config SOC_R7F70254XFABG_C
	bool
	select SOC_SERIES_RH850U2B

config SOC_R7F70254XFABA_C
	bool
	select SOC_SERIES_RH850U2B

config SOC_R7F70254XFABB_C
	bool
	select SOC_SERIES_RH850U2B

config SOC_R7F70254XAFABG_C
	bool
	select SOC_SERIES_RH850U2B

config SOC_R7F70254XAFABA_C
	bool
	select SOC_SERIES_RH850U2B

config SOC_R7F70254XAFABB_C
	bool
	select SOC_SERIES_RH850U2B

config SOC_R7F70255XFABB_C
	bool
	select SOC_SERIES_RH850U2B

config SOC_R7F70255XAFABB_C
	bool
	select SOC_SERIES_RH850U2B

config SOC_R7F70255XBFABB_C
	bool
	select SOC_SERIES_RH850U2B

config SOC_SERIES
	default "rh850u2b" if SOC_SERIES_RH850U2B

config SOC
	default "r7f70254xfabg-c"   if SOC_R7F70254XFABG_C
	default "r7f70254xfaba-c"   if SOC_R7F70254XFABA_C
	default "r7f70254xfabb-c"   if SOC_R7F70254XFABB_C
	default "r7f70254xafabg-c"  if SOC_R7F70254XAFABG_C
	default "r7f70254xafaba-c"  if SOC_R7F70254XAFABA_C
	default "r7f70254xafabb-c"  if SOC_R7F70254XAFABB_C
	default "r7f70255xfabb-c"   if SOC_R7F70255XFABB_C
	default "r7f70255xafabb-c"  if SOC_R7F70255XAFABB_C
	default "r7f70255xbfabb-c"  if SOC_R7F70255XBFABB_C
```

## soc/renesas/rh850/u2b/Kconfig
```kconfig
# SPDX-License-Identifier: Apache-2.0

config SOC_SERIES_RH850U2B
	select RH850
	select CPU_G4MH
	select XIP
	select HAS_RENESAS_U2B_FSP
	select CLOCK_CONTROL_RENESAS_U2B_CGC if CLOCK_CONTROL
	select HAS_RENESAS_RH850_RDP
	select SOC_EARLY_INIT_HOOK
	select HAS_FLASH_LOAD_OFFSET
	select CPU_HAS_FPU
	select HAS_RENESAS_U2X_INTERRUPT
	select MULTITHREADING
	select ARCH_HAS_CUSTOM_SWAP_TO_MAIN
```

## soc/renesas/rh850/u2b/Kconfig.defconfig
```kconfig
# SPDX-License-Identifier: Apache-2.0

if SOC_SERIES_RH850U2B

config CLOCK_CONTROL_INIT_PRIORITY
	default 30

config NUM_IRQS
	default 768

DT_ICLK_PATH := $(dt_nodelabel_path,iclk)

config SYS_CLOCK_HW_CYCLES_PER_SEC
	default $(dt_node_int_prop_int,$(DT_ICLK_PATH),clock-frequency)

config BUILD_OUTPUT_HEX
	default n

config BUILD_OUTPUT_BIN
	default n

config BUILD_OUTPUT_S19
	default n

config CLOCK_CONTROL
	default y

config DYNAMIC_INTERRUPTS
	default y

config MULTITHREADING
	default n

# Set to the minimal size of data which can be written.
config FLASH_FILL_BUFFER_SIZE
	default 128

endif # SOC_SERIES_U2B10
```

## subsys/usb/host/class/hid/Kconfig
```kconfig
# SPDX-FileCopyrightText: Copyright 2026 Renesas, Embedd
# SPDX-License-Identifier: Apache-2.0

config USBH_HID_CLASS
	bool "USB host HID Class support [EXPERIMENTAL]"
	select EXPERIMENTAL
	depends on USB_HOST_STACK
	help
	  USB Host HID Class implementation.

if USBH_HID_CLASS

config USBH_HID_INSTANCES_COUNT
	int "Number of HOST HID instances"
	default 2
	help
	  Number of instances of this USB class

config USBH_HID_BOOT_PROTOCOL
	bool "Use boot protocol when interfacing with HID devices"
	default y
	help
	  Most USB HID devices will implement a common report descriptor
	  known as "boot protocol". It is meant to let host machines interact
	  with the device even without loading a fully fledged HID driver,
	  usually in the context of a bootloader. It works well by itself,
	  so it may be used exclusively in order to save resources.

config USBH_HID_REPORT_MAX_USAGES
	int "Maximum usages to be found in a HID report descriptor"
	default 8
	help
	  HID report descriptor fields have usages associated with them.
	  Usages are specified sequentially and are assigned to fields
	  with FIFO order. This option declares how big the usage stack
	  can get.

config USBH_HID_REPORT_MAX_VARIANTS
	int "Maximum number of report variants for HID devices"
	default 32
	help
	  HID devices can specify multiple reports, each distinguished by
	  a report ID. This option declares how many the driver can allocate.

config USBH_HID_REPORT_MAX_COLLECTIONS
	int "Maximum number of report collections for HID devices"
	default 16
	help
	  HID report descriptors are organized in logical group called
	  collections. This option declares how many the driver can allocate.

config USBH_HID_REPORT_MAX_FIELDS
	int "Maximum number of report fields for HID devices"
	default 32
	help
	  HID report descriptors are a list of input/output fields with which
	  the device communicates. This option declares how many the driver
	  can allocate.

config USBH_HID_REPORT_MAX_STATE_STACK
	int "Maximum size of the report state stack for HID devices"
	default 4
	help
	  HID report descriptors work with a global state that can be pushed
	  and popped from a stack. This option declares how bit the state stack
	  can get.

config USBH_HID_ROUTE_TO_INPUT
	bool "Route the HID events directly to the input subsystem"
	default n
	select INPUT
	help
	  A HID device generates some events that can be handled by the input
	  subsystem. By flagging this option they are reported through the
	  USB host device.

config USBH_HID_MAX_INPUT_REPORT_SIZE
	int "Maximum input report size"
	default 16
	depends on USBH_HID_ROUTE_TO_INPUT
	help
	  In order to properly route HID events to the input subsystem the
	  input reports must be stored and compared against the ones following.
	  This is the maximum allowed report input size.


module = USBH_HID
module-str = usbh hid
default-count = 1
source "subsys/logging/Kconfig.template.log_config"
source "subsys/usb/common/Kconfig.template.instances_count"

endif # USBH_HID_CLASS
```

## tests/drivers/adc/adc_accuracy_test/boards/pb_rh850u2c_292pin_r7f702600afabb-c.conf
```kconfig
# Copyright (c) 2026 Renesas Electronics Corporation
# SPDX-License-Identifier: Apache-2.0

CONFIG_REFERENCE_VOLTAGE_TEST=y
CONFIG_TEST_ADC_CALIBRATE_REQUIRED=n
```

## tests/drivers/clock_control/clock_control_api/boards/pb_rh850u2b_468pin_r7f70254xfabg-c.conf
```kconfig
# Copyright (c) 2026 Renesas Electronics Corporation
# SPDX-License-Identifier: Apache-2.0

CONFIG_CLOCK_CONTROL=y
CONFIG_CLOCK_CONTROL_RENESAS_RH850_CGC=y
```
