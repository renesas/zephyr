## dts/bindings/mtd/renesas,ra-ospi-b-nor.yaml
```yaml
# Copyright (c) 2024-2026 Renesas Electronics Corporation
# SPDX-License-Identifier: Apache-2.0

description: Renesas RA OSPI FLASH

compatible: "renesas,ra-ospi-b-nor"

include: [base.yaml, "jedec,jesd216.yaml"]

properties:
  jedec-id:
    required: true
    description: |
      The JEDEC ID of the flash memory connected to OSPI. This is used to match the flash
      memory to a compatible flash driver, and to ensure the correct SPI NOR flash

  protocol-mode:
    type: int
    required: true
    description: |
     The width of OSPI bus to which flash memory is connected.

     Possible values are :
      - OSPI_SPI_MODE  <1> = SPI mode on 1 data line
      - OSPI_DUAL_MODE <2> = Dual mode on 2 data lines
      - OSPI_QUAD_MODE <4> = Quad mode on 4 data lines
      - OSPI_OPI_MODE  <8> = Octo mode on 8 data lines
    enum:
      - 1
      - 2
      - 4
      - 8

  ospi-max-frequency:
    type: int
    required: true
    description: |
      Max frequency input on OSPI

  enter-4byte-command:
    type: int
    description: |
      Enter 4-byte address mode command (Only required if SPI NOR
      Flash has the incorrect BFPT DW16 information in SFDP)

  rdsr-addr-4bytes:
    type: boolean
    description: |
      Whether RDSR command requires 4-byte address (Only required if SPI NOR
      Flash has the incorrect PROFILE1 DW1 information in SFDP)

  default-8d-dummy-cycles:
    type: int
    description: |
      Default dummy cycles for read command (Only required if SPI NOR Flash enter 8D mode
      but don't has dummy cycles information or the information is incorrect in SFDP)

  seq-enable-qpi:
    type: int
    description: |
      Override for the SFDP BFP DW15 "444 Enable Sequences" bitfield, used to select the
      command sequence for entering 4S-4S-4S (QPI) mode (Only required if SPI NOR Flash
      doesn't have or has incorrect BFPT DW15 information in SFDP).

      Possible values are :
       - <0x01> = Issue 0x38 after enabling Quad mode via the QE bit (quad-enable-requirements)
       - <0x02> = Issue 0x38, no prior QE bit write required
       - <0x04> = Issue 0x35, no prior QE bit write required

  max-sfdp-param-headers:
    type: int
    default: 9
    description: |
      Maximum number of JESD216 SFDP parameter headers (nph + 1) this driver will read
      during probe. All SFDP tables are read into fixed-size buffers (not heap-allocated)
      so that probing remains safe to run while the application executes XIP out of this
      same OSPI flash. Increase this if this flash device advertises more parameter
      tables than the default covers; probe fails with an error rather than silently
      truncating if the device exceeds this bound.

  smpt-max-dwords:
    type: int
    default: 64
    description: |
      Maximum size (in 32-bit words) of this flash device's JESD216 Sector Map
      Parameter Table (SMPT). Unlike the other SFDP tables, the SMPT's length is not
      fixed by the JESD216 spec - it scales with how many configuration maps and
      regions the device defines. Increase this if this flash device's sector map is
      larger than the default covers.

  max-regions:
    type: int
    default: 16
    description: |
      Maximum number of distinct erase regions this driver can track for this flash
      device (parsed from its Sector Map Parameter Table, or 1 when it has no sector
      map). This is live state used by every subsequent erase/write call, not just
      probe-time scratch space. Increase this if this flash device's sector map
      defines more regions than the default covers.

  sccr-max-dwords:
    type: int
    default: 28
    description: |
      Maximum size (in 32-bit words) of this flash device's JESD216 SCCR Map
      Parameter Table. JESD216D-01 6.9 only guarantees a 22-dw minimum (this
      driver's own decode logic requires at least that much) - it is not a real
      upper bound, and real devices report more: the MX25LW51245G measured on
      real hardware reports 28 dw. Increase this if a different flash device's
      SCCR map is larger than the default covers; probe fails with an error
      rather than silently truncating if the device exceeds this bound.
```

## dts/bindings/mtd/renesas,rx-nv-mram.yaml
```yaml
# Copyright (c) 2025 Renesas Electronics Corporation
# SPDX-License-Identifier: Apache-2.0

description: MRAM memory binding of Renesas RX family

include: [soc-nv-flash.yaml]

compatible: "renesas,rx-nv-mram"

properties:
  reg:
    required: true
```

## dts/bindings/ospi/renesas,rx-ospi-b.yaml
```yaml
# Copyright (c) 2025 Renesas Electronics Corporation
# SPDX-License-Identifier: Apache-2.0

description: Renesas RX OSPI

compatible: "renesas,rx-ospi-b"

include: [base.yaml, pinctrl-device.yaml]

bus: ospi

properties:
  reg:
    required: true

  unit:
    type: int
    required: true
    description: OSPI unit number

  pinctrl-0:
    required: true

  pinctrl-names:
    required: true

  clocks:
    required: true
```

## dts/bindings/phy/renesas,ra-mipi-dphy.yaml
```yaml
# Copyright (c) 2026 Renesas Electronics Corporation
# SPDX-License-Identifier: Apache-2.0

description: Renesas RA MIPI D-PHY

compatible: "renesas,ra-mipi-dphy"

include: [phy-controller.yaml]

phy-cells:
  - mode

properties:
  reg:
    required: true

  clocks:
    required: true

  "#phy-cells":
    const: 1
    description: |
      Single cell selects the D-PHY direction (DPHYMDC.MASTEREN). The PHY is a
      single physical block shared between MIPI CSI and MIPI DSI: only one
      direction can be enabled at a time.
        0 = Slave mode, feeds MIPI CSI-2 (camera capture)
        1 = Master mode, drives MIPI DSI (display)

  pll-div:
    type: int
    enum: [1, 2, 3, 4]
    description:
      PHY PLL input frequency divisor.

  pll-mul-int:
    type: int
    description:
      PHY PLL integer multiplier.

  pll-mul-frac:
    type: string
    enum: ["0.00", "0.33", "0.66", "0.50"]
    description:
      PHY PLL fractional multiplier.

  pll-out-div:
    type: int
    enum: [1, 2, 4, 8]
    description: |
      PHY PLL output frequency divisor.

  lp-divisor:
    type: int
    description:
      PHY PLL LP speed divisor.

child-binding:
  description: |
    D-PHY lane timing configuration. The child node must be named "phys-timing".
    Refer to '65. MIPI PHY' in the RA8P1 HWM for parameter details.

  properties:
    t-init:
      type: int
      required: true
      description: |
        Minimum duration of the TINIT state (Units: operation clock cycles).

    t-clk-prep:
      type: int
      required: true
      description: |
        Duration of the clock lane LP-00 state (immediately before entry to the HS-0 state).

    t-hs-prep:
      type: int
      required: true
      description: |
        Duration of the data lane LP-00 state (immediately before entry to the HS-0 state).

    t-clk-settle:
      type: int
      required: true
      description: |
        Period over which a transition to the HS state is ignored on the clock lane
        after the TCLK_PREPARE period begins.

    t-clk-miss:
      type: int
      required: true
      description: |
        Period from detecting the absence of a clock until the clock lane's HS-RX
        is disabled.

    t-hs-sett:
      type: int
      required: true
      description: |
        Period over which a transition to the HS state is ignored on a data lane
        after its TCLK_PREPARE period begins.

    t-lp-exit:
      type: int
      required: true
      description:
        Low-power transition time to High-Speed mode.

    dphytim4:
      type: array
      required: true
      description: |
        Clock lane pre and post data timing parameter: <TCLKZERO TCLKPRE TCLKPOST TCLKTRL>

    dphytim5:
      type: array
      required: true
      description: |
        High-Speed data lane timing parameter: <THSZERO THSTRL THSEXIT>
```

## dts/bindings/phy/renesas,rx-usbphyc.yaml
```yaml
# Copyright (c) 2025 Renesas Electronics Corporation
# SPDX-License-Identifier: Apache-2.0

description: Renesas RX USBHS internal PHY controller

compatible: "renesas,rx-usbphyc"

include: phy-controller.yaml

properties:
  clock:
    type: phandle
    description: |
      Clock source for PHY clock in case internal clock is using

  phys-clock-src:
    type: string
    enum:
      - "internal"
      - "xtal"
    description: |
      Select clock source for PHY clock as XTAL or use internal clock

  "#phy-cells":
    const: 0
```

## dts/bindings/pic/renesas,rh850-pic.yaml
```yaml
# Copyright (c) 2026 Renesas Electronics Corporation
# SPDX-License-Identifier: Apache-2.0

description: |
  Renesas RH850 Peripheral Interconnect Controller (PIC).
  The PIC routes signals between on-chip peripherals.

compatible: "renesas,rh850-pic"

include: base.yaml

properties:
  taud-input-control-function:
    type: string
    enum:
      - "none"
      - "timer-input-select"
      - "pwm-output-with-dead-time"
      - "high-accuracy-triangle-wave-pwm-with-dead-time"
      - "delay-pulse-output-with-dead-time"
      - "trigger-pulse-width-measurement"
    default: "none"
    description: |
      Function used to control the TAUD signals. It is one setting for the whole chip.

  triangle-wave-pwm:
    type: array
    description: |
      Phases of the high accuracy triangle wave PWM output function of the TAUD units. One cell per
      PIC_TRIWAVE(unit, phases, level), unit = TAUD0..TAUD3, phases = U, V, W, UV, UW, VW or UVW,
      level = NONE, HIGH or LOW (active level). A phase that is not listed is disabled and must not
      be listed with two different levels. Not available on every TAUD unit due to hardware support.

  taud-int-signal:
    type: array
    description: |
      TAUD channel used as INT signal of a TAUD unit. One cell per PIC_TAUD_INT(unit, channel),
      channel = CH0, CH2 or CH8. At most one cell per unit. Not available on every TAUD unit
      (checked at build time). If not set, no channel is selected.

  adc-trigger-selection:
    type: array
    description: |
      ADC hardware trigger routes. One cell per RH850_PIC_ADC_TRIG(adc, sg, edge, source):
        adc    ADC0 .. ADC3 (the unit index of the ADC instance).
        sg     SG0 .. SG4, DIAG (diagnostic scan group, only on MCUs that have one).
        edge   RISING, FALLING or BOTH.
        source TAUD<unit>_CH<channel> (unit 0..3, channel 0..15), or one of the other sources
               listed in the header (INTTAUJ0I3, ADCTRG0, TSG30TRG0, ENCA, ATU, ...).

# Example configuration (set it in the application overlay of the module that needs it, e.g. TAUD
# PWM or ADC):
#
#   #include <zephyr/dt-bindings/pic/renesas/pic-rh850-common.h>
#
#   &pic0 {
#           taud-input-control-function = "high-accuracy-triangle-wave-pwm-with-dead-time";
#           triangle-wave-pwm = <RH850_PIC_TRIWAVE(TAUD0, UVW, HIGH)>,
#                               <RH850_PIC_TRIWAVE(TAUD1, UVW, HIGH)>;
#           adc-trigger-selection = <RH850_PIC_ADC_TRIG(ADC0, SG0, FALLING, TAUD0_CH4)>,
#                                   <RH850_PIC_ADC_TRIG(ADC1, SG1, FALLING, TAUD1_CH4)>;
#           status = "okay";
#   };
```
