## dts/bindings/pwm/renesas,rh850-taud-pwm.yaml
```yaml
# Copyright (c) 2026 Renesas Electronics Corporation
# SPDX-License-Identifier: Apache-2.0

description: |
  Renesas RH850 TAUD PWM Primary-Synchronized Timer Unit

  This binding defines a primary-synchronized PWM architecture where one primary channel
  controls the period/frequency for a group of synchronized child channels. Each
  synchronized channel can have independent duty cycle control while sharing the same
  period from the primary channel.

  Architecture: A primary channel provides the PWM interface, controls the shared
  period and frequency, and manages the clock and interrupts. Child channels can
  operate in synchronized mode for PWM output or independent mode for PWM capture.
  Synchronized channels inherit the primary period and have independent duty-cycle
  control. Up to 15 synchronized child channels can be paired with one primary.

  Example: The primary device pwm0_ch0 provides PWM for channels 1 and 2.
  The PWM specifiers are:
    pwms = <&pwm0_ch0 1 PWM_MSEC(20) PWM_POLARITY_NORMAL>;
    pwms = <&pwm0_ch0 2 PWM_MSEC(20) PWM_POLARITY_NORMAL>;

  Child channel configuration example:
    &pwm0_ch0 {
            channel@1 {
                    reg = <1>;
                    channel-mode = "synchronized";
            };
            channel@3 {
                    reg = <3>;
                    channel-mode = "independent";
            };
    };

compatible: "renesas,rh850-taud-pwm"

include: [base.yaml, pwm-controller.yaml, pinctrl-device.yaml]

properties:
  reg:
    type: array
    required: true
    description: |
      Primary channel register base address. On RH850/U2A, a second register
      block named "dnfa" contains DNFACTLn and DNFAENn.

  reg-names:
    type: string-array
    description: |
      Register block names. RH850/U2A uses "taud" for the primary channel
      registers and "dnfa" for the digital noise-filter registers.

  unit:
    type: int
    required: true
    description: |
      TAUD unit number. This driver currently supports only TAUD0 (unit 0);
      other unit values fail a build-time assertion.

  channel:
    type: int
    required: true
    description: Primary channel index (0-15, typically even)

  clocks:
    required: true
    description: Clock source reference for primary channel

  clock-source:
    type: int
    default: 0
    enum:
      - 0  # CK0 - Main peripheral clock
      - 1  # CK1 - Alternative clock source
      - 2  # CK2 - Alternative clock source
      - 3  # CK3 - Alternative clock source
    description: |
      Clock source selection for primary channel (operation_clk field).
      Default: 0 (CK0 - Main peripheral clock) for maximum frequency and
      simplest configuration without requiring alternative clock sources.

  clock-divider:
    type: int
    default: 0
    enum:
      - 0   # 2^0 = 1x (no division)
      - 1   # 2^1 = 2x
      - 2   # 2^2 = 4x
      - 3   # 2^3 = 8x
      - 4   # 2^4 = 16x
      - 5   # 2^5 = 32x
      - 6   # 2^6 = 64x
      - 7   # 2^7 = 128x
      - 8   # 2^8 = 256x
      - 9   # 2^9 = 512x
      - 10  # 2^10 = 1024x
      - 11  # 2^11 = 2048x
      - 12  # 2^12 = 4096x
      - 13  # 2^13 = 8192x
      - 14  # 2^14 = 16384x
      - 15  # 2^15 = 32768x
    description: |
      Clock divider exponent applied to PCLK (clk_div field).
      Default: 0 (1x, no division) for maximum frequency and finest resolution.

      Important: The prescaler (TAUDnTPS) is shared by all channels in a unit.
      All primary nodes in the same unit MUST have the same clock-divider value.
      The driver rejects conflicting values at build time.

  noise-filter-prescaler:
    type: int
    default: 0
    description: |
      Digital Noise Filter (DNFA) prescaler value (DNFACTLn, 8-bit register).
      Specifies the sampling clock for noise filtering on capture input pins.
      The primary node must provide a "dnfa" register block. Shared by all
      channels in the TAUD unit, so all primary nodes in the same unit MUST use
      the same prescaler value. The driver rejects conflicting values and a
      missing "dnfa" register block at build time.

  "#pwm-cells":
    const: 3
    description: PWM specifier format (channel, period, flags)

  "#address-cells":
    const: 1
    description: Child node addressing uses 1 cell

  "#size-cells":
    const: 0
    description: Child nodes have no size property

pwm-cells:
  - channel
  - period
  - flags

child-binding:
  description: |
    TAUD channel managed by this primary channel, addressed by the PWM API with its
    reg as the channel number. Its role is selected by channel-mode.

    "synchronized" (default):
    - Synchronized with the primary: shares its period/frequency
    - Has its own duty cycle (pwm_set_cycles with this channel)
    - Started and stopped together with the primary
    - Output pin routing specified in parent's pinctrl configuration

    "independent":
    - Not synchronized with the primary: runs on its own input trigger
    - Used as a PWM capture input (TAUDnTTINm) through the capture API
    - Started and stopped by pwm_enable_capture()/pwm_disable_capture()
    - Input pin routing specified in parent's pinctrl configuration

    All child pins (outputs and capture inputs) are routed through the parent
    node's pinctrl configuration. Child-level pinctrl properties are not
    supported; specify all pins in the parent's pinctrl groups.

  properties:
    reg:
      type: int
      required: true
      description: |
        TAUD channel index (0-15). Must be different from the primary channel
        index. Example: ch0 (primary=0) with ch1 (synchronized=1), ch2 (synchronized=2)

    interrupts:
      type: array
      description: |
        Interrupt specification for this channel (INTTAUDnIm).
        Required only for "independent" (capture) channels.
        Synchronized channels do not use interrupts.
        Set interrupt-parent on the child when the channel's TAUD interrupt
        is routed through a different interrupt controller. On RH850/U2A,
        RH850/U2B, and RH850/U2C, even TAUD0 channels use INTC1 and odd
        TAUD0 channels use INTC2.
        Format: <irq_number priority>

    channel-mode:
      type: string
      default: "synchronized"
      enum:
        - "synchronized"
        - "independent"
      description: |
        Operating mode of this channel.
        Default: "synchronized" (most common use case—synchronized PWM output).

        - "synchronized": synchronized with the primary channel, used for PWM output. Shares
          the primary channel's period and frequency, with independent duty cycle control.
        - "independent": independent channel used for PWM capture. Period
          capture uses the Input Pulse Interval Measurement function and
          pulse capture uses the Input Signal Width Measurement function.
          Requires CONFIG_PWM_CAPTURE, otherwise the channel is ignored.

    noise-filter-enable:
      type: boolean
      description: |
        Enable the digital noise filter (DNFA) on this channel's capture input pin.
        The parent node must provide a "dnfa" register block. Should be enabled
        when the input pin is subject to noise or EMI. Enabling this property
        without a "dnfa" register block causes a build-time error. The property
        has no effect on non-independent channels.
```

## dts/bindings/pwm/renesas,rx-gpt-pwm.yaml
```yaml
# Copyright (c) 2026 Renesas Electronics Corporation
# SPDX-License-Identifier: Apache-2.0

description: Renesas RX GPT Pulse Width Modulation

compatible: "renesas,rx-gpt-pwm"

include: [pwm-controller.yaml, base.yaml, pinctrl-device.yaml]

properties:
  "#pwm-cells":
    const: 3

pwm-cells:
  - channel
  - period
  - flags
```

## dts/bindings/pwm3p/renesas,rh850-taud3p-pwm3p.yaml
```yaml
# Copyright (c) 2026 Renesas Electronics Corporation
# SPDX-License-Identifier: Apache-2.0

description: |
  Renesas RH850 TAUD3P 3-phase PWM controller (PWM3P). One instance drives three complementary
  high-side/low-side output pairs (U/V/W) that share one period and one deadtime. The signal
  routing is configured by the PIC (Peripheral Interconnect Controller) node given in "pic".

compatible: "renesas,rh850-taud3p-pwm3p"

include: [base.yaml, pinctrl-device.yaml]

properties:
  reg:
    required: true
    description: |
      Base address and size of the TAUD unit used by this PWM3P instance.

  taud-three-phase-unit:
    type: int
    required: true
    description: |
      Index of the TAUD unit used by this PWM3P instance. It is set by the SoC devicetree
      together with "reg", the address of a unit differs between SoCs so it cannot be derived
      from "reg" alone.

  clocks:
    type: phandle-array
    required: true
    description: |
      Module clock of the TAUD unit, given as a CGC clock specifier, for example
      clocks = <&cgc RH850_PCLK(TAUD, 0, PCLK)>. The channel is the index of the TAUD unit and
      the driver enables it before touching any TAUD register.

  pic:
    type: phandle
    description: |
      Phandle of the PIC node that routes the PWM3P signals, for example pic = <&pic0>.
      Only used, and then required, when CONFIG_RENESAS_RH850_PIC is enabled. The PIC must be
      enabled and initialized before this device.

  period-counts:
    type: int
    required: true
    description: |
      Initial PWM period in timer counter cycles, shared by all 3 phases. Must be even and at
      least 2.

  deadtime-counts:
    type: int
    default: 240
    description: |
      Deadtime in timer counter cycles, inserted between the high-side and low-side outputs of
      each phase. Must not exceed half of period-counts.

  operation-clk:
    type: int
    default: 0
    enum:
      - 0
      - 1
      - 2
      - 3
    description: Timer operation clock source selection (0..3).

  clk-div:
    type: int
    default: 0
    enum:
      - 0
      - 1
      - 2
      - 3
      - 4
      - 5
      - 6
      - 7
      - 8
      - 9
      - 10
      - 11
      - 12
      - 13
      - 14
      - 15
    description: Timer clock divider, the input clock is divided by 2^n.

  interrupts:
    description: |
      Optional interrupt raised once per PWM period. It is required by pwm3p_set_callback(),
      which returns -ENOTSUP if it is absent.
```

## dts/bindings/rng/renesas,rx-rsip-e50d-trng.yaml
```yaml
# Copyright (c) 2025 Renesas Electronics Corporation
# SPDX-License-Identifier: Apache-2.0

description: Renesas RX RSIP-E50D TRNG

compatible: "renesas,rx-rsip-e50d-trng"

include: base.yaml
```

## dts/bindings/rng/renesas,rx-trng.yaml
```yaml
# Copyright (c) 2025 Renesas Electronics Corporation
# SPDX-License-Identifier: Apache-2.0

description: Renesas RX TRNG

compatible: "renesas,rx-trng"

include: base.yaml
```
