## dts/bindings/interrupt-controller/renesas,rx-grp-intc-fsp.yaml
```yaml
# Copyright (c) 2021 KT-Elektronik Klaucke und Partner GmbH
# Copyright (c) 2025 Renesas Electronics Corporation
# SPDX-License-Identifier: Apache-2.0

description: Renesas group interrupt
compatible: "renesas,rx-grp-intc-fsp"

include: [interrupt-controller.yaml, base.yaml]

properties:
  "#interrupt-cells":
    const: 2

interrupt-cells:
  - irq
  - priority
```

## dts/bindings/mbox/renesas,rcar-mfis-common-mbox.yaml
```yaml
# Copyright (c) 2026, Renesas Electronics Corporation
# SPDX-License-Identifier: Apache-2.0

description: |
  Renesas R-Car MFIS common mailbox controller.

  The common MFIS mailbox channels provide communication between AP and RT
  core domains, or between RT core domains.

  Each channel has two communication sides, S and R. The local core's side
  is configured independently for each channel.

compatible: "renesas,rcar-mfis-common-mbox"

include: renesas,rcar-mfis-mbox-base.yaml

properties:
  interrupts:
    required: true
    description: |
      The interrupt list contains the two interrupt lines for each supported
      MFIS common hardware channel.

      For hardware channel N:
        interrupt index (2 * N)     is the S-to-R interrupt
        interrupt index (2 * N + 1) is the R-to-S interrupt

      The driver selects the RX interrupt for a channel from this pair based
      on the channel child's renesas,local-side property.

  "#address-cells":
    const: 1

  "#size-cells":
    const: 0

child-binding:
  description: MFIS common channel configuration

  properties:
    reg:
      type: array
      required: true
      description: MFIS common channel ID.

    renesas,local-side:
      type: string
      required: true
      enum:
        - "s-side"
        - "r-side"
      description: |
        Selects the local core's side of this MFIS common channel.

        "s-side" uses the S-to-R direction for transmit and the R-to-S
        direction for receive.

        "r-side" uses the R-to-S direction for transmit and the S-to-R
        direction for receive.

        For AP-to-RT communication, the R-Car software convention assigns
        the AP endpoint to "r-side" and the RT endpoint to "s-side".

        For RT-to-RT communication, there is no fixed side assignment.
        The two endpoints of a channel must use opposite sides: one endpoint
        must use "s-side" and the other must use "r-side".

examples:
  - |
    /* Consumer using MFIS common channel 0 */
    &mfis_common {
        status = "okay";

        channel@0 {
            reg = <0>;
            renesas,local-side = "s-side";
        };
    };

    mbox_consumer: mbox-consumer {
        compatible = "vnd,mbox-consumer";
        mboxes = <&mfis_common 0>,
                 <&mfis_common 0>;
        mbox-names = "tx", "rx";
    };
```

## dts/bindings/mbox/renesas,rcar-mfis-mbox-base.yaml
```yaml
# Copyright (c) 2026, Renesas Electronics Corporation
# SPDX-License-Identifier: Apache-2.0

description: |
  Common properties for Renesas R-Car MFIS mailbox controllers.

  The multifunctional interface (MFIS) provides signalling and small message
  registers between CPU domains. Each MFIS channel is bidirectional and represents
  one communication link between two endpoints. A channel should not be shared by multiple
  cores on the same endpoint.

include: [base.yaml, mailbox-controller.yaml]

properties:
  reg:
    required: true

  "#mbox-cells":
    const: 1

mbox-cells:
  - channel
```

## dts/bindings/mbox/renesas,rcar-mfis-scp-mbox.yaml
```yaml
# Copyright (c) 2026, Renesas Electronics Corporation
# SPDX-License-Identifier: Apache-2.0

description: |
  Renesas R-Car MFIS SCP mailbox controller.

  The SCP MFIS mailbox channels provide communication between an AP/RT
  core domain and the SCP core domain.

  The communication side for these channels is fixed by hardware and
  therefore does not require per-channel S/R configuration.

compatible: "renesas,rcar-mfis-scp-mbox"

include: renesas,rcar-mfis-mbox-base.yaml

properties:
  interrupts:
    required: true
    description: |
      Interrupt index N maps directly to mailbox channel N within this
      mailbox controller instance. The interrupt list must contain one
      entry for each supported channel.

examples:
  - |
    /* Consumer using MFIS scp channel 0 */
    &mfis_scp {
        status = "okay";
    };

    firmware {
        scmi {
            compatible = "arm,scmi";
            mboxes = <&mfis_scp 0>;
            mbox-names = "tx";
        };
    };
```

## dts/bindings/memory-controllers/renesas,rcar-backup-buffer.yaml
```yaml
# Copyright (c) 2026 Renesas Electronics Corporation
# SPDX-License-Identifier: Apache-2.0

description: |
  Back-up Buffer (BKBUF).

  The data storage in the Back-up Buffer are not initialized after a reset
  as long as the power is supplied to the given LSI chip.

compatible: "renesas,rcar-backup-buffer"

include: [base.yaml, "zephyr,memory-region.yaml"]

properties:
  reg:
    required: true

  reg-names:
    required: true
    description: |
      Three register regions are expected, in this order:

        - "bkbuf": the Back-up Buffer itself. This region is the one turned
          into the linker memory region named by the "zephyr,memory-region"
          property.
        - "prot": the MDLCnPKCPROT1 register, which guards writes to the
          "bkbapr" register.
        - "bkbapr": the MDLCnBKBAPR register, which controls access to the
          Back-up Buffer.
```

## dts/bindings/memory-controllers/renesas,rx-ospi-b-psram.yaml
```yaml
# Copyright (c) 2025 Renesas Electronics Corporation
# SPDX-License-Identifier: Apache-2.0

description: Renesas RX OSPI Pseudo SRAM

compatible: "renesas,rx-ospi-b-psram"

include: [base.yaml]

on-bus: ospi

properties:
  reg:
    required: true
    description: Chip Select channel on OSPI

  size:
    type: int
    required: true
    description: Memory size in bytes

  spi-protocol:
    type: string
    default: "8D_8D_8D"
    description: |
      SPI protocol mode setting for OSPI communication.
    enum:
      - "1S_1S_1S"
      - "8D_8D_8D"

  variable-latency:
    type: boolean
    description: Enable variable latency mode

  frame-format:
    type: string
    default: "XSPI_PROFILE_1"
    description: |
      Frame format setting for OSPI communication.
    enum:
      - "STANDARD"
      - "XSPI_PROFILE_1"
      - "XSPI_PROFILE_2"
      - "XSPI_PROFILE_2_EXTENDED"

  ds-latch-delay:
    type: int
    default: 16
    description: Data strobe latch delay cycles (0 - 31)

  ospi-max-frequency:
    type: int
    required: true
    description: Maximum clock frequency of device's OSPI interface in Hz

  command-to-command-interval:
    type: int
    default: 2
    description: Command to command interval in clock cycles (0 - 15)

  cs-pullup-lag:
    type: boolean
    description: Chip select pull-up lag extension 1 cycles

  cs-pulldown-lead:
    type: boolean
    description: Chip select pull-down lead extension 1 cycles

  write-size-bytes:
    type: int
    default: 32
    description: Maximum number of bytes to be written in one write operation

  ddr-sampling-extension:
    type: int
    default: 0
    enum: [0, 1, 2, 3, 4, 5, 6, 7]
    description: DDR sampling extension cycles

  auto-calibration-pattern-address:
    type: int
    default: 0x50002000
    description: |
      Address that stores the auto calibration pattern.
      Please refer to the address space section of the MCU user's manual.

  address-bytes:
    type: int
    default: 4
    enum: [1, 2, 3, 4]
    description: Number of address bytes

  command-bytes:
    type: int
    default: 2
    enum: [1, 2]
    description: Number of command bytes

  read-command:
    type: int
    default: 0xA000
    description: Read command opcode

  read-dummy-cycles:
    type: int
    default: 5
    description: Number of dummy cycles for read command

  write-command:
    type: int
    default: 0x2000
    description: Write command opcode

  write-dummy-cycles:
    type: int
    default: 5
    description: Number of dummy cycles for write command
```

## dts/bindings/mipi-dsi/renesas,ra-mipi-dsi.yaml
```yaml
# Copyright (c) 2024 Renesas Electronics Corporation
# SPDX-License-Identifier: Apache-2.0

description: Renesas RA MIPI DSI host

compatible: "renesas,ra-mipi-dsi"

include: [mipi-dsi-host.yaml]

properties:
  clocks:
    required: true

  interrupts:
    required: true

  interrupt-names:
    type: string-array
    required: true
    description: name of each interrupt

  phys:
    type: phandle-array
    required: true
    description: |
      MIPI D-PHY providing the physical layer for this DSI host, in master
      mode. See renesas,ra-mipi-dphy.yaml.

  phy-names:
    type: string-array

  ulps-wakeup-period:
    type: int
    description: ULPS wakeup period.

  video-mode-delay:
    type: int
    description: |
      Set the delay value inside DSI Host until the transfer begins.

  timing:
    type: array
    description: |
      MIPI DSI timing parameter: <CLKSTPT CLKBFHT CLKKPT GOLPBKT>
```

## dts/bindings/misc/renesas,rx-external-interrupt-icum.yaml
```yaml
# Copyright (c) 2025 Renesas Electronics Corporation
# SPDX-License-Identifier: Apache-2.0

description: Renesas RX External Interrupt ICUM

compatible: "renesas,rx-external-interrupt-icum"

include: [base.yaml]

properties:
  interrupts:
    required: true

  reg:
    required: true

  channel:
    type: int
    required: true

  renesas,trigger:
    type: string
    enum:
      - "falling"
      - "rising"
      - "both-edges"
      - "low-level"
    description: |
      Select the signal edge or state that triggers an interrupt

  renesas,digital-filtering:
    type: boolean
    description: |
      Select if data noise filter should be enabled.

  renesas,sample-clock-div:
    type: int
    enum:
      - 1
      - 8
      - 32
      - 64
      - 128
      - 4
      - 16
    description: |
      Select the clock divider for the digital noise filter. Clock source is system clock.
```

## dts/bindings/misc/renesas,rx-gpt.yaml
```yaml
# Copyright (c) 2026 Renesas Electronics Corporation
# SPDX-License-Identifier: Apache-2.0

description: Renesas RX GPT controller

compatible: "renesas,rx-gpt"

include: [base.yaml, pinctrl-device.yaml]

properties:
  channel:
    type: int
    description: channel GPT

  reg:
    required: true

  clocks:
    required: true

  divider:
    type: string
    required: true
    enum:
      - "DIV_1"
      - "DIV_2"
      - "DIV_4"
      - "DIV_8"
      - "DIV_16"
      - "DIV_32"
      - "DIV_64"
      - "DIV_128"
      - "DIV_256"
      - "DIV_512"
      - "DIV_1024"

  interrupts:
    required: true

  interrupt-names:
    required: true
```

## dts/bindings/misc/renesas,rx-sci-b.yaml
```yaml
# Copyright (c) 2025 Renesas Electronics Corporation
# SPDX-License-Identifier: Apache-2.0

description: Renesas RX SCI B controller

compatible: "renesas,rx-sci-b"

include: [base.yaml, pinctrl-device.yaml]

properties:
  reg:
    required: true

  clocks:
    required: true

  channel:
    type: int
    description: |
      The number of channels available in the SCI controller. This is used to
      differentiate multiple instances of the same controller type.

  tei-ctrl:
    type: phandle
    description: |
      Group interrupt controller for the transmit end interrupt (TEI). This only applies
      in cases the RX MCU supports group interrupt feature

  tei-number:
    type: int
    description: |
      Number of the TEI in the interrupt group of tei-ctrl

  eri-ctrl:
    type: phandle
    description: |
      Group interrupt controller for the error interrupt (ERI). This only applies
      in cases the RX MCU supports group interrupt feature

  eri-number:
    type: int
    description: |
      Number of the ERI in the interrupt group of eri-ctrl
```

## dts/bindings/misc/renesas,rx-system-controller.yaml
```yaml
# Copyright (c) 2025 Renesas Electronics Corporation
# SPDX-License-Identifier: Apache-2.0

description: Renesas RX System controller

compatible: "renesas,rx-system-controller"

include: [base.yaml]

properties:
  reg:
    required: true
```

## dts/bindings/misc/renesas,rx-tmr.yaml
```yaml
# Copyright (c) 2024 Renesas Electronics Corporation
# SPDX-License-Identifier: Apache-2.0

description: Renesas RX TMR

compatible: "renesas,rx-tmr"

include: base.yaml

properties:
  reg:
    required: true

  channel:
    type: int
    required: true

  renesas,prescaler:
    description: |
      TMR clock divider for PCLKB. timer clock = (clock-source / (1 << prescaler))
    type: int
    required: true
    enum:
      - 0
      - 1
      - 3
      - 5
      - 6
      - 10
      - 13

  interrupts-extended:
    required: true

  interrupt-names:
    required: true
```
