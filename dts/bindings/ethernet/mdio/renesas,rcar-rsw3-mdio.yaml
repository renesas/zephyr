## dts/bindings/flash_controller/renesas,rx-xspi-nor.yaml
```yaml
# Copyright (c) 2025 Renesas Electronics Corporation
# SPDX-License-Identifier: Apache-2.0

description: Renesas RX XSPI FLASH

compatible: "renesas,rx-xspi-nor"

include: ["flash-controller.yaml", "jedec,jesd216.yaml"]

on-bus: ospi

properties:
  reg:
    required: true
    description: Chip Select channel on OSPI

  write-block-size:
    type: int
    default: 1
    description: Address alignment required by flash write operations

  protocol-mode:
    type: int
    required: true
    description: |
     The width and rate of XSPI bus to which flash memory is connected.

     Possible values are :
      - XSPI_SPI_MODE  <1> = SPI mode on 1 data line
      - XSPI_DUAL_MODE <2> = Dual mode on 2 data lines
      - XSPI_QUAD_MODE <4> = Quad mode on 4 data lines
      - XSPI_OCTO_MODE <8> = Octo mode on 8 data lines
    enum: [ 1, 2, 4, 8 ]

  data-rate:
    type: int
    required: true
    description: |
     The SPI data Rate is STR or DTR

     Possible values are :
      - XSPI_STR_TRANSFER <1> = Single Rate Transfer
      - XSPI_DTR_TRANSFER <2> = Dual Rate Transfer (only with XSPI_OCTO_MODE)
    enum:
      - 1
      - 2

  ospi-max-frequency:
    type: int
    required: true
    description: Max frequency input on OSPI

  size:
    required: true
    description: Total size of the flash memory in bytes

  max-write-size:
    type: int
    default: 64
    description: Maximum number of bytes that can be programmed in a single write operation

  auto-calib-pattern-address-sector:
    type: int
    default: 3
    description: Sector number that stores the auto calibration pattern

  write-status-bit:
    type: int
    default: 0
    description: Bit position of the write in progress (WIP) bit in the status register
    enum: [0, 1, 2, 3, 4, 5, 6, 7]

  write-enable-bit:
    type: int
    default: 1
    description: Bit position of the write enable latch (WEL) bit in the status register
    enum: [0, 1, 2, 3, 4, 5, 6, 7]

  command-interval:
    type: int
    default: 2
    description: Minimum clock cycles between 2 commands.
    enum: [0, 1, 2, 3, 4, 5, 6, 7, 8 , 9, 10, 11, 12, 13, 14, 15, 16]

  pull-up-delay:
    type: boolean
    description: De-assert CS line 1 clock cycle after the last command

  pull-down-lead:
    type: boolean
    description: Assert CS line 1 clock cycle before the first command

  sdr-drive-timing:
    type: int
    default: 0
    enum:
      - 0
      - 1
    description: |
      Selects the SDR drive timing setting
      - 0: drive 1/2 cycle before CK
      - 1: drive at CK

  sdr-sampling-edge:
    type: int
    default: 0
    enum:
      - 0
      - 1
    description: |
      Selects the SDR CK sampling edge
      - 0: sample at falling edge of CK
      - 1: sample at rising edge of CK

  sdr-sampling-delay:
    type: int
    default: 0
    description: Number of cycles to delay before sampling data on SDR read operations (0 - 7)

  ddr-sampling-extension:
    type: int
    default: 0
    description: |
      Number of cycles to extending the data sampling window on DDR read operations (0 - 7)

  output-assert-delay:
    type: string
    default: ASSERTION_DELAY_DISABLED
    enum:
      - ASSERTION_DELAY_DISABLED
      - ASSERTION_DELAY_ENABLED
    description: |
      Assertion timing of the output buffer control signal. Setting this  will delays the start
      of output from the IO pins and the DS pin by one cycle.

  cs:
    type: int
    default: 0
    description: Chip Select channel on OSPI

  quad-protocol:
    type: string
    default: "io"
    enum:
      - "io"
      - "qpi"
    description: |
      Quad sub-protocol to use when protocol-mode selects XSPI_QUAD_MODE.
      - "io"  = 1S-4S-4S (address/command on 1 line, data on 4 lines)
      - "qpi" = 4S-4S-4S (command/address/data all on 4 lines)

  enter-4byte-command:
    type: int
    default: 0
    description: |
      Override opcode used to enter 4-byte addressing mode. If 0 (default),
      the driver decodes the correct method from JESD216 BFP DW16
      "Enter 4-Byte Addressing" bits.

  default-8d-dummy-cycles:
    type: int
    default: 0
    description: |
      Override the read dummy cycle count used in 8D-8D-8D (Octal DDR) mode.
      If 0 (default), the value is decoded from the JESD216 xSPI Profile 1.0
      table or the Sequence Octal DDR table.

  rdsr-addr-4bytes:
    type: boolean
    description: |
      Force the status register read (RDSR) in 8D-8D-8D mode to use a
      4-byte address phase, overriding the JESD216 xSPI Profile 1.0
      RDSR-address-bytes bit.

  reset-dummy-cycles:
    type: boolean
    description: |
      Some flash devices (e.g. ISSI IS25 series) apply a non-default read
      dummy-cycle count that must be reset to the hardware default (via a
      vendor-specific "Set Read Parameters" command) before entering
      QPI/Octal mode. Enable this quirk for such devices.

  fix-bfpt-addr-bytes:
    type: boolean
    description: |
      Some flash devices report incorrect addressing width in JESD216 BFP
      DW1 (e.g. claiming 3-byte-only addressing while 4-byte addressing is
      required/supported). When set, the driver overrides the decoded BFP
      value to force 4-byte addressing.

  reduce-drive-strength:
    type: boolean
    description: |
      Lower the flash output drive strength (vendor-specific volatile
      register write) to reduce simultaneous-switching-output noise on
      quad/octal reads. Only applies to flash devices that support this
      quirk (e.g. ISSI IS25 series Extended Read Register ODS bits).
```

## dts/bindings/gpio/renesas,rx-gpio-ioport.yaml
```yaml
# Copyright (c) 2025 Renesas Electronics Corporation
# SPDX-License-Identifier: Apache-2.0

description: Renesas RX GPIO IO port

compatible: "renesas,rx-gpio-ioport"

include: [gpio-controller.yaml, base.yaml]

properties:
  reg:
    required: true

  port:
    type: int
    required: true

  vbatts_pins:
    type: array
    description: Array of vbatt pin on port

  "#gpio-cells":
    const: 2

gpio-cells:
  - pin
  - flags
```

## dts/bindings/i2s/renesas,rcar-i2s-ssi.yaml
```yaml
# Copyright (c) 2026 Renesas Electronics Corporation
# SPDX-License-Identifier: Apache-2.0

description: Renesas R-Car I2S controller

compatible: "renesas,rcar-i2s-ssi"

include: [i2s-controller.yaml, pinctrl-device.yaml]

properties:
  reg:
    required: true

  interrupts:
    required: true

  clocks:
    required: true

  dmas:
    description: TX/RX DMA channel specifiers

  dma-names:
    description: Must be "tx" and/or "rx"
```

## dts/bindings/i2s/renesas,rh850-i2s-ssif.yaml
```yaml
# Copyright (c) 2026 Renesas Electronics Corporation
# SPDX-License-Identifier: Apache-2.0

description: Renesas RH850 Serial Sound Interface (SSIF) I2S controller

compatible: "renesas,rh850-i2s-ssif"

include: [i2s-controller.yaml, pinctrl-device.yaml]

properties:
  reg:
    required: true

  interrupts:
    required: true

  interrupt-names:
    required: true
    enum:
      - "ssi_txi"
      - "ssi_rxi"
      - "ssi_inti"

  channel:
    type: int
    required: true

  pinctrl-0:
    required: true

  pinctrl-names:
    required: true

  clocks:
    required: true

  clock-names:
    required: true

  full-duplex:
    type: boolean
```
