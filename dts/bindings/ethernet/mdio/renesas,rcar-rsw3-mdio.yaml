## dts/bindings/ethernet/mdio/renesas,rcar-rsw3-mdio.yaml
```yaml
# Copyright (c) 2026 Renesas Electronics Corporation
# SPDX-License-Identifier: Apache-2.0

description: Renesas RCAR R-Switch3 (RSW3) MDIO controller

compatible: "renesas,rcar-rsw3-mdio"

include: [mdio-controller.yaml, pinctrl-device.yaml]

properties:
  reg:
    required: true

  reg-names:
    required: true

  clocks:
    required: true
    description: |
      The RSW3 AES clock controller followed by a fixed-clock provider for
      the MDC divider source rate.

  clock-names:
    required: true
    description: |
      Must contain "gate" for the RSW3 AES clock controller and
      "mdc-source" for the fixed MDC divider source rate.

  channel:
    type: int
    required: true
    description: |
      The MDIO(RMAC) channel number to use for this controller. This is required to
      differentiate between multiple MDIO(RMAC) controllers in the same system.
      In this IP only RMAC0 to RMAC4 provide external MDIO functionality.

  pinctrl-0:
    required: true

  pinctrl-names:
    required: true
```

## dts/bindings/ethernet/mdio/renesas,rh850-etnd-mdio.yaml
```yaml
# Copyright (c) 2026 Renesas Electronics Corporation
# SPDX-License-Identifier: Apache-2.0

description: |
  MDIO controller of the Renesas RH850 MCU ETND (TSN) Ethernet MAC.

  The MDIO state machine is part of the RMACAn register block of the ETND
  MAC, so this controller belongs to one ETND channel. It is a sibling of the
  ETND MAC node in the SoC devicetree and owns the MDC/MDIO pinctrl. PHY nodes
  are children of this node and are referenced from the MAC through its
  "phy-handle" property.

compatible: "renesas,rh850-etnd-mdio"

include: [mdio-controller.yaml, pinctrl-device.yaml]

properties:
  reg:
    required: true

  clocks:
    required: true
    description: |
      Clock for module.

  pinctrl-0:
    required: true

  pinctrl-names:
    required: true

  channel:
    type: int
    default: 0
    description: ETND controller channel this MDIO block belongs to.
```

## dts/bindings/ethernet/mdio/renesas,rx-rmac-mdio.yaml
```yaml
# Copyright (c) 2025 Renesas Electronics Corporation
# SPDX-License-Identifier: Apache-2.0

description: Renesas RX External MDIO controller

compatible: "renesas,rx-rmac-mdio"

include: [mdio-controller.yaml, pinctrl-device.yaml]

properties:
  channel:
    type: int
    required: true

  pinctrl-0:
    required: true

  pinctrl-names:
    required: true

  reset-gpios:
    type: phandle-array
    description: GPIO connected to MAC PHY reset signal pin. Reset is active low.
```

## dts/bindings/ethernet/phy/renesas,q32xx-phy.yaml
```yaml
# Copyright (c) 2026 Renesas Electronics Corporation
# SPDX-License-Identifier: Apache-2.0

description: Renesas implementation of the PHY Q32XX

compatible: "renesas,q32xx-phy"

include: ethernet-phy-common.yaml

properties:
  renesas,line-rate:
    type: string
    description: |
      T1 line rate programmed during initialization. If not specified, the device will use
      default HW strap setting. This PHY driver currently supports 2500 and 5000 through
      this property.
    enum:
      - "2500BASE-T1"
      - "5000BASE-T1"

  renesas,master-slave:
    type: string
    description: |
      Operation mode programmed during initialization. If not specified, the device will
      use default HW strap to determine master/slave mode.
    enum:
      - "slave"
      - "master"

  renesas,serdes-speed:
    type: string
    description: |
      SerDes speed programmed during initialization. If not specified, the device will
      use default HW strap to determine SerDes speed.
    enum:
      - "2500_BASEX"
      - "2P5G_BASEX"
      - "5000_BASER"
      - "5G_BASER"
      - "10G_BASER"
      - "5G_USXGMII"
      - "10G_USXGMII"
```

## dts/bindings/ethernet/phy/renesas,rcar-ether-pcs-channel.yaml
```yaml
# Copyright (c) 2026 Renesas Electronics Corporation
# SPDX-License-Identifier: Apache-2.0

description: |
  Renesas R-Car X5H Ethernet PCS channel. Each channel drives the SERDES
  lane (through the MP-PHY) between one rswitch3 ETHA port and its
  external PHY.

compatible: "renesas,rcar-ether-pcs-channel"

include: [phy.yaml]

properties:
  reg:
    required: true
    description: PCS channel index within the parent PCS block.

  phys:
    type: phandle-array
    required: true
    description: MP-PHY channel/lane driving this PCS channel's SERDES.

  phy-mode:
    type: string
    required: true
    enum:
      - "sgmii"
      - "usxgmii"
    description: MAC-to-PCS interface mode used by this channel's ETHA port.
```

## dts/bindings/ethernet/phy/ti,dp83869.yaml
```yaml
# Copyright (c) 2026 Renesas Electronics Corporation
# SPDX-License-Identifier: Apache-2.0

description: |
  TI DP83869 Ethernet PHY device

  Example usage:
    #include <zephyr/dt-bindings/ethernet/phy/ti_dp83869.h>

    phy@2 {
        compatible = "ti,dp83869";
        reg = <2>;
        ti,op-mode = <DP83869_OP_MODE_SGMII_COPPER_ETHERNET>;
        status = "okay";
    };

compatible: "ti,dp83869"

include: ethernet-phy-common.yaml

properties:
  ti,op-mode:
    type: int
    description: |
      Operational mode for the PHY.

      If not specified, the device will use HW strap to set operation mode.

      Currently supported modes:
        0: DP83869_OP_MODE_RGMII_COPPER_ETHERNET
        6: DP83869_OP_MODE_SGMII_COPPER_ETHERNET
    enum:
      - 0
      - 6

  ti,rx-internal-delay-ps:
    type: int
    description: |
      RX internal delay, in picoseconds, for RGMII mode.
      If not specified, the driver does not modify the RX internal delay setting.
      The DP83869 reset value for the RGMII RX internal delay is 2000ps.
      A value of 0 disables the RX internal delay.
    enum: [0, 250, 500, 750, 1000, 1250, 1500, 1750, 2000, 2250, 2500, 2750, 3000, 3250, 3500, 3750]

  ti,tx-internal-delay-ps:
    type: int
    description: |
      TX internal delay, in picoseconds, for RGMII mode.
      If not specified, the driver does not modify the TX internal delay setting.
      The DP83869 reset value for the RGMII TX internal delay is 2000ps.
      A value of 0 disables the TX internal delay.
    enum: [0, 250, 500, 750, 1000, 1250, 1500, 1750, 2000, 2250, 2500, 2750, 3000, 3250, 3500, 3750]

  ti,rx-fifo-depth:
    type: string
    description: |
      Receive FIFO depth.
      If not specified, the driver does not modify the RX FIFO depth setting.
      The DP83869 reset value for the RX FIFO depth is 4 bytes/nibbles (B/NIB).
    enum:
      - "3b-nib"
      - "4b-nib"
      - "6b-nib"
      - "8b-nib"

  ti,tx-fifo-depth:
    type: string
    description: |
      Transmit FIFO depth.
      If not specified, the driver does not modify the TX FIFO depth setting.
      The DP83869 reset value for the TX FIFO depth is 4 bytes/nibbles (B/NIB).
    enum:
      - "3b-nib"
      - "4b-nib"
      - "6b-nib"
      - "8b-nib"

  default-speeds:
    default: ["10BASE Half-Duplex", "10BASE Full-Duplex", "100BASE Half-Duplex",
              "100BASE Full-Duplex", "1000BASE Half-Duplex", "1000BASE Full-Duplex"]
```

## dts/bindings/ethernet/renesas,r8a78000-ether-pcs.yaml
```yaml
# Copyright (c) 2026 Renesas Electronics Corporation
# SPDX-License-Identifier: Apache-2.0

description: Renesas R-Car X5H Ethernet PCS block

compatible: "renesas,r8a78000-ether-pcs"

include: [base.yaml]

properties:
  reg:
    required: true
```

## dts/bindings/ethernet/renesas,rcar-ptp-clock-channel.yaml
```yaml
# Copyright (c) 2026 Renesas Electronics Corporation
# SPDX-License-Identifier: Apache-2.0

description: Renesas R-Car PTP (Precision Time Protocol) Clock Channel

compatible: "renesas,rcar-ptp-clock-channel"

include: ["base.yaml"]

properties:
  reg:
    required: true
```

## dts/bindings/ethernet/renesas,rcar-ptp-clock.yaml
```yaml
# Copyright (c) 2026 Renesas Electronics Corporation
# SPDX-License-Identifier: Apache-2.0

description: Renesas R-Car PTP (Precision Time Protocol) Clock

compatible: "renesas,rcar-ptp-clock"

include: ["base.yaml"]

properties:
  reg:
    required: true

  clock-frequency:
    type: int
    required: true
    description: Nominal Clock Frequency of PTP Clock
```

## dts/bindings/ethernet/renesas,rcarsoc-eth-tsnes.yaml
```yaml
# Copyright (c) 2026 Renesas Electronics Corporation
# SPDX-License-Identifier: Apache-2.0

description: Renesas RCARSOC Ethernet TSNES

compatible: "renesas,rcarsoc-eth-tsnes"

include: [ethernet-controller.yaml, pinctrl-device.yaml]

properties:
  reg:
    required: true

  reg-names:
    required: true

  channel:
    type: int
    required: true

  interrupts:
    description: |
      IRQ configuration
    required: true

  interrupt-names:
    description: Interrupt names for debugging

  rx-queues:
    description: Number of RX queues (1-32)
    type: int
    default: 1

  tx-queues:
    description: Number of TX queues (1-8)
    type: int
    default: 1

  rx-queue-size:
    description: RX descriptor ring size per queue (must be a power of 2)
    type: int
    default: 1024

  tx-queue-size:
    description: TX descriptor ring size per queue (must be a power of 2)
    type: int
    default: 1024

  renesas,rswitch:
    description: Phandle to the main rswitch3 device
    type: phandle
    required: true

  renesas,rswitch-if:
    description: Internal MAC port number on the switch
    type: int

  renesas,rswitch-forward-ports:
    description: Bitmask of physical ports for hardware forwarding
    type: int
```

## dts/bindings/ethernet/renesas,rcarsoc-rswitch3-gwca.yaml
```yaml
# Copyright (c) 2026 Renesas Electronics Corporation
# SPDX-License-Identifier: Apache-2.0

description: |
  One GWCA (Gateway CPU Agent) DMA engine of an R-Car R-Switch 3.

  The two engines are independent. Each has its own registers, queues,
  descriptor rings and receive thread, and both share the switch register
  block and the merged gateway interrupt.

  Enable the engines this core drives and disable the one another core owns.
  A port selects its engine with renesas,gwca.

compatible: "renesas,rcarsoc-rswitch3-gwca"

include: [base.yaml]

properties:
  reg:
    required: true
    enum:
      - 13
      - 14
    description: |
      Forwarding-agent index of this engine, 13 for GWCA0 and 14 for GWCA1.
      Engines and ports share one agent numbering, so no two children of the
      switch end up with the same unit address. The driver takes this engine's
      register block and its engine number for FWPBFCSDC() and TPDEMIMC_GDICM()
      from it.

  renesas,tx-ring-size:
    type: int
    required: true
    description: |
      Transmit descriptors in every queue of this engine. One queue serves one
      port. The depth sets how many frames the engine holds for transmission
      before software has to wait. It can range from 8 to 2048, and every
      descriptor reserves a frame buffer in the dedicated Ethernet RAM.

  renesas,rx-ring-size:
    type: int
    required: true
    description: |
      Receive descriptors in every queue of this engine. One queue serves one
      port. The depth sets how many frames may arrive between two runs of the
      receive thread without overrunning the ring. It can range from 8 to 4096,
      and every descriptor reserves a frame buffer in the dedicated Ethernet RAM.
```

## dts/bindings/ethernet/renesas,rcarsoc-rswitch3-port.yaml
```yaml
# Copyright (c) 2026 Renesas Electronics Corporation
# SPDX-License-Identifier: Apache-2.0

description: |
  Renesas R-Car R-Switch 3 port, one node per TSNA/ETHA agent. Read
  directly by the parent rswitch3 driver via DT_FOREACH_CHILD_STATUS_OKAY(),
  which brings the agent up, and by the per-port net_if driver in the same
  source file, which instantiates a GWCA-backed net_if for each external
  agent.

  A node is one of exactly two kinds, distinguished by which properties it
  sets:

  - external: this agent's RMAC talks to an external PHY. Set phy-handle
    and phy-mode, plus xpcs if a PCS channel drives the SerDes lane. The
    link state comes from the PHY behind phy-handle. Gets ETHA/PCS
    bring-up and a GWCA-backed net_if.
  - internal: this agent's RMAC talks directly to a TSN-ES endpoint
    instead. Set renesas,tsnes (and usually renesas,forward-ports), and
    none of xpcs, phy-handle or phy-mode. Gets internal ETHA bring-up only;
    the referenced TSN-ES device owns its own net_if and DMA engine.

  The driver rejects any other combination with a build-time assertion.

compatible: "renesas,rcarsoc-rswitch3-port"

include: [ethernet-controller.yaml]

properties:
  reg:
    required: true
    description: ETHA agent index for this physical port.

  xpcs:
    type: phandle
    description: PCS channel driving the SerDes lane for this port (external agents).

  phy-mode:
    type: string
    enum:
      - "rgmii"
      - "sgmii"
      - "usxgmii"
    description: |
      MAC-to-PCS interface mode for this port's ETHA agent. Required for
      external agents; not applicable to internal (renesas,tsnes) ones.

  renesas,gwca:
    type: phandle
    description: |
      GWCA engine that transfers this port's frames to and from a net_if on
      this core. The engine must be enabled. An external port without this
      property gets no net_if: it is only brought up and forwarded, for
      example to a TSN-ES agent through renesas,forward-ports. Not applicable
      to an internal (renesas,tsnes) port.

  renesas,tsnes:
    type: phandle
    description: |
      renesas,rcarsoc-eth-tsnes instance this agent's RMAC talks to
      internally, instead of an external SerDes/PHY. Only set on internal
      agents; mutually exclusive with xpcs/phy-handle/phy-mode.

  renesas,forward-ports:
    type: int
    description: |
      Bitmask (bit N = agent N) of external agents this internal agent's
      TSN-ES traffic may be forwarded to/from. Only meaningful alongside
      renesas,tsnes.
```

## dts/bindings/ethernet/renesas,rcarsoc-rswitch3.yaml
```yaml
# Copyright (c) 2026 Renesas Electronics Corporation
# SPDX-License-Identifier: Apache-2.0

description: Renesas R-Car Ethernet Rswitch 3

compatible: "renesas,rcarsoc-rswitch3"

include: [base.yaml]

properties:
  reg:
    required: true

  reg-names:
    required: true

  clocks:
    required: true

  clock-names:
    required: true

  interrupts:
    description: |
      GWCA data interrupt ("RX/TX process complete for CPU"). Every queue
      interrupt of both engines is combined onto this one line.
    required: true

  interrupt-names:
    description: Interrupt names for debugging
```
