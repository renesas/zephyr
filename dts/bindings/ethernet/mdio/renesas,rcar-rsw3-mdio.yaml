## dts/bindings/ethernet/renesas,rh850-ethernet-etnd.yaml
```yaml
# Copyright (c) 2026 Renesas Electronics Corporation
# SPDX-License-Identifier: Apache-2.0

description: |
  Renesas RH850 MCU Ethernet TSN (ETND) MAC controller.

compatible: "renesas,rh850-ethernet-etnd"

include: [ethernet-controller.yaml, pinctrl-device.yaml]

properties:
  reg:
    required: true

  interrupts:
    required: true

  interrupt-names:
    required: true
    description: |
      "data" - ETND TX/RX/error (FSP ether_cfg_t.irq).

  clocks:
    required: true
    description: |
      Clock for module.

  phy-handle:
    type: phandle
    required: true
    description: phandle to the external PHY node.

  channel:
    type: int
    default: 0
    description: ETND controller channel index.

  loopback:
    type: boolean
    description: Enable MAC internal loopback (test only).

  zephyr,mac-address-filter:
    type: uint8-array
    description: |
      Multicast destination MAC addresses to accept, 6 bytes per entry, at
      most 32 entries. Only used when CONFIG_ETH_RENESAS_RH850_ETND_ADDR_FILTER
      is enabled; the table is programmed once at R_ETHER_TSN_Open() and is
      not updated at runtime. Broadcast and the interface's own unicast
      address are always accepted; unicast entries are ignored by the HAL.

      Example (IPv6 all-nodes, IPv6 solicited-node for MAC ..:54:53:4e,
      IPv4 all-hosts):
        zephyr,mac-address-filter = [33 33 00 00 00 01
                                      33 33 ff 54 53 4e
                                      01 00 5e 00 00 01];

  txq-num:
    type: int
    default: 1
    const: 1
    description: |
      Number of TX queues. Only support 1 queue for this version.

  txb0-num:
    type: int
    default: 8
    description: |
      TX buffer/descriptor count for queue 0. Range from 1 to 64.

  txq0-max-frame-size:
    type: int
    default: 1518
    description: |
      Max TX frame size in bytes for queue 0. Range from 64 to 4095.

  rxq-num:
    type: int
    default: 1
    const: 1
    description: |
      Number of RX queues. Only support 1 queue for this version.

  rxb0-num:
    type: int
    default: 8
    description: |
      Number of RX descriptors count for queue 0. Range from 1 to 64.

  rxq0-max-frame-size:
    type: int
    default: 1514
    description: |
      Max RX frame size in bytes for queue 0, FCS excluded. Range from 64 to 4095.
      Longer frames are truncated by the MAC. The default matches
      NET_ETH_MAX_FRAME_SIZE without CONFIG_NET_VLAN; set it to 1518 when
      CONFIG_NET_VLAN is enabled.
```

## dts/bindings/ethernet/renesas,rh850-ethernet-etnf.yaml
```yaml
# Copyright (c) 2026 Renesas Electronics Corporation
# SPDX-License-Identifier: Apache-2.0

description: Renesas RH850 Ethernet T1S (10BASE-T1S)

compatible: "renesas,rh850-ethernet-etnf"

include: [ethernet-controller.yaml, pinctrl-device.yaml]

properties:
  reg:
    required: true

  interrupts:
    required: true

  clocks:
    required: true
    description: |
      Clock for using the module.

  channel:
    type: int
    default: 0
    description: ETNF controller channel index.

  mdio-interface:
    type: string
    required: true
    enum:
      - "dedicated"   # ETS0_MDC + ETS0_MDIO
      - "shared"      # ETS0_RX_MDC + ETS0_ED_MDIO
    description: |
      Selects which MDIO pin pair to use for bit-bang PHY access.
      Maps to ether_t1s_mdio_interface_type_t in the FSP.

  loopback:
    type: boolean
    description: Enable internal loopback mode (for testing only).

  pma-filtered:
    type: boolean
    description: |
      Configure PMA to handle a filtered T1S energy detection.
      If absent, unfiltered mode is used (ETHER_T1S_PMA_UNFILTERED).

  zephyr,mac-address-filter:
    type: uint8-array
    description: |
      Multicast destination MAC addresses to accept, 6 bytes per entry, at
      most 32 entries. Only used when CONFIG_ETH_RENESAS_RH850_ETNF_ADDR_FILTER
      is enabled; the table is programmed once at R_ETHER_T1S_Open() and is
      not updated at runtime. Broadcast and the interface's own unicast
      address are always accepted; unicast entries are ignored by the HAL.

      Example (IPv6 all-nodes, IPv6 solicited-node for MAC ..:12:34:56,
      IPv4 all-hosts):
        zephyr,mac-address-filter = [33 33 00 00 00 01
                                      33 33 ff 12 34 56
                                      01 00 5e 00 00 01];

  txq-num:
    type: int
    default: 1
    const: 1
    description: |
      Number of TX queues. Only support 1 queue for this version.

  rxq-num:
    type: int
    default: 1
    const: 1
    description: |
      Number of RX queues. Only support 1 queue for this version.

  txb0-num:
    type: int
    default: 8
    description: |
      TX buffer count for queue 0. Range from 1 to 64.

  rxb0-num:
    type: int
    default: 8
    description: |
      RX buffer count for queue 0. Range from 1 to 64.
```

## dts/bindings/ethernet/renesas,rx-eswm.yaml
```yaml
# Copyright (c) 2025 Renesas Electronics Corporation
# SPDX-License-Identifier: Apache-2.0

description: Renesas RX Ethernet RMAC

compatible: "renesas,rx-eswm"

include: [base.yaml, pinctrl-device.yaml]

properties:
  reg:
    required: true
  clocks:
    required: true
```

## dts/bindings/ethernet/renesas,rx-rmac.yaml
```yaml
# Copyright (c) 2025 Renesas Electronics Corporation
# SPDX-License-Identifier: Apache-2.0

description: Renesas RX Ethernet RMAC

compatible: "renesas,rx-rmac"

include: [ethernet-controller.yaml, pinctrl-device.yaml]

properties:
  reg:
    required: true

  channel:
    type: int
    required: true

  phy-handle:
    required: true

  phy-clock:
    type: phandle
    required: true
    description: |
      Specifies the reference clock node for PHY device.

  phy-clock-type:
    type: string
    required: true
    enum:
      - "xtal"
      - "internal"
    description: |
      Specifies the clock type of reference clock:
      "xtal": use xtal as clock source
      "internal": use ETHPHYCLK pin output as clock source

  txq-num:
    type: int
    default: 2
    description: Number of TX queues

  rxq-num:
    type: int
    default: 2
    description: Number of RX queues

  txq-len:
    type: int
    default: 4
    description: |
      Number of descriptors in each TX queue

  rxq-len:
    type: int
    default: 4
    description: |
      Number of descriptors in each RX queue

  txb-num:
    type: int
    default: 12
    description: |
      Number of TX buffers

  rxb-num:
    type: int
    default: 12
    description: |
      Number of RX buffers

  power-fail-gpios:
    type: phandle-array
    description: |
      Optional input that is active while a power fail is in progress. The ETHA registers
      are not accessed during a power fail: a PHY link change reported in that time is
      deferred, and the current link state is read back from the PHY when the input goes
      inactive. Example:

        power-fail-gpios = <&port0 0 GPIO_ACTIVE_LOW>;

  gwdis:
    type: phandle-array
    description: |
      Group interrupt specifier for the GWCA0 data interrupt (gwdi).
      First cell: phandle to the group interrupt controller
      Second cell: number of the gwdi in the group
```

## dts/bindings/firmware/renesas,scmi-reset-status.yaml
```yaml
# Copyright (c) 2026 Renesas Electronics Corporation
# SPDX-License-Identifier: Apache-2.0

description: Renesas SCMI vendor reset status interface

compatible: "renesas,scmi-reset-status"

include: [base.yaml]

properties:
  reg:
    required: true
    const: [0x80]
```

## dts/bindings/flash_controller/renesas,rx-mram-controller.yaml
```yaml
# Copyright (c) 2025 Renesas Electronics Corporation
# SPDX-License-Identifier: Apache-2.0

description: Renesas RX flash MRAM controller

compatible: "renesas,rx-mram-controller"

include: flash-controller.yaml
```

## dts/bindings/flash_controller/renesas,rx-mram-region-ctrl.yaml
```yaml
# Copyright (c) 2026 Renesas Electronics Corporation
# SPDX-License-Identifier: Apache-2.0

description: |
  Renesas RX MRAM region controller.

  Represents a single programmable MRAM region (code or data) of the RX MRAM
  controller. This node is the flash device that owns the soc-nv-flash node
  describing the region and any zephyr,mapped-partition nodes beneath it. It is
  a child of the renesas,rx-mram-controller node

compatible: "renesas,rx-mram-region-ctrl"

include: base.yaml
```

## dts/bindings/flash_controller/renesas,rx-ospi-b-nor.yaml
```yaml
# Copyright (c) 2025 Renesas Electronics Corporation
# SPDX-License-Identifier: Apache-2.0

description: Renesas RX OSPI FLASH

compatible: "renesas,rx-ospi-b-nor"

include: ["flash-controller.yaml", "jedec,jesd216.yaml"]

on-bus: ospi

properties:
  reg:
    required: true
    description: Chip Select channel on OSPI

  write-block-size:
    type: int
    default: 1
    description: Address alignment required by flash write operations

  protocol-mode:
    type: int
    required: true
    description: |
     The width and rate of XSPI bus to which flash memory is connected.

     Possible values are :
      - XSPI_SPI_MODE  <1> = SPI mode on 1 data line
      - XSPI_DUAL_MODE <2> = Dual mode on 2 data lines
      - XSPI_QUAD_MODE <4> = Quad mode on 4 data lines
      - XSPI_OCTO_MODE <8> = Octo mode on 8 data lines
    enum: [ 1, 2, 4, 8 ]

  data-rate:
    type: int
    required: true
    description: |
     The SPI data Rate is STR or DTR

     Possible values are :
      - XSPI_STR_TRANSFER <1> = Single Rate Transfer
      - XSPI_DTR_TRANSFER <2> = Dual Rate Transfer (only with XSPI_OCTO_MODE)
    enum:
      - 1
      - 2

  ospi-max-frequency:
    type: int
    required: true
    description: Max frequency input on OSPI

  size:
    required: true
    description: Total size of the flash memory in bytes

  max-write-size:
    type: int
    default: 64
    description: Maximum number of bytes that can be programmed in a single write operation

  auto-calib-pattern-address-sector:
    type: int
    default: 3
    description: Sector number that stores the auto calibration pattern

  write-status-bit:
    type: int
    default: 0
    description: Bit position of the write in progress (WIP) bit in the status register
    enum: [0, 1, 2, 3, 4, 5, 6, 7]

  write-enable-bit:
    type: int
    default: 1
    description: Bit position of the write enable latch (WEL) bit in the status register
    enum: [0, 1, 2, 3, 4, 5, 6, 7]

  command-interval:
    type: int
    default: 2
    description: Minimum clock cycles between 2 commands.
    enum: [0, 1, 2, 3, 4, 5, 6, 7, 8 , 9, 10, 11, 12, 13, 14, 15, 16]

  pull-up-delay:
    type: boolean
    description: De-assert CS line 1 clock cycle after the last command

  pull-down-lead:
    type: boolean
    description: Assert CS line 1 clock cycle before the first command

  sdr-drive-timing:
    type: int
    default: 0
    enum:
      - 0
      - 1
    description: |
      Selects the SDR drive timing setting
      - 0: drive 1/2 cycle before CK
      - 1: drive at CK

  sdr-sampling-edge:
    type: int
    default: 0
    enum:
      - 0
      - 1
    description: |
      Selects the SDR CK sampling edge
      - 0: sample at falling edge of CK
      - 1: sample at rising edge of CK

  sdr-sampling-delay:
    type: int
    default: 0
    description: Number of cycles to delay before sampling data on SDR read operations (0 - 7)

  ddr-sampling-extension:
    type: int
    default: 0
    description: |
      Number of cycles to extending the data sampling window on DDR read operations (0 - 7)

  output-assert-delay:
    type: string
    default: ASSERTION_DELAY_DISABLE
    enum:
      - ASSERTION_DELAY_DISABLE
      - ASSERTION_DELAY_ENABLE
    description: |
      Assertion timing of the output buffer control signal. Setting this  will delays the start
      of output from the IO pins and the DS pin by one cycle.
```
