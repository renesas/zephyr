## dts/bindings/rtc/renesas,rx-rtc.yaml
```yaml
# Copyright (c) 2026 Renesas Electronics Corporation
# SPDX-License-Identifier: Apache-2.0

description: Renesas RX RTC

compatible: "renesas,rx-rtc"

include: rtc-device.yaml

properties:
  reg:
    required: true

  clocks:
    required: true

  interrupt-names:
    required: true
    enum:
      - "cup"
      - "prd"
      - "alm"
    description: |
      - "cup": carry interrupt
      - "prd": periodic interrupt
      - "alm": alarm interrupt
```

## dts/bindings/sent/renesas,rh850-sent.yaml
```yaml
# Copyright (c) 2026 Renesas Electronics Corporation
# SPDX-License-Identifier: Apache-2.0

title: Renesas RH850 RSENT Receiver Controller

description: |
  Renesas RH850 RSENT receiver controller.

  The controller receives SENT fast-channel and serial-channel messages.
  Each enabled child node represents one hardware RSENT channel.

  Channel child-node properties describe static hardware configuration,
  including the number of fast-message data nibbles, communication tick
  length, frame checking, CRC checking, slow-message extraction, and
  pause-pulse handling.

compatible: "renesas,rh850-sent"

include:
  - name: sent-controller.yaml
    child-binding:
      property-allowlist:
        - reg
        - num-data-nibbles
        - clock-tick-length-us
        - fast-crc
        - short-serial-crc
        - successive-calib-pulse-method
        - pause-pulse-detect

  - name: pinctrl-device.yaml

properties:
  reg:
    required: true

  interrupts:
    required: true

  interrupt-names:
    required: true

  clocks:
    required: true

  unit:
    type: int
    required: true
    description: |
      RSENT hardware unit number
      This value identifies the RSENT peripheral instance and is used
      as the logical channel identifier exposed through the generic
      SENT API.

  pinctrl-0:
    required: true

  pinctrl-names:
    required: true

child-binding:
  description: |
    Configuration of one Renesas RH850 RSENT hardware channel.

    The value of the reg property identifies the hardware channel within
    the RSENT controller. Other properties contain the static configuration
    used to initialize that channel.

  properties:
    slow-message-format:
      type: string
      required: true
      enum:
        - "disabled"
        - "short-serial"
        - "enhanced-serial"
      description: |
        Slow-channel message extraction format.

        Supported values are:

        - "disabled": Do not extract slow-channel messages.
        - "short-serial": Short serial message with 8-bit data and
          a 4-bit message ID.
        - "enhanced-serial": Enhanced serial message with 12-bit
          data and an 8-bit message ID (or 16-bit data and a 4-bit
          message ID - when the slow channel message reception buffer
          is updated).

    message-length-mode:
      type: string
      enum:
        - "variable"
        - "fixed"
      description: |
        Selects the received SENT message-length handling mode when
        pause-pulse-detect is enabled.

        Supported values are:

        - "variable": Use pause-pulse reception with variable message
          length. The RSENT hardware performs the applicable automatic
          frame timing checks.
        - "fixed": Use pause-pulse reception with fixed message length.
          The RSENT hardware provides the measured calibration-pulse and
          message lengths for software validation.

        This property does not enable pause-pulse detection.
        The pause-pulse-detect property controls whether received frames
        contain a pause pulse. When pause-pulse-detect is not enabled,
        this property does not affect the hardware configuration.

    dmas:
      type: phandle-array
      description: |
        Optional DMA channel used for RSENT data reception.

        If this property is omitted, the driver uses interrupt-driven
        message reception.

    dma-names:
      type: string-array
      description: |
        Names of the DMA channels used by this RSENT channel.

        The expected name is "rx".
```

## dts/bindings/spi/renesas,rx-spi-b.yaml
```yaml
# Copyright (c) 2025 Renesas Electronics Corporation
# SPDX-License-Identifier: Apache-2.0

description: Renesas RX SPI_B controller

compatible: "renesas,rx-spi-b"

include: [spi-controller.yaml, pinctrl-device.yaml]

properties:
  channel:
    type: int
    required: true

  reg:
    required: true

  clocks:
    required: true

  pinctrl-0:
    required: true

  pinctrl-names:
    required: true
```

## dts/bindings/spi/renesas,rx-spi-sci-b.yaml
```yaml
# Copyright (c) 2025 Renesas Electronics Corporation
# SPDX-License-Identifier: Apache-2.0

description: Renesas RX SCI SPI controller

compatible: "renesas,rx-spi-sci-b"

include: [spi-controller.yaml, pinctrl-device.yaml]
```

## dts/bindings/timer/renesas,rx-gpt-timer.yaml
```yaml
# Copyright (c) 2026 Renesas Electronics Corporation
# SPDX-License-Identifier: Apache-2.0

description: Renesas RX timer node

compatible: "renesas,rx-gpt-timer"

include: base.yaml
```

## dts/bindings/usb/renesas/renesas,rx-udc.yaml
```yaml
# Copyright (c) 2025 Renesas Electronics Corporation
# SPDX-License-Identifier: Apache-2.0

description: Renesas RX USB device controller

compatible: "renesas,rx-udc"
```

## dts/bindings/usb/renesas/renesas,rx-usbfs.yaml
```yaml
# Copyright (c) 2025 Renesas Electronics Corporation
# SPDX-License-Identifier: Apache-2.0

description: Renesas RX USB full-speed controller

compatible: "renesas,rx-usbfs"

include: [pinctrl-device.yaml, usb-ep.yaml]

properties:
  phys-clock:
    type: phandles
    required: true
    description: USBFS physical clock.

  interrupts:
    required: true
    description: |
      IRQ number and priority to use for USBFS.

  interrupt-names:
    required: true
    enum:
      - "usbi"
      - "usbr"
    description: |
      Interrupts must be given corresponding names so that the shim driver can recognize them.

  reg:
    required: true

  phys:
    type: phandle
    description: PHY provider specifier
```

## dts/bindings/usb/renesas/renesas,rx-usbhs.yaml
```yaml
# Copyright (c) 2025 Renesas Electronics Corporation
# SPDX-License-Identifier: Apache-2.0

description: Renesas RX USB high-speed controller

compatible: "renesas,rx-usbhs"

include: [pinctrl-device.yaml, usb-ep.yaml]

properties:
  phys-clock:
    type: phandles
    description: |
      USBHS physical clocks.
      Should be provided in case internal clock source is set in phys node.

  interrupts:
    required: true
    description: |
      IRQ number and priority to use for USBHS.

  interrupt-names:
    required: true
    enum:
      - "usbhsr"
    description: |
      Interrupts must be given corresponding names
      so that the shim driver can recognize them.

  reg:
    required: true

  phys:
    type: phandle
    description: PHY provider specifier
```

## dts/bindings/usb/zephyr,usbh-hid.yaml
```yaml
# Copyright (c) 2026 Renesas, Embedd
# SPDX-License-Identifier: Apache-2.0

description: Bindings for HID Host driver

compatible: "zephyr,usbh-hid"

include: base.yaml

properties:
  "#address-cells":
    required: true
    const: 1

  "#size-cells":
    required: true
    const: 0
```

## dts/bindings/video/renesas,ra-mipi-csi.yaml
```yaml
# Copyright (c) 2026 Renesas Electronics Corporation
# SPDX-License-Identifier: Apache-2.0

description: Renesas RA MIPI CSI

compatible: "renesas,ra-mipi-csi"

include: [base.yaml, pinctrl-device.yaml]

properties:
  reg:
    required: true

  clocks:
    required: true

  clock-names:
    required: true

  phys:
    type: phandle-array
    required: true
    description: |
      MIPI D-PHY providing the physical layer for this CSI-2 receiver, in
      slave mode. See renesas,ra-mipi-dphy.yaml.

  phy-names:
    type: string-array

  ulps-wakeup-period:
    type: int
    description: ULPS wakeup period.

  hsync-sample:
    type: int
    description: |
      Specifies the number of PCLK cycles to sample the HSYNC signal.

  vsync-sample:
    type: int
    description: |
      Specifies the number of PCLK cycles to sample the VSYNC signal.

  video-mode-delay:
    type: int
    description: |
      Set the delay value inside DSI Host until the transfer begins.

  timing:
    type: array

child-binding:
  description: |
    "ports" node grouping the sensor-facing input port (port@0) and the
    VIN-facing output port (port@1).
  child-binding:
    child-binding:
      include: video-interfaces.yaml
```

## dts/bindings/video/renesas,ra-vin.yaml
```yaml
# Copyright (c) 2026 Renesas Electronics Corporation
# SPDX-License-Identifier: Apache-2.0

description: Renesas RA VIN Driver

compatible: "renesas,ra-vin"

include: [base.yaml, pinctrl-device.yaml]

properties:
  reg:
    required: true

  clocks:
    required: true

  clock-names:
    required: true

  interrupts:
   required: true

  interrupt-names:
   required: true

  input-format:
    type: int

  data-type:
    type: int

  virtual-channel:
    type: int

  image-stride:
    type: int

  line-start:
    type: int

  line-end:
    type: int

  pixel-start:
    type: int

  pixel-end:
    type: int

  scaling-enable:
    type: boolean

  frame-write-complete-interrupt:
    type: boolean

child-binding:
  description: |
    "port" node with a single "endpoint" child linked, via
    remote-endpoint-label, to the MIPI CSI-2 output-side endpoint
    (renesas,ra-mipi-csi.yaml port@1) that feeds this VIN instance.
  child-binding:
    include: [video-interfaces.yaml]
```

## dts/bindings/watchdog/renesas,rcar-wwdt.yaml
```yaml
# Copyright (c) 2026 Renesas Electronics Corporation and/or its affiliates
# SPDX-License-Identifier: Apache-2.0

description: Renesas R-Car Window Watchdog Timer (WWDT)

compatible: "renesas,rcar-wwdt"

include: [base.yaml, "reset-device.yaml"]

properties:
  reg:
    required: true

  interrupts:
    description: WWDT 75 percent warning interrupt

  clocks:
    required: true
    description: Reference to the RCLK fixed clock that drives the WWDT counter

  resets:
    required: true
    description: The two module reset domains of the WWDT instance

  warning-irq-enabled:
    type: boolean
    description: Enable early warning interrupt threshold in 75 percent

  error-mode:
    type: string
    enum:
      - "nmi"
      - "reset"
    default: "reset"
    description: |
      Select WWDT handle error condition behavior:
       - nmi: generates an NMI request for ECM.
       - reset: generates a reset request for ECM.
      Defaults to "reset" (hardware reset value for handling error mode).
```

## dts/bindings/watchdog/renesas,rx-iwdt-fsp.yaml
```yaml
# Copyright (c) 2026 Renesas Electronics Corporation
# SPDX-License-Identifier: Apache-2.0

description: Renesas RX Independent Watchdog Timer (IWDT)

compatible: "renesas,rx-iwdt-fsp"

include: base.yaml

properties:
  reg:
    required: true

  clocks:
    required: true
```

## modules/mbedtls/Kconfig.mbedtls_alt
```kconfig
# MbedTLS Renesas alternative related options

# Copyright (c) 2025 Renesas Electronics Corporation
# SPDX-License-Identifier: Apache-2.0

menu "Mbed TLS alternative configuration"
	depends on MBEDTLS_CUSTOM && MBEDTLS_CFG_FILE = "alt_config.h"

config MBEDTLS_CIPHER_ALT
	bool "Use cipher alternative implementation"
	default y
	depends on MBEDTLS_CIPHER

config MBEDTLS_AES_ALT
	bool "Use AES alternative implementation"
	default y
	depends on MBEDTLS_CIPHER_AES_ENABLED

config MBEDTLS_CCM_ALT
	bool "Use CCM alternative implementation"
	default y
	depends on MBEDTLS_CIPHER_CCM_ENABLED

config MBEDTLS_GCM_ALT
	bool "Use GCM alternative implemetation"
	default y
	depends on MBEDTLS_CIPHER_GCM_ENABLED

config MBEDTLS_CMAC_ALT
	bool "Use CMAC alternative implementation"
	default y
	depends on MBEDTLS_CMAC

config MBEDTLS_RSA_ALT
	bool "Use RSA alternative implemetation"
	default y
	depends on MBEDTLS_RSA_C

config MBEDTLS_PLATFORM_SETUP_TEARDOWN_ALT
	bool "Use platform setup alternative implemetation"
	default y

config MBEDTLS_ECP_ALT
	bool "Use ECP alternative implementation"
	default y
	depends on MBEDTLS_ECP_C

config MBEDTLS_SHA256_ALT
	bool "Use SHA256 alternative implementation"
	default y
	depends on MBEDTLS_SHA256

config MBEDTLS_SHA512_ALT
	bool "Use SHA512 alternative implementation"
	default y
	depends on MBEDTLS_SHA512

config MBEDTLS_ECDSA_VERIFY_ALT
	bool "Use ECDSA verify alternative implementation"
	default y
	depends on MBEDTLS_ECDSA_C

config MBEDTLS_ECDSA_SIGN_ALT
	bool "Use ECDSA sign alternative implementation"
	default y
	depends on MBEDTLS_ECDSA_C

config MBEDTLS_CTR_DRBG_C_ALT
	bool "Use CTR DRBG C alternative implementation"
	default y
	depends on MBEDTLS_CTR_DRBG_ENABLED

config MBEDTLS_ECDH_ALT
	bool "Use ECDH alternative implementation"
	default y
	depends on MBEDTLS_ECDH_C

if MBEDTLS_AES_ALT

choice MBEDTLS_AES_KEY_FORMAT
	prompt "Select AES key format"
	default MBEDTLS_AES_KEY_WRAPPED_AND_PLAINTEXT

config MBEDTLS_AES_KEY_WRAPPED_AND_PLAINTEXT
	bool "AES key format include plaintext and wrapped (vendor)"

config MBEDTLS_AES_KEY_PLAINTEXT
	bool "AES key format include plaintext only"

endchoice # MBEDTLS_AES_KEY_FORMAT

endif # MBEDTLS_AES_ALT

if MBEDTLS_ECP_ALT

choice MBEDTLS_ECC_KEY_FORMAT
	prompt "Select ECC key format"
	default MBEDTLS_ECC_KEY_WRAPPED_AND_PLAINTEXT

config MBEDTLS_ECC_KEY_WRAPPED_AND_PLAINTEXT
	bool "ECC key format include plaintext and wrapped (vendor)"

config MBEDTLS_ECC_KEY_PLAINTEXT
	bool "ECC key format include plaintext only"

endchoice # MBEDTLS_ECC_KEY_FORMAT

endif # MBEDTLS_ECP_ALT

if MBEDTLS_RSA_ALT

choice MBEDTLS_RSA_KEY_FORMAT
	prompt "Select RSA key format"
	default MBEDTLS_RSA_KEY_WRAPPED_AND_PLAINTEXT

config MBEDTLS_RSA_KEY_WRAPPED_AND_PLAINTEXT
	bool "RSA key format include plaintext and wrapped (vendor)"

config MBEDTLS_RSA_KEY_PLAINTEXT
	bool "RSA key format include plaintext only"

endchoice # MBEDTLS_RSA_KEY_FORMAT

config MBEDTLS_RSA3K_KEYGEN_ENABLED
	bool "Enable RSA3072 bits key generator"

config MBEDTLS_RSA3K_SIGNING_ENABLED
	bool "Enable RSA3072 bits signing"

config MBEDTLS_RSA3K_VERIFICATION_ENABLED
	bool "Enable RSA3072 bits verification"

config MBEDTLS_RSA4K_KEYGEN_ENABLED
	bool "Enable RSA4096 bits key generator"

config MBEDTLS_RSA4K_SIGNING_ENABLED
	bool "Enable RSA4096 bits signing"

config MBEDTLS_RSA4K_VERIFICATION_ENABLED
	bool "Enable RSA4096 bits verification"

endif # MBEDTLS_RSA_ALT

endmenu
```

## samples/boards/renesas/tfm_dual_core_ospi/Kconfig.sysbuild
```kconfig
# Copyright (c) 2026 Renesas Electronics Corporation
# SPDX-License-Identifier: Apache-2.0

source "share/sysbuild/Kconfig"

config CM85_NS_BOARD
	string "Cortex-M85 non-secure board target"
	default "ek_ra8p1/r7ka8p1kflcac/cm85/ns" if "$(BOARD)/$(BOARD_QUALIFIERS)" = "ek_ra8p1/r7ka8p1kflcac/cm33/ns"
	help
	  Board target of the Cortex-M85 non-secure image, built with TF-M.
	  That image verifies the Cortex-M33 image in OSPI flash and starts
	  the Cortex-M33.
```
