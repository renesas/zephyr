## samples/drivers/adc/adc_stream/sample.yaml
```yaml
sample:
  name: ADC stream sample
common:
  tags: adc
  depends_on: adc
  filter: dt_alias_exists("adc0") and dt_node_has_prop("/zephyr,user","io-channels")
  harness: console
  harness_config:
    type: one_line
    regex:
      - "^ADC data for [^@]+@\\d+ channel \\d+ \\([0-9.]+\\) \\d+ns$"
tests:
  sample.drivers.adc.adc_stream: {}
  sample.drivers.adc.adc_stream.ad4052-stream:
    extra_args:
      - SHIELD=eval_ad4052_ardz
      - EXTRA_CONF_FILE=ad4052-stream.conf
      - DTC_OVERLAY_FILE=boards/apard32690_max32690_m4_ad4052.overlay
    platform_allow:
      - apard32690/max32690/m4
  sample.drivers.adc.adc_stream.max32-stream:
    extra_args:
      - EXTRA_CONF_FILE=max32-stream.conf
      - DTC_OVERLAY_FILE=boards/apard32690_max32690_m4_max32.overlay
    platform_allow:
      - apard32690/max32690/m4
  sample.drivers.adc.adc_stream.rh850-adck-stream:
    extra_args:
      - EXTRA_CONF_FILE=rh850-adck-stream.conf
      - DTC_OVERLAY_FILE=boards/pb_rh850u2b_468pin_r7f70254xfabg-c.overlay
    platform_allow:
      - pb_rh850u2b_468pin/r7f70254xfabg-c
  sample.drivers.adc.adc_stream.rh850-adcj-stream:
    extra_args:
      - EXTRA_CONF_FILE=rh850-adcj-stream.conf
      - DTC_OVERLAY_FILE=boards/pb_rh850u2a_516pin_r7f702300aebbc-c.overlay
    platform_allow:
      - pb_rh850u2a_516pin/r7f702300aebbc-c
```

## samples/drivers/can/babbling/boards/pb_rh850u2a_516pin_r7f702300bebbc-c.conf
```kconfig
# Copyright (c) 2026 Renesas Electronics Corporation
# SPDX-License-Identifier: Apache-2.0

CONFIG_ISR_STACK_SIZE=4096
```

## samples/drivers/counter/alarm/sample.yaml
```yaml
sample:
  name: Counter RTC Driver Sample
common:
  tags:
    - drivers
    - counter
  harness: console
  harness_config:
    type: multi_line
    ordered: true
    regex:
      - "Counter alarm sample"
      - "Set alarm in 2 sec"
      - "!!! Alarm !!!"
      - "Now: [2|3]"
  depends_on: counter
tests:
  sample.drivers.counter.alarm:
    platform_allow:
      - nucleo_f746zg
      - nrf51dk/nrf51822
      - nrf52dk/nrf52832
      - nrf52840dk/nrf52840
      - nrf5340dk/nrf5340/cpuapp
      - nrf54h20dk/nrf54h20/cpuapp
      - nrf54h20dk/nrf54h20/cpuflpr
      - nrf54h20dk/nrf54h20/cpuppr
      - nrf54h20dk/nrf54h20/cpurad
      - nrf54l15dk/nrf54l15/cpuapp
      - nrf54l15dk/nrf54l15/cpuflpr
      - nrf54lm20dk/nrf54lm20a/cpuapp
      - nrf54lm20dk/nrf54lm20b/cpuapp
      - nrf7120dk/nrf7120/cpuapp
      - nrf9160dk/nrf9160
      - sama7g54_ek
      - samd20_xpro
      - bl5340_dvk/nrf5340/cpuapp
      - gd32e103v_eval
      - gd32e507z_eval
      - gd32f403z_eval
      - gd32f450i_eval
      - gd32f450z_eval
      - gd32e507v_start
      - gd32f407v_start
      - gd32f450v_start
      - gd32f470i_eval
      - stm32h735g_disco
      - stm32h573i_dk
      - rpi_pico
      - mr_canhubk3
      - s32z2xxdc2/s32z270/rtu0
      - s32z2xxdc2/s32z270/rtu1
      - s32z2xxdc2@D/s32z270/rtu0
      - s32z2xxdc2@D/s32z270/rtu1
      - lp_em_cc2340r5
      - slwrb4180b
      - xg24_rb4187c
      - xg27_rb4194a
      - xg29_rb4412a
      - pb_rh850u2a_144pin/r7f702302fafm-c
      - pb_rh850u2a_156pin/r7f702302fabd-c
      - pb_rh850u2a_176pin/r7f702302fafk-c
      - pb_rh850u2a_292pin/r7f702300afaba-c
      - pb_rh850u2a_292pin/r7f702300bfaba-c
      - pb_rh850u2a_292pin/r7f702300eaba-c
      - pb_rh850u2a_292pin/r7f702301afabg-c
      - pb_rh850u2a_292pin/r7f702301bfabg-c
      - pb_rh850u2a_292pin/r7f702301eabg-c
      - pb_rh850u2a_292pin/r7f702302fabb-c
      - pb_rh850u2a_373pin/r7f702300aebbb-c
      - pb_rh850u2a_373pin/r7f702300bebbb-c
      - pb_rh850u2a_373pin/r7f702300ebbb-c
      - pb_rh850u2a_373pin/r7f702301aebba-c
      - pb_rh850u2a_373pin/r7f702301bebba-c
      - pb_rh850u2a_373pin/r7f702301ebba-c
      - pb_rh850u2a_516pin/r7f702300aebbc-c
      - pb_rh850u2a_516pin/r7f702300bebbc-c
      - pb_rh850u2a_516pin/r7f702300ebbg-c
      - pb_rh850u2b_292pin/r7f70254xafabb-c
      - pb_rh850u2b_292pin/r7f70254xfabb-c
      - pb_rh850u2b_292pin/r7f70255xafabb-c
      - pb_rh850u2b_292pin/r7f70255xbfabb-c
      - pb_rh850u2b_292pin/r7f70255xfabb-c
      - pb_rh850u2b_373pin/r7f70254xafaba-c
      - pb_rh850u2b_373pin/r7f70254xfaba-c
      - pb_rh850u2b_468pin/r7f70254xafabg-c
      - pb_rh850u2b_468pin/r7f70254xfabg-c
      - pb_rh850u2c_100pin/r7f702606afafd-c
      - pb_rh850u2c_100pin/r7f702616afafd-c
      - pb_rh850u2c_100pin/r7f702613afafd-c
      - pb_rh850u2c_144pin/r7f702606afafb-c
      - pb_rh850u2c_144pin/r7f702606afafm-c
      - pb_rh850u2c_144pin/r7f702616afafm-c
      - pb_rh850u2c_144pin/r7f702616afafb-c
      - pb_rh850u2c_144pin/r7f702614afafm-c
      - pb_rh850u2c_144pin/r7f702614afafb-c
      - pb_rh850u2c_292pin/r7f702600afabb-c
      - pb_rh850u2c_292pin/r7f702606afabb-c
      - pb_rh850u2c_292pin/r7f702616afabb-c
      - pb_rh850u2c_292pin/r7f702613afabb-c
      - y_ask_rh850u2a/r7f702302fabb-c
      - y_ask_rh850u2a/r7f702300bfaba-c
      - y_ask_rh850u2b/r7f70255xafabb-c
      - y_ask_rh850u2b/r7f70255xbfabb-c
      - y_ask_rh850u2b/r7f70255xfabb-c
      - y_ask_rh850u2b/r7f70254xafabb-c
      - y_ask_rh850u2b/r7f70254xfabb-c
      - y_ask_rh850u2c/r7f702600afabb-c
      - y_ask_rh850u2c/r7f702606afabb-c
    integration_platforms:
      - nucleo_f746zg
  sample.drivers.counter.alarm.stm32_rtc:
    # This test case is needed because when Timer Counter is available,
    # RTC Counter will never be selected in the test.
    # CONFIG_COUNTER_RTC_STM32 flag is enabled by default when RTC is enabled.
    filter: CONFIG_SOC_FAMILY_STM32 and CONFIG_COUNTER_RTC_STM32
    extra_configs:
      # Timer Counter flag needs to be disabled for RTC node to be selected
      - CONFIG_COUNTER_TIMER_STM32=n
    tags:
      - rtc
```

## samples/drivers/i2s/i2s_codec/boards/pb_rh850u2c_292pin_r7f702600afabb-c.conf
```kconfig
CONFIG_I2C=y
CONFIG_PWM=y

CONFIG_CLOCK_CONTROL_FIXED_RATE_CLOCK=y

CONFIG_AUDIO_CODEC_WM8960=y

CONFIG_SAMPLE_FREQ=8000
CONFIG_SAMPLE_WIDTH=16
CONFIG_BYTES_PER_SAMPLE=2

CONFIG_USE_DMIC=n
```

## samples/drivers/i2s/i2s_codec/boards/rcar_ironhide_x5h_r8a7800_r52.conf
```kconfig
# Copyright (c) 2026 Renesas Electronics Corporation
# SPDX-License-Identifier: Apache-2.0

CONFIG_AUDIO_CODEC=y
CONFIG_SAMPLE_FREQ=16000
CONFIG_USE_DMIC=n
```

## samples/drivers/psi5/Kconfig
```kconfig
# Copyright (c) 2026 Renesas Electronics Corporation
# SPDX-License-Identifier: Apache-2.0

config SAMPLE_PSI5_CHANNEL
	int "PSI5 channel used by the sample"
	range 0 7
	default 1
	help
	  Channel ID passed to psi5_register_callback(), psi5_start_sync()
	  and psi5_send(). It must match the channel node enabled in the
	  board overlay.

source "Kconfig.zephyr"
```

## samples/drivers/psi5/boards/pb_rh850u2a_373pin_r7f702301aebba-c.conf
```kconfig
CONFIG_SAMPLE_PSI5_CHANNEL=0
CONFIG_LOG_PROCESS_THREAD_CUSTOM_PRIORITY=y
CONFIG_LOG_PROCESS_THREAD_PRIORITY=-1
```

## samples/drivers/sent/Kconfig
```kconfig
# Copyright (c) 2026 Renesas Electronics Corporation
#
# SPDX-License-Identifier: Apache-2.0

mainmenu "SENT driver sample"

source "Kconfig.zephyr"

config SENT_SAMPLE_CHANNEL
	int "SENT channel used by the sample"
	default 1
	help
	  Select the SENT channel used by the sample.
```
