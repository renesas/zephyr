/*
 * Copyright (c) 2025 Renesas Electronics Corporation
 *
 * SPDX-License-Identifier: Apache-2.0
 */

#include <mem.h>
// #include <zephyr/dt-bindings/pinctrl/renesas/pinctrl-u2b.h>
// #include <zephyr/dt-bindings/clock/u2b_clock.h>

/ {
	#address-cells = <1>;
	#size-cells = <1>;
	cpus {
		#address-cells = <1>;
		#size-cells = <0>;

		cpu@0 {
			device_type = "cpu";
			compatible = "renesas,g4mh";
			reg = <0>;
			status = "okay";
		};
	};
};
